## subsys/gesture_access/Kconfig
```kconfig
#
# Copyright (c) 2026 Nordic Semiconductor ASA
#
# SPDX-License-Identifier: LicenseRef-Nordic-5-Clause
#

menuconfig DOOR_LOCK_GESTURE_ACCESS
	bool "Door Lock gesture access (SPI camera + on-device inference)"
	select CPP
	select NRF_AXON
	help
	  Enables gesture-based access control using an SPI camera and
	  on-device inference from the nRF Edge AI SDK (sdk-edge-ai).

if DOOR_LOCK_GESTURE_ACCESS

config NRF_AXON_INTERLAYER_BUFFER_SIZE
	int
	default 120000

config DOOR_LOCK_GESTURE_ACCESS_DETECTION_THRESHOLD_MILLI
	int "Detection confidence threshold in permille (0-1000)"
	range 0 1000
	default 950
	help
	  Minimum model confidence required for a grid cell to count as a
	  detection, expressed as permille (950 = 95.0%). Tuned for the
	  bundled FOMO model; changing it without re-evaluating the model
	  may affect false-positive rate.

module = DOOR_LOCK_GESTURE_ACCESS
module-str = Door Lock gesture access
source "$(ZEPHYR_BASE)/subsys/logging/Kconfig.template.log_config"

config DOOR_LOCK_GESTURE_ACCESS_FRAME_FORWARDING
	bool "Forward captured camera frames to a host PC over serial"
	select CRC
	select USB_DEVICE_STACK_NEXT
	select USBD_CDC_ACM_CLASS
	select UART_INTERRUPT_DRIVEN
	select UART_LINE_CTRL
	help
	  Build-time debug aid. When enabled, every captured
	  frame plus its inference result is pushed over the SoC's native
	  USB port (as a CDC ACM virtual COM port) to a host tool for
	  visualization. See scripts/gesture_frame_viewer.py.

	  Frames are only sent while a host has the port open (DTR
	  asserted), so the application runs unchanged when nothing is
	  connected. The console stays on its own UART (e.g. the onboard
	  debugger's virtual COM port), so log output and frame data never
	  share a channel.

	  Not intended for production builds: it adds a USB channel and
	  per-frame transmit overhead purely for debugging.

if DOOR_LOCK_GESTURE_ACCESS_FRAME_FORWARDING

config DOOR_LOCK_GESTURE_ACCESS_FRAME_FORWARDING_TX_TIMEOUT_MS
	int "Per-frame USB transmit timeout in milliseconds"
	default 500
	help
	  Upper bound on how long a single frame transfer may take. Sending
	  is abandoned once this expires, which keeps capture and inference
	  running if the host stops draining the port.

config DOOR_LOCK_GESTURE_ACCESS_FRAME_FORWARDING_USB_VID
	hex "USB vendor ID"
	default 0x2fe3
	help
	  Defaults to the Zephyr project vendor ID, which is only licensed
	  for development and testing.

config DOOR_LOCK_GESTURE_ACCESS_FRAME_FORWARDING_USB_PID
	hex "USB product ID"
	default 0x0101

endif # DOOR_LOCK_GESTURE_ACCESS_FRAME_FORWARDING

config DOOR_LOCK_GESTURE_ACCESS_THREAD_STACK_SIZE
	int "Gesture access capture thread stack size"
	default 4096
	help
	  Stack size for the dedicated gesture-access thread that owns the
	  camera capture loop and on-device gesture inference.

config DOOR_LOCK_GESTURE_ACCESS_THREAD_PRIORITY
	int "Gesture access capture thread priority"
	default 11
	help
	  Priority of the dedicated gesture-access capture thread. Left as a
	  preemptible priority so it does not delay higher-priority
	  threads while it blocks on frame capture and runs
	  inference.

config DOOR_LOCK_GESTURE_ACCESS_DEBOUNCE_CONFIRM_FRAMES
	int "Consecutive detecting frames required to confirm a gesture"
	range 1 255
	default 3
	help
	  Number of consecutive frames with at least one model detection
	  required before the debounced detection state is reported as
	  "detected". Filters out single-frame false positives.

config DOOR_LOCK_GESTURE_ACCESS_DEBOUNCE_RELEASE_FRAMES
	int "Consecutive non-detecting frames required to release a gesture"
	range 1 255
	default 2
	help
	  Number of consecutive frames with no model detection required
	  before the debounced detection state falls back to "not detected".

endif # DOOR_LOCK_GESTURE_ACCESS
```

## subsys/gesture_access/gesture_access_workqueue/Kconfig
```kconfig
#
# Copyright (c) 2026 Nordic Semiconductor ASA
#
# SPDX-License-Identifier: LicenseRef-Nordic-5-Clause
#

config DOOR_LOCK_GESTURE_ACCESS_WORKQUEUE
	bool "Gesture access work queue"
	help
	  Dedicated work queue for gesture-access camera capture
	  and on-device inference work. Selected automatically by
	  CONFIG_DOOR_LOCK_GESTURE_ACCESS; do not enable directly.

if DOOR_LOCK_GESTURE_ACCESS_WORKQUEUE

config DOOR_LOCK_GESTURE_ACCESS_WORKQUEUE_INIT_PRIORITY
	int "Gesture access workqueue init priority"
	default APPLICATION_INIT_PRIORITY

config DOOR_LOCK_GESTURE_ACCESS_WORKQUEUE_STACK_SIZE
	int "Gesture access workqueue stack size"
	default 4096
	help
	  Stack size for the dedicated gesture-access workqueue thread that
	  runs camera capture work and on-device gesture
	  inference work.

config DOOR_LOCK_GESTURE_ACCESS_WORKQUEUE_PRIORITY
	int "Gesture access workqueue priority"
	default 11
	help
	  Cooperative thread priority of the dedicated gesture-access work
	  queue.

endif # DOOR_LOCK_GESTURE_ACCESS_WORKQUEUE
```

## subsys/gesture_access/model/Kconfig
```kconfig
#
# Copyright (c) 2026 Nordic Semiconductor ASA
#
# SPDX-License-Identifier: LicenseRef-Nordic-5-Clause
#

config DOOR_LOCK_GESTURE_ACCESS_MODEL
	bool "Gesture access inference model"
	select CPP
	select NRF_AXON


if DOOR_LOCK_GESTURE_ACCESS_MODEL

config NRF_AXON_INTERLAYER_BUFFER_SIZE
	int
	default 120000


endif # DOOR_LOCK_GESTURE_ACCESS_MODEL
```

## tests/functional/subsys/aliro_nfc_user_device/provisioning/testcase.yaml
```yaml
tests:
  aliro_nfc_user_device.functional.provisioning:
    build_only: false
    platform_allow: native_sim/native/64
    integration_platforms:
      - native_sim/native/64
    tags: aliro_nfc_user_device
```

## applications/aliro-nfc-user-device/src/platform/Kconfig
```kconfig
#
# Copyright (c) 2026 Nordic Semiconductor ASA
#
# SPDX-License-Identifier: LicenseRef-Nordic-5-Clause
#

rsource "nfc/Kconfig"
rsource "os/Kconfig"
rsource "crypto/Kconfig"
rsource "authorization/Kconfig"
```

## applications/aliro-nfc-user-device/src/platform/authorization/Kconfig
```kconfig
#
# Copyright (c) 2026 Nordic Semiconductor ASA
#
# SPDX-License-Identifier: LicenseRef-Nordic-5-Clause
#

menu "Authorization"

config ALIRO_UD_AUTHORIZATION_WINDOW_SECONDS
	int "Button authorization window duration (seconds)"
	range 1 300
	default 30
	help
	  Duration, in seconds, that one DK button press keeps
	  Aliro::Interface::UserDevice::Authorization::GetState() reporting
	  AuthorizationState::Authorized (APP_PLAN.md AWP4,
	  ALIRO-UD-SYRS-P1-011).

module = ALIRO_UD_AUTHORIZATION
module-str = ALIRO_UD_AUTHORIZATION
module-dep = LOG
module-help = Enables Aliro NFC User Device authorization log messages.
source "$(ZEPHYR_BASE)/subsys/logging/Kconfig.template.log_config"

endmenu # Authorization
```

## applications/aliro-nfc-user-device/src/platform/nfc/Kconfig
```kconfig
#
# Copyright (c) 2026 Nordic Semiconductor ASA
#
# SPDX-License-Identifier: LicenseRef-Nordic-5-Clause
#

menu "NFC transport"

config ALIRO_UD_NFC_THREAD_STACK_SIZE
	int "NFC/stack worker thread stack size"
	default 40960
	help
	  Stack size for the dedicated high-priority thread that serializes
	  NFC transport events (field on/off, complete command APDUs) and
	  deferred Aliro User Device stack events into calls on
	  Aliro::UserDeviceStack. nfc_t4t_lib callbacks never call the stack
	  directly; see APP_PLAN.md AWP1.

config ALIRO_UD_NFC_THREAD_PRIORITY
	int "NFC/stack worker thread priority"
	default 5
	help
	  Zephyr preemptible priority (K_PRIO_PREEMPT) of the dedicated
	  NFC/stack worker thread.

config ALIRO_UD_NFC_EVENT_QUEUE_DEPTH
	int "NFC/stack worker bounded event queue depth"
	default 4
	help
	  Depth of the bounded queue feeding the NFC/stack worker thread.
	  Events posted while the queue is full are dropped deterministically
	  (logged, never blocking the producer); see docs/evidence.md.

config ALIRO_UD_TIMING_INSTRUMENTATION
	bool "Command-to-response timing instrumentation"
	default y
	help
	  Records the duration from delivering a command APDU to the
	  Aliro User Device stack to the stack returning from that call (by
	  which point it has already synchronously sent the response APDU),
	  as informational/regression evidence (APP_PLAN.md AWP7: no
	  normative NFC processing-time bound applies to this application's
	  PICS; see docs/evidence.md). Lightweight (one k_uptime_get_32()
	  call and a handful of integer updates per command) and safe to
	  disable entirely for production builds that do not need it: its
	  one source file is not even compiled in when this is disabled.

module = ALIRO_UD_NFC
module-str = ALIRO_UD_NFC
module-dep = LOG
module-help = Enables Aliro NFC User Device NFC transport log messages.
source "$(ZEPHYR_BASE)/subsys/logging/Kconfig.template.log_config"

endmenu # NFC transport
```

## applications/aliro-nfc-user-device/src/platform/os/Kconfig
```kconfig
#
# Copyright (c) 2026 Nordic Semiconductor ASA
#
# SPDX-License-Identifier: LicenseRef-Nordic-5-Clause
#

menu "OS bridge"

config ALIRO_UD_OS_MAX_TIMERS
	int "Maximum concurrently acquired Aliro::Interface::UserDevice::Os::Timer slots"
	default 4
	help
	  Size of the fixed pool backing Aliro::Interface::UserDevice::Os::Timer.
	  P1 uses one timer per active User Device session (the session
	  watchdog; at most one session in P1) plus headroom for later
	  application-owned timers (for example the AWP4 authorization
	  window).

config ALIRO_UD_OS_TIMER_THREAD_STACK_SIZE
	int "Os::Timer callback work queue stack size"
	default 2048
	help
	  Stack size of the dedicated work queue thread that runs
	  Aliro::Interface::UserDevice::Os::Timer expiry callbacks. Stack
	  callbacks take the stack mutex and may log, so they never run in
	  the k_timer expiry ISR.

config ALIRO_UD_OS_TIMER_THREAD_PRIORITY
	int "Os::Timer callback work queue priority"
	default 5
	help
	  Zephyr preemptible priority (K_PRIO_PREEMPT) of the Os::Timer
	  callback work queue thread.

module = ALIRO_UD_OS
module-str = ALIRO_UD_OS
module-dep = LOG
module-help = Enables Aliro NFC User Device OS bridge log messages.
source "$(ZEPHYR_BASE)/subsys/logging/Kconfig.template.log_config"

endmenu # OS bridge
```

## applications/aliro-nfc-user-device/src/platform/power/Kconfig
```kconfig
#
# Copyright (c) 2026 Nordic Semiconductor ASA
#
# SPDX-License-Identifier: LicenseRef-Nordic-5-Clause
#

menu "System OFF"

config ALIRO_UD_SYSTEM_OFF
	bool "System OFF support"
	default y
	help
	  Enables Button 0 (sw0) "wake + authorize" as the sole System OFF wake
	  source (the NFC frontend is deactivated before power-off so an NFC
	  field cannot wake the DK), Button 1 (sw1) awake-only hold/off toggle,
	  and auto-idle sleep with sys_poweroff() (docs/system_off_proposal.md).
	  Disabling this alone
	  removes all runtime power-off behavior with no other code changes:
	  this module's own sources are not compiled in when this is disabled
	  (see CMakeLists.txt), and every call site into this module elsewhere
	  in the application is wrapped in IS_ENABLED(CONFIG_ALIRO_UD_SYSTEM_OFF).

if ALIRO_UD_SYSTEM_OFF

config ALIRO_UD_SYSTEM_OFF_IDLE_DELAY_S
	int "Auto-sleep idle delay after NFC field-off (seconds)"
	default 5
	help
	  Delay after the NFC field is lost before an idle-timeout
	  sys_poweroff() is attempted (mirrors samples/nfc/system_off's
	  reschedule/cancel-on-FIELD_ON/FIELD_OFF pattern, but longer than
	  that sample's 3 s). Cancelled by a subsequent field-on. The
	  resulting deadline is never allowed to fire while a valid button
	  authorization window (AliroUd::Authorization::Window) is open.

config ALIRO_UD_SYSTEM_OFF_BUTTON1_SETTLE_MS
	int "Button 1 toggle settle / wake-to-press separation (milliseconds)"
	default 300
	help
	  Minimum time separation, after this boot's wake, before a Button 1
	  press is accepted as a hold-awake/off toggle. Serves two purposes:
	  it delays arming Button 1's edge interrupt after boot, and it is
	  re-checked in HandleButton1Press(). This prevents the Button 0 press
	  that woke the DK from cross-triggering the Button 1 handler on this
	  chip family (LATCH/wake-attribution ambiguity,
	  docs/system_off_proposal.md caveat #1/#2) and pinning the DK awake.
	  Comfortably above typical mechanical button bounce.

endif # ALIRO_UD_SYSTEM_OFF

module = ALIRO_UD_POWER
module-str = ALIRO_UD_POWER
module-dep = LOG
module-help = Enables Aliro NFC User Device System OFF/power log messages.
source "$(ZEPHYR_BASE)/subsys/logging/Kconfig.template.log_config"

endmenu # System OFF
```

## applications/aliro-nfc-user-device/src/storage/credential/Kconfig
```kconfig
#
# Copyright (c) 2026 Nordic Semiconductor ASA
#
# SPDX-License-Identifier: LicenseRef-Nordic-5-Clause
#

menu "Credential and trust persistence (AWP3)"

config ALIRO_UD_CREDENTIAL_PSA_WANT
	bool
	default y
	# key_backend_psa.cpp / fake_key_backend.cpp: import an Access
	# Credential private-key scalar (ImportPrivateKeyScalar), export its
	# public key, and sign with it (ECDSA P-256/SHA-256). Kept here
	# (rather than platform/crypto/Kconfig, AWP5) since it is this
	# module's own PSA usage, independent of which KeyBackend is linked
	# (APP_PLAN.md AWP3/AWP5). See platform/crypto/Kconfig for the
	# session/ephemeral-key PSA requirements.
	select PSA_WANT_KEY_TYPE_ECC_KEY_PAIR_IMPORT
	select PSA_WANT_KEY_TYPE_ECC_KEY_PAIR_EXPORT
	select PSA_WANT_ECC_SECP_R1_256
	select PSA_WANT_ALG_ECDSA
	select PSA_WANT_ALG_SHA_256
	help
	  PSA Crypto algorithm/key-type requirements for Access Credential
	  private-key storage, shared by the real and host-test-fake
	  KeyBackend implementations.

config ALIRO_UD_MAX_CREDENTIALS
	int "Maximum number of provisioned Access Credentials"
	default 4
	range 1 8
	help
	  Fixed capacity of the credential store. APP_PLAN.md AWP3 requires a
	  default of four. Each credential occupies one fixed persistent
	  storage slot (slot index = CredentialHandle - 1); handles are never
	  reused for a different slot.

config ALIRO_UD_MAX_BINDINGS_PER_CREDENTIAL
	int "Maximum reader_group_identifier bindings per Access Credential"
	default 16
	range 16 32
	help
	  Aliro 1.0 Specification section 6.2 and ALIRO-UD-SYRS-P1-009 require
	  at least 16 distinct reader_group_identifier bindings per credential,
	  each independently trusting a directly-bound Reader public key or a
	  Reader System Issuer CA public key (WP5.5 decision D9).

config ALIRO_UD_MAILBOX_MAX_SIZE
	int "Maximum provisionable per-credential mailbox size (bytes)"
	default 512
	range 1 4096
	help
	  Upper bound on the mailbox size staged as part of credential
	  provisioning (APP_PLAN.md AWP3/AWP6). The mailbox byte storage and
	  EXCHANGE semantics themselves are implemented in AWP6; AWP3 only
	  persists the provisioned size and permissions.

config ALIRO_UD_DOCUMENT_MAX_SIZE
	int "Maximum size of each optional Access/Revocation Document (bytes)"
	default 1024
	range 1 4096
	help
	  Upper bound on each optional Access Document and Revocation Document
	  staged as part of credential provisioning (APP_PLAN.md AWP3).

config ALIRO_UD_MAX_PREFERRED_BINDINGS
	int "Maximum distinct reader_group_identifier values with a recorded preferred credential"
	default 64
	help
	  Upper bound on the "preferred credential per shared reader
	  identifier" table (APP_PLAN.md AWP3, ALIRO-UD-SYRS-P1-010). Bounded
	  by the maximum possible number of distinct group identifiers across
	  every credential (ALIRO_UD_MAX_CREDENTIALS * ALIRO_UD_MAX_BINDINGS_PER_CREDENTIAL).

config ALIRO_UD_CREDENTIAL_KEY_ID_BASE
	hex "Base PSA persistent key ID for Access Credential private keys"
	default 0x00000100
	help
	  Each credential slot deterministically owns two adjacent persistent
	  PSA key IDs starting at this base: one for its committed key and one
	  "staged" companion ID used only while a replacement key is being
	  imported during a create/update transaction (APP_PLAN.md AWP3
	  persistent transaction journal). Slot i uses
	  (base + 2*i) committed / (base + 2*i + 1) staged. Must not overlap
	  any other persistent PSA key ID used by this application.

config ALIRO_UD_CREDENTIAL_KEY_BACKEND_REAL
	bool
	default y if !ZTEST
	help
	  Selects the real PSA/CRACEN/KMU-backed persistent key backend.
	  Disabled automatically under ZTEST, where host tests link an
	  application-owned in-memory fake instead (native_sim has no
	  hardware-backed trusted storage; APP_PLAN.md requires host tests to
	  use fakes/in-memory backends rather than depend on unavailable
	  hardware).

module = ALIRO_UD_CREDENTIAL
module-str = ALIRO_UD_CREDENTIAL
module-dep = LOG
module-help = Enables Aliro NFC User Device credential/trust storage log messages.
source "$(ZEPHYR_BASE)/subsys/logging/Kconfig.template.log_config"

endmenu # Credential and trust persistence (AWP3)
```

## applications/aliro-nfc-user-device/src/storage/document/Kconfig
```kconfig
#
# Copyright (c) 2026 Nordic Semiconductor ASA
#
# SPDX-License-Identifier: LicenseRef-Nordic-5-Clause
#

menu "Access/Revocation Document snapshots"

config ALIRO_UD_MAX_OPEN_DOCUMENT_SNAPSHOTS
	int "Maximum concurrently open Document snapshots"
	default 2
	range 2 8
	help
	  Fixed capacity of the open-snapshot table (APP_PLAN.md AWP5). AUTH1
	  opens both the Access Document and Revocation Document snapshots
	  for one session concurrently, so this must be at least 2.

module = ALIRO_UD_DOCUMENT
module-str = ALIRO_UD_DOCUMENT
module-dep = LOG
module-help = Enables Aliro NFC User Device document-snapshot log messages.
source "$(ZEPHYR_BASE)/subsys/logging/Kconfig.template.log_config"

endmenu # Access/Revocation Document snapshots
```

## applications/aliro-nfc-user-device/src/storage/mailbox/Kconfig
```kconfig
#
# Copyright (c) 2026 Nordic Semiconductor ASA
#
# SPDX-License-Identifier: LicenseRef-Nordic-5-Clause
#

menu "Mailbox persistence (AWP6)"

config ALIRO_UD_MAILBOX_MAX_SESSIONS
	int "Maximum number of concurrently open mailbox sessions"
	default 2
	range 1 8
	help
	  Fixed capacity of the OpenSnapshot()-without-Close() session table
	  (APP_PLAN.md AWP6). Phase 1 PICS is NFC-only with at most one active
	  connection, but host tests exercise session isolation with more
	  than one concurrently open session; a small fixed pool covers both.

module = ALIRO_UD_MAILBOX
module-str = ALIRO_UD_MAILBOX
module-dep = LOG
module-help = Enables Aliro NFC User Device mailbox persistence log messages.
source "$(ZEPHYR_BASE)/subsys/logging/Kconfig.template.log_config"

endmenu # Mailbox persistence (AWP6)
```

## drivers/camera/spi_cam/Kconfig
```kconfig
#
# Copyright (c) 2026 Nordic Semiconductor ASA
#
# SPDX-License-Identifier: LicenseRef-Nordic-5-Clause
#

config DOOR_LOCK_CAMERA_SPI
	bool "SPI camera driver for gesture access"
	select SPI
	select VIDEO
	select DOOR_LOCK_GESTURE_ACCESS_WORKQUEUE
	help
	  Zephyr `video` class driver for the SPI camera module used by the
	  gesture access feature. Selected automatically by
	  CONFIG_DOOR_LOCK_GESTURE_ACCESS; do not enable directly.

if DOOR_LOCK_CAMERA_SPI

module = DOOR_LOCK_CAMERA_SPI
module-str = Door Lock SPI camera driver
source "$(ZEPHYR_BASE)/subsys/logging/Kconfig.template.log_config"

config DOOR_LOCK_CAMERA_SPI_CAPTURE_INTERVAL_MS_DEFAULT
	int "Default capture cadence, in milliseconds"
	default 500
	help
	  Default period between captures, applied at init and used whenever
	  VIDEO_CID_SPI_CAM_CAPTURE_INTERVAL_MS has not been set by the
	  application. This governs gesture-access sampling only; it is
	  independent of the door lock's own event loop. The driver always
	  enforces a minimum interval derived from the worst-case capture +
	  FIFO-read latency of the configured resolution/format, regardless
	  of this value.

endif # DOOR_LOCK_CAMERA_SPI
```

## dts/bindings/door-lock,spi-cam.yaml
```yaml
#
# Copyright (c) 2026 Nordic Semiconductor ASA
#
# SPDX-License-Identifier: LicenseRef-Nordic-4-Clause
#

description: |
  SPI camera module used by the gesture access.


compatible: "door-lock,spi-cam"

include: spi-device.yaml
```

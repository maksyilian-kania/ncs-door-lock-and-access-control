## CMakeLists.txt
```
#
# Copyright (c) 2026 Nordic Semiconductor ASA
#
# SPDX-License-Identifier: LicenseRef-Nordic-5-Clause
#

cmake_minimum_required(VERSION 3.20.0)

find_package(Zephyr REQUIRED HINTS $ENV{ZEPHYR_BASE})
project(aliro-nfc-user-device)

target_sources(app PRIVATE src/main.cpp)
target_include_directories(app PRIVATE src)

add_subdirectory(src/platform/nfc)
add_subdirectory(src/platform/os)
add_subdirectory(src/platform/crypto)
add_subdirectory(src/platform/authorization)
add_subdirectory(src/platform/power)
add_subdirectory(src/storage/credential)
add_subdirectory(src/storage/key)
add_subdirectory(src/storage/mailbox)
add_subdirectory(src/storage/document)
add_subdirectory(src/cli)
```

## Kconfig
```
#
# Copyright (c) 2026 Nordic Semiconductor ASA
#
# SPDX-License-Identifier: LicenseRef-Nordic-5-Clause
#

mainmenu "Aliro NFC User Device"

module = ALIRO_UD_APP
module-str = ALIRO_UD_APP
module-dep = LOG
module-help = Enables Aliro NFC User Device application log messages.
source "$(ZEPHYR_BASE)/subsys/logging/Kconfig.template.log_config"

rsource "src/platform/Kconfig"
rsource "src/storage/credential/Kconfig"
rsource "src/storage/mailbox/Kconfig"

rsource "Kconfig.defconfig"

source "Kconfig.zephyr"
```

## Kconfig.defconfig
```
#
# Copyright (c) 2026 Nordic Semiconductor ASA
#
# SPDX-License-Identifier: LicenseRef-Nordic-5-Clause
#

#
# Persistent storage backend for Aliro::Interface::UserDevice::Credential and
# ::Trust (APP_PLAN.md AWP3). Mirrors the settings/NVS-or-ZMS defaults
# established by applications/aliro-access-control-app/Kconfig.defconfig for
# the same board family.
#
config FLASH
	default y

config FLASH_MAP
	default y

config NVS
	default y if !SOC_FLASH_NRF_RRAM

config NVS_LOOKUP_CACHE_SIZE
	default 512 if NVS

config NVS_LOOKUP_CACHE_FOR_SETTINGS
	default y if SETTINGS_NVS

config ZMS
	default y if SOC_FLASH_NRF_RRAM

config ZMS_LOOKUP_CACHE_SIZE
	default 512 if SETTINGS_ZMS

config ZMS_LOOKUP_CACHE_FOR_SETTINGS
	default y if SETTINGS_ZMS

config SETTINGS
	default y

choice NVS_LOG_LEVEL_CHOICE
	default NVS_LOG_LEVEL_ERR
endchoice

choice ZMS_LOG_LEVEL_CHOICE
	default ZMS_LOG_LEVEL_ERR
endchoice

choice SETTINGS_LOG_LEVEL_CHOICE
	default SETTINGS_LOG_LEVEL_ERR
endchoice

#
# PSA/CRACEN/KMU persistent key storage for imported Access Credential
# private keys (APP_PLAN.md AWP3). Mirrors
# applications/aliro-access-control-app/Kconfig.crypto.defconfig.
#
config PSA_CRYPTO
	default y

config TRUSTED_STORAGE
	default y

config MBEDTLS_PSA_CRYPTO_STORAGE_C
	default y

choice TRUSTED_STORAGE_BACKEND_AEAD_KEY
	default TRUSTED_STORAGE_BACKEND_AEAD_KEY_HASH_UID if SOC_SERIES_NRF52
	default TRUSTED_STORAGE_BACKEND_AEAD_KEY_DERIVE_FROM_HUK
endchoice

config HW_UNIQUE_KEY_WRITE_ON_CRYPTO_INIT
	default y if (SOC_NRF5340_CPUAPP || SOC_SERIES_NRF54L)

config MBEDTLS_ENABLE_HEAP
	default y

config MBEDTLS_HEAP_SIZE
	default 8192

# One committed + one staged persistent key per credential slot.
config MBEDTLS_PSA_KEY_SLOT_COUNT
	default 16

config HEAP_MEM_POOL_SIZE
	default 4096
```

## sample.yaml
```
sample:
  description: Aliro NFC User Device
  name: aliro-nfc-user-device
common:
  build_only: true
tests:
  build.aliro_nfc_user_device:
    platform_allow:
      - nrf54lm20dk/nrf54lm20b/cpuapp
    integration_platforms:
      - nrf54lm20dk/nrf54lm20b/cpuapp
```

## prj.conf
```kconfig
#
# Copyright (c) 2026 Nordic Semiconductor ASA
#
# SPDX-License-Identifier: LicenseRef-Nordic-5-Clause
#

#
# Aliro User Device stack (Aliro::UserDeviceStack facade, checked out under
# the "ncs-aliro" west project). Kconfig/CMake integration is supplied by the
# module itself; no manual link wiring is added here.
#
CONFIG_NCS_ALIRO_USER_DEVICE=y

#
# NFC-A Type 4 Tag/ISO-DEP listen-mode transport (AWP1). Raw ISO-DEP mode
# only: no NDEF payload is registered.
#
CONFIG_NFC_T4T_NRFXLIB=y

# Basic system configuration
CONFIG_CPP=y
CONFIG_STD_CPP17=y
CONFIG_REQUIRES_FULL_LIBCPP=y

#
# SYS_INIT hooks (including AWP4's authorization button/LED init) and
# `main()`'s own boot sequencing all run on the main thread's stack before
# the scheduler starts other threads. On-target this faulted with a
# `K_ERR_STACK_CHK_FAIL` UsageFault (PSP reaching PSPLIM exactly) inside
# CONFIG_LOG_MODE_IMMEDIATE's synchronous log-formatting/GRTC-timestamp call
# chain (`msg_process` -> `z_log_msg_runtime_vcreate` -> ... ->
# `sys_clock_cycle_get_32`) once AWP4 added another SYS_INIT hook; the
# original 4096 B evidently left too little headroom for that call depth.
# See docs/evidence/AWP4.md for the captured crash. Doubling restores
# headroom without materially affecting the RAM budget.
#
CONFIG_MAIN_STACK_SIZE=8192
CONFIG_SYSTEM_WORKQUEUE_STACK_SIZE=2048

CONFIG_LOG=y
CONFIG_LOG_MODE_IMMEDIATE=y
CONFIG_NCS_ALIRO_USER_DEVICE_LOG_LEVEL_DBG=y

#
# k_poll() multiplexes the NFC/stack worker thread's wait between the
# coalesced field-lifecycle semaphore and the bounded command/stack-event
# queue (AWP1 lifecycle-race fix; see nfc_worker.cpp).
#
CONFIG_POLL=y

CONFIG_CONSOLE=y
CONFIG_UART_CONSOLE=y

#
# Development CLI over the DK virtual UART (AWP2): Zephyr shell on the same
# UART as the console, at the board's default 115200-8N1. See
# `src/cli/cli.cpp` for the "aliro-ud" root command.
#
CONFIG_SHELL=y
#
# "aliro-ud credential set-document" takes a hex-encoded document up to
# CONFIG_ALIRO_UD_DOCUMENT_MAX_SIZE (default 1024) bytes wide (APP_PLAN.md
# AWP3); the shell command buffer must fit the longest such line: command
# prefix (~50 chars) + 2 hex chars/byte.
CONFIG_SHELL_CMD_BUFF_SIZE=2200

#
# On-target "aliro-ud credential commit" (AWP6 DK bring-up) faulted with a
# stack-overflow UsageFault on the `shell_uart` thread at the default 2048 B
# `CONFIG_SHELL_STACK_SIZE`: `PersistedCredential` (two embedded 1024 B
# `OptionalDocument` buffers plus a 16-entry `Binding` array, ~3 KB) is
# built up on that thread's stack across the staging-transaction call chain
# before being copied into the committed store (same class of issue as the
# AWP5 host-test `CONFIG_ZTEST_STACK_SIZE` fix in
# tests/.../crypto/prj.conf, but never previously hit here because no AWP
# before this one exercised a real interactive "credential commit" over
# the DK's shell). See docs/evidence/AWP6.md for the captured crash.
CONFIG_SHELL_STACK_SIZE=16384
```

## src/main.c
```c
/*
 * Copyright (c) 2026 Nordic Semiconductor ASA
 *
 * SPDX-License-Identifier: LicenseRef-Nordic-5-Clause
 */

#include <string.h>

#include <hal/nrf_power.h>
#include <nfc_t4t_lib.h>
#include <nrfx.h>
#include <zephyr/device.h>
#include <zephyr/kernel.h>
#include <zephyr/logging/log.h>
#include <zephyr/pm/device.h>
#include <zephyr/sys/poweroff.h>

#if !NRF_POWER_HAS_RESETREAS
#include <hal/nrf_reset.h>
#endif

LOG_MODULE_REGISTER(aliro_nfc_ud, LOG_LEVEL_INF);

#define SYSTEM_OFF_DELAY_S 3U
#define APDU_BUFFER_SIZE   1024U

/* Aliro expedited phase AID: A000000909ACCE5501 */
static const uint8_t kAliroExpeditedAid[] = { 0xA0, 0x00, 0x00, 0x09, 0x09, 0xAC, 0xCE, 0x55, 0x01 };

static struct k_work_delayable s_system_off_work;

static uint8_t s_apdu_buffer[APDU_BUFFER_SIZE];
static size_t s_apdu_length;
static bool s_first_message_logged;

static void send_status_response(uint8_t sw1, uint8_t sw2)
{
	const uint8_t response[] = { sw1, sw2 };
	int err = nfc_t4t_response_pdu_send(response, sizeof(response));

	if (err != 0) {
		LOG_ERR("Failed to send R-APDU: %d", err);
	}
}

static bool contains_aliro_expedited_aid(const uint8_t *apdu, size_t length)
{
	if (length < sizeof(kAliroExpeditedAid)) {
		return false;
	}

	for (size_t i = 0; i <= length - sizeof(kAliroExpeditedAid); i++) {
		if (memcmp(&apdu[i], kAliroExpeditedAid, sizeof(kAliroExpeditedAid)) == 0) {
			return true;
		}
	}

	return false;
}

static void log_first_message(const uint8_t *apdu, size_t length)
{
	LOG_HEXDUMP_INF(apdu, length, "First message from Aliro reader (C-APDU)");

	if (length >= 4U) {
		LOG_INF("C-APDU header: CLA=0x%02x INS=0x%02x P1=0x%02x P2=0x%02x", apdu[0], apdu[1],
			apdu[2], apdu[3]);
	}

	if (contains_aliro_expedited_aid(apdu, length)) {
		LOG_INF("Detected Aliro expedited phase SELECT AID");
	} else {
		LOG_INF("Aliro expedited phase AID not found in first message");
	}
}

static void enter_system_off(struct k_work *work)
{
	ARG_UNUSED(work);

	LOG_INF("Entering System OFF — approach an Aliro reader to wake the device");

	if (IS_ENABLED(CONFIG_PM_DEVICE) && IS_ENABLED(CONFIG_SERIAL)) {
		const struct device *const console = DEVICE_DT_GET(DT_CHOSEN(zephyr_console));
		enum pm_device_state state;
		int err;

		if (device_is_ready(console)) {
			do {
				err = pm_device_state_get(console, &state);
			} while ((err == 0) && (state == PM_DEVICE_STATE_ACTIVE));
		}
	}

	sys_poweroff();
}

static void schedule_system_off(void)
{
	k_work_reschedule(&s_system_off_work, K_SECONDS(SYSTEM_OFF_DELAY_S));
}

static void cancel_system_off(void)
{
	k_work_cancel_delayable(&s_system_off_work);
}

static void reset_apdu_assembly(void)
{
	s_apdu_length = 0;
}

static void handle_complete_apdu(void)
{
	if (!s_first_message_logged) {
		log_first_message(s_apdu_buffer, s_apdu_length);
		s_first_message_logged = true;
	}

	/* Minimal placeholder response for the POC — full Aliro handling comes later. */
	send_status_response(0x6A, 0x82);
	reset_apdu_assembly();
}

static void nfc_callback(void *context, nfc_t4t_event_t event, const uint8_t *data, size_t data_length,
			 uint32_t flags)
{
	ARG_UNUSED(context);

	switch (event) {
	case NFC_T4T_EVENT_FIELD_ON:
		cancel_system_off();
		reset_apdu_assembly();
		s_first_message_logged = false;
		LOG_INF("NFC field detected");
		break;

	case NFC_T4T_EVENT_FIELD_OFF:
		schedule_system_off();
		reset_apdu_assembly();
		LOG_INF("NFC field removed");
		break;

	case NFC_T4T_EVENT_DATA_IND:
		if (data_length > 0U) {
			if ((s_apdu_length + data_length) > APDU_BUFFER_SIZE) {
				LOG_ERR("APDU buffer overflow, discarding message");
				reset_apdu_assembly();
				send_status_response(0x6F, 0x00);
				break;
			}

			memcpy(&s_apdu_buffer[s_apdu_length], data, data_length);
			s_apdu_length += data_length;
		}

		if ((flags & NFC_T4T_DI_FLAG_MORE) == 0U) {
			handle_complete_apdu();
		}
		break;

	default:
		break;
	}
}

static void print_reset_reason(void)
{
	uint32_t reason;

#if NRF_POWER_HAS_RESETREAS
	reason = nrf_power_resetreas_get(NRF_POWER);
	nrf_power_resetreas_clear(NRF_POWER, reason);
#else
	reason = nrf_reset_resetreas_get(NRF_RESET);
	nrf_reset_resetreas_clear(NRF_RESET, reason);
#endif

#if NRF_POWER_HAS_RESETREAS
	if (reason & NRF_POWER_RESETREAS_NFC_MASK) {
#else
	if (reason & NRF_RESET_RESETREAS_NFC_MASK) {
#endif
		LOG_INF("Wake-up cause: NFC field detect");
#if NRF_POWER_HAS_RESETREAS
	} else if (reason & NRF_POWER_RESETREAS_RESETPIN_MASK) {
#else
	} else if (reason & NRF_RESET_RESETREAS_RESETPIN_MASK) {
#endif
		LOG_INF("Wake-up cause: pin reset");
#if NRF_POWER_HAS_RESETREAS
	} else if (reason & NRF_POWER_RESETREAS_SREQ_MASK) {
#else
	} else if (reason & NRF_RESET_RESETREAS_SREQ_MASK) {
#endif
		LOG_INF("Wake-up cause: soft reset");
	} else if (reason != 0U) {
		LOG_INF("Wake-up cause: other (0x%08x)", reason);
	} else {
		LOG_INF("Wake-up cause: power-on reset");
	}
}

static int start_nfc_listen_mode(void)
{
	int err;

	/* Raw ISO-DEP mode: do not register an NDEF payload. */
	err = nfc_t4t_setup(nfc_callback, NULL);
	if (err != 0) {
		LOG_ERR("nfc_t4t_setup failed: %d", err);
		return err;
	}

	err = nfc_t4t_emulation_start();
	if (err != 0) {
		LOG_ERR("nfc_t4t_emulation_start failed: %d", err);
		return err;
	}

	LOG_INF("NFC T4T listen mode started (raw ISO-DEP)");
	return 0;
}

int main(void)
{
	LOG_INF("Aliro NFC User Device POC");

	print_reset_reason();

	k_work_init_delayable(&s_system_off_work, enter_system_off);
	schedule_system_off();

	if (start_nfc_listen_mode() != 0) {
		LOG_ERR("NFC initialization failed");
		return 0;
	}

	return 0;
}
```

## src/main.cpp
```c
/*
 * Copyright (c) 2026 Nordic Semiconductor ASA
 *
 * SPDX-License-Identifier: LicenseRef-Nordic-5-Clause
 */

#include <zephyr/kernel.h>
#include <zephyr/logging/log.h>

#include <aliro/user_device/user_device.h>

#include "platform/nfc/nfc_transport.h"
#include "platform/os/app_status.h"
#include "platform/power/power.h"
#include "storage/credential/credential_store.h"
#include "storage/key/persistent_key_store.h"
#include "storage/mailbox/mailbox_store.h"

LOG_MODULE_REGISTER(aliro_nfc_ud, LOG_LEVEL_INF);

/*
 * main() performs boot sequencing only (see docs/architecture.md).
 * Authorization and the development CLI are implemented in their own
 * modules starting with later AWPs; none of that protocol or platform
 * behavior belongs here. Credential/trust persistence (AWP3) is
 * initialized here because it must run its boot-time transaction-journal
 * recovery before the NFC transport starts (a session must never observe
 * a half-committed credential record).
 */
int main(void)
{
	LOG_INF("Aliro NFC User Device");

	const AliroError credentialError = AliroUd::Credential::Store::Init();
	if (credentialError != ALIRO_NO_ERROR) {
		LOG_ERR("Credential store initialization failed: %d", credentialError.ToInt());
		AliroUd::AppStatus::SetInitState(AliroUd::AppStatus::InitState::StackInitFailed);
		return 0;
	}

	/*
	 * Kpersistent records are keyed by credential handle, so this must
	 * initialize after the credential store above.
	 */
	const AliroError persistentKeyError = AliroUd::PersistentKey::Store::Init();
	if (persistentKeyError != ALIRO_NO_ERROR) {
		LOG_ERR("Persistent key store initialization failed: %d", persistentKeyError.ToInt());
		AliroUd::AppStatus::SetInitState(AliroUd::AppStatus::InitState::StackInitFailed);
		return 0;
	}

	/*
	 * Mailbox byte storage (AWP6) is keyed by credential handle and reads
	 * mailbox configuration live from the credential store, so it must
	 * initialize after the credential store above.
	 */
	const AliroError mailboxError = AliroUd::Mailbox::Store::Init();
	if (mailboxError != ALIRO_NO_ERROR) {
		LOG_ERR("Mailbox store initialization failed: %d", mailboxError.ToInt());
		AliroUd::AppStatus::SetInitState(AliroUd::AppStatus::InitState::StackInitFailed);
		return 0;
	}

	const AliroError err = Aliro::UserDeviceStack::Instance().Init();

	if (err != ALIRO_NO_ERROR) {
		/*
		 * AliroError::ToString() is declared in the shared aliro/errors.h
		 * header but its definition (stack/src/errors/errors.cpp) is only
		 * built for CONFIG_NCS_ALIRO (Reader); a User-Device-only build
		 * cannot link it. Use the numeric code instead of narrowing this
		 * skeleton around that gap; see docs/evidence/AWP0.md.
		 */
		LOG_ERR("User Device stack initialization failed: %d", err.ToInt());
		AliroUd::AppStatus::SetInitState(AliroUd::AppStatus::InitState::StackInitFailed);
		return 0;
	}

	LOG_INF("User Device stack initialized");

	/*
	 * Starts the dedicated NFC/stack worker thread and NFC-A Type 4
	 * Tag/ISO-DEP listen-mode transport (AWP1). Field activation/removal
	 * and command APDUs are mapped to UserDeviceStack session lifecycle
	 * calls on that worker thread from here on; main() has no further
	 * role to play.
	 */
	if (AliroUd::Nfc::Start() != 0) {
		LOG_ERR("NFC transport initialization failed");
		AliroUd::AppStatus::SetInitState(AliroUd::AppStatus::InitState::NfcStartFailed);
		return 0;
	}

	AliroUd::AppStatus::SetInitState(AliroUd::AppStatus::InitState::Running);

	/*
	 * System OFF support (docs/system_off_proposal.md): Button 0
	 * "wake + authorize" as the sole wake source, Button 1 hold/off toggle,
	 * auto-idle sleep. Started last, after the NFC transport and worker
	 * thread are already running, since NotifyFieldOn()/NotifyFieldOff()
	 * calls can arrive as soon as AliroUd::Nfc::Start() returns above.
	 */
	if (IS_ENABLED(CONFIG_ALIRO_UD_SYSTEM_OFF)) {
		AliroUd::Power::Start();
	}

	return 0;
}
```

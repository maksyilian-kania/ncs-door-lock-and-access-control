## CMakeLists.txt
```
#
# Copyright (c) 2026 Nordic Semiconductor ASA
#
# SPDX-License-Identifier: LicenseRef-Nordic-5-Clause
#

cmake_minimum_required(VERSION 3.20.0)

find_package(Zephyr REQUIRED HINTS $ENV{ZEPHYR_BASE})

project(aliro_nfc_user_device_authorization)

set(ALIRO_UD_APP_SRC_DIR ${CMAKE_CURRENT_SOURCE_DIR}/../../../../../applications/aliro-nfc-user-device/src)
set(ALIRO_UD_WORKER_LIFECYCLE_TEST_SRC_DIR ${CMAKE_CURRENT_SOURCE_DIR}/../worker_lifecycle/src)
set(ALIRO_UD_TEST_COMMON_DIR ${CMAKE_CURRENT_SOURCE_DIR}/../common)

target_include_directories(app PRIVATE ${ALIRO_UD_APP_SRC_DIR} ${ALIRO_UD_TEST_COMMON_DIR}
					${ALIRO_UD_WORKER_LIFECYCLE_TEST_SRC_DIR})

# authorization_window.cpp (pure state machine) and authorization.cpp (the
# real Aliro::Interface::UserDevice::Authorization adapter) under test
# (APP_PLAN.md AWP4), plus the real worker/os/credential stack so
# test_authorization_e2e.cpp can drive a real AUTH0 command through the real
# Aliro::UserDeviceStack, exactly as worker_lifecycle/cli_info do.
# authorization_button.cpp/authorization_led.cpp (DK-hardware-only GPIO) are
# excluded, substituted by fake_authorization_indicator.cpp.
target_sources(app PRIVATE
  ${ALIRO_UD_APP_SRC_DIR}/platform/authorization/authorization_window.cpp
  ${ALIRO_UD_APP_SRC_DIR}/platform/authorization/authorization.cpp
  ${ALIRO_UD_TEST_COMMON_DIR}/fake_authorization_indicator.cpp
  ${ALIRO_UD_APP_SRC_DIR}/platform/nfc/nfc_worker.cpp
  ${ALIRO_UD_APP_SRC_DIR}/platform/os/os_mutex.cpp
  ${ALIRO_UD_APP_SRC_DIR}/platform/os/os_timer.cpp
  ${ALIRO_UD_APP_SRC_DIR}/platform/os/os_queue.cpp
  ${ALIRO_UD_APP_SRC_DIR}/platform/os/os_trusted_time.cpp
  ${ALIRO_UD_APP_SRC_DIR}/platform/os/os_logging.cpp
  ${ALIRO_UD_APP_SRC_DIR}/platform/os/transaction.cpp
  ${ALIRO_UD_APP_SRC_DIR}/storage/credential/credential.cpp
  ${ALIRO_UD_APP_SRC_DIR}/storage/credential/credential_store.cpp
  ${ALIRO_UD_TEST_COMMON_DIR}/fake_credential_persistence.cpp
  ${ALIRO_UD_TEST_COMMON_DIR}/fake_key_backend.cpp
  # The real Aliro::UserDeviceStack references the Crypto,
  # CredentialSigning, Document, and PersistentKey contracts; the
  # PersistentKey persistence/key backends are swapped for in-memory fakes.
  ${ALIRO_UD_APP_SRC_DIR}/platform/crypto/crypto.cpp
  ${ALIRO_UD_APP_SRC_DIR}/platform/crypto/certificate.cpp
  ${ALIRO_UD_APP_SRC_DIR}/platform/crypto/credential_signing.cpp
  ${ALIRO_UD_APP_SRC_DIR}/storage/document/document.cpp
  ${ALIRO_UD_APP_SRC_DIR}/storage/document/document_snapshots.cpp
  ${ALIRO_UD_APP_SRC_DIR}/storage/key/persistent_key.cpp
  ${ALIRO_UD_APP_SRC_DIR}/storage/key/persistent_key_store.cpp
  ${ALIRO_UD_TEST_COMMON_DIR}/fake_persistent_key_persistence.cpp
  ${ALIRO_UD_TEST_COMMON_DIR}/fake_persistent_key_backend.cpp
  # WP7 stack impact (see docs/wp7_stack_impact.md): the real
  # Aliro::UserDeviceStack now unconditionally calls
  # Aliro::Interface::UserDevice::Mailbox::* from
  # UserDeviceStateMachine::HandleAuth1()/HandleExchange() (WP7-S7), even
  # for SELECT-only traffic's session teardown path.
  ${ALIRO_UD_APP_SRC_DIR}/storage/mailbox/mailbox.cpp
  ${ALIRO_UD_APP_SRC_DIR}/storage/mailbox/mailbox_sessions.cpp
  ${ALIRO_UD_APP_SRC_DIR}/storage/mailbox/mailbox_store.cpp
  ${ALIRO_UD_TEST_COMMON_DIR}/fake_mailbox_persistence.cpp
  ${ALIRO_UD_WORKER_LIFECYCLE_TEST_SRC_DIR}/fake_nfc_interface.cpp
  src/test_authorization_window.cpp
  src/test_authorization_contract.cpp
  src/test_authorization_e2e.cpp
)

# nfc_worker.cpp calls into BeginCommandTiming()/EndCommandTiming()
# (APP_PLAN.md AWP7); mirrors the application's own CMakeLists.txt (see
# worker_lifecycle's copy of this comment for the full rationale).
target_sources_ifdef(CONFIG_ALIRO_UD_TIMING_INSTRUMENTATION app PRIVATE
  ${ALIRO_UD_APP_SRC_DIR}/platform/nfc/command_timing.cpp
)
```

## Kconfig
```
#
# Copyright (c) 2026 Nordic Semiconductor ASA
#
# SPDX-License-Identifier: LicenseRef-Nordic-5-Clause
#

mainmenu "Aliro NFC User Device - Authorization Test"

# Pulls in CONFIG_ALIRO_UD_NFC_*/CONFIG_ALIRO_UD_OS_*/CONFIG_ALIRO_UD_AUTHORIZATION_*:
# this test builds the real platform/nfc/nfc_worker.cpp, platform/os/*.cpp,
# and platform/authorization/*.cpp sources directly (see CMakeLists.txt), so
# it needs the same Kconfig options they reference, normally sourced via the
# application's own Kconfig.
rsource "../../../../../applications/aliro-nfc-user-device/src/platform/nfc/Kconfig"
rsource "../../../../../applications/aliro-nfc-user-device/src/platform/os/Kconfig"
rsource "../../../../../applications/aliro-nfc-user-device/src/platform/authorization/Kconfig"
rsource "../../../../../applications/aliro-nfc-user-device/src/storage/credential/Kconfig"
# WP7 stack impact (see docs/wp7_stack_impact.md): the real
# Aliro::UserDeviceStack now unconditionally calls
# Aliro::Interface::UserDevice::Mailbox::*, so this test now also builds
# storage/mailbox/*.cpp (see CMakeLists.txt) and needs its Kconfig options.
rsource "../../../../../applications/aliro-nfc-user-device/src/storage/mailbox/Kconfig"
# The Crypto, Document, and PersistentKey sources this test builds (see
# CMakeLists.txt) reference their own Kconfig options.
rsource "../../../../../applications/aliro-nfc-user-device/src/platform/crypto/Kconfig"
rsource "../../../../../applications/aliro-nfc-user-device/src/storage/key/Kconfig"
rsource "../../../../../applications/aliro-nfc-user-device/src/storage/document/Kconfig"

source "Kconfig.zephyr"
```

## prj.conf
```kconfig
#
# Copyright (c) 2026 Nordic Semiconductor ASA
#
# SPDX-License-Identifier: LicenseRef-Nordic-5-Clause
#

CONFIG_NCS_ALIRO_USER_DEVICE=y

CONFIG_CPP=y
CONFIG_STD_CPP17=y
CONFIG_REQUIRES_FULL_LIBCPP=y

CONFIG_ZTEST=y
CONFIG_ZTEST_STACK_SIZE=4096
CONFIG_MAIN_STACK_SIZE=4096

CONFIG_LOG=y

# k_poll() multiplexes the worker thread's wait between the coalesced
# field-lifecycle semaphore and the bounded command/stack-event queue.
CONFIG_POLL=y

#
# PSA Crypto (volatile only): backs the AWP3 credential-store fake key
# backend's real scalar validation/public-key derivation. See
# tests/functional/subsys/aliro_nfc_user_device/common/fake_key_backend.cpp.
#
CONFIG_PSA_CRYPTO=y
CONFIG_PSA_WANT_KEY_TYPE_ECC_KEY_PAIR_IMPORT=y
CONFIG_PSA_WANT_KEY_TYPE_ECC_PUBLIC_KEY=y
CONFIG_PSA_WANT_ECC_SECP_R1_256=y
CONFIG_PSA_WANT_ALG_ECDSA=y
CONFIG_PSA_WANT_ALG_SHA_256=y
CONFIG_PSA_WANT_GENERATE_RANDOM=y
```

## src/test_authorization_contract.cpp
```c
/*
 * Copyright (c) 2026 Nordic Semiconductor ASA
 *
 * SPDX-License-Identifier: LicenseRef-Nordic-5-Clause
 */

#include <zephyr/kernel.h>
#include <zephyr/ztest.h>

#include "fake_authorization_indicator.h"
#include "platform/authorization/authorization_window.h"

#include <aliro/user_device/interface.h>

/*
 * Contract-level tests for Aliro::Interface::UserDevice::Authorization
 * (APP_PLAN.md AWP4): the real authorization.cpp adapter in front of the
 * real AliroUd::Authorization::GlobalWindow() and a fake LED indicator
 * recorder (native_sim has no `led0` devicetree alias).
 */

using AuthorizationState = ::Aliro::UserDevice::AuthorizationState;

namespace {

void ResetBeforeEachTest(void *fixture)
{
	(void)fixture;
	AliroUd::Authorization::GlobalWindow().Close();
	AliroUd::Authorization::Test::ResetFakeAuthorizationIndicator();
}

} // namespace

ZTEST_SUITE(aliro_ud_authorization_contract, nullptr, nullptr, ResetBeforeEachTest, nullptr, nullptr);

/** @brief With no window open, GetState() reports Required for any credential handle. */
ZTEST(aliro_ud_authorization_contract, test_get_state_required_with_no_window)
{
	AuthorizationState state{ AuthorizationState::Authorized };

	const auto error = Aliro::Interface::UserDevice::Authorization::GetState(1, state);

	zassert_equal(ALIRO_NO_ERROR, error, "GetState() must succeed");
	zassert_equal(static_cast<int>(AuthorizationState::Required), static_cast<int>(state),
		      "Expected Required with no open window");
}

/** @brief GetState() reflects a window opened directly on AliroUd::Authorization::GlobalWindow() (button press). */
ZTEST(aliro_ud_authorization_contract, test_get_state_authorized_after_window_opened)
{
	AliroUd::Authorization::GlobalWindow().Open(k_uptime_get(), 30000);

	AuthorizationState state{ AuthorizationState::Required };
	const auto error = Aliro::Interface::UserDevice::Authorization::GetState(1, state);

	zassert_equal(ALIRO_NO_ERROR, error, "GetState() must succeed");
	zassert_equal(static_cast<int>(AuthorizationState::Authorized), static_cast<int>(state),
		      "Expected Authorized with an open window");
}

/** @brief GetState() ignores the credential handle: the window is device-global, not per-credential. */
ZTEST(aliro_ud_authorization_contract, test_get_state_is_credential_independent)
{
	AliroUd::Authorization::GlobalWindow().Open(k_uptime_get(), 30000);

	AuthorizationState stateForOne{ AuthorizationState::Required };
	AuthorizationState stateForOther{ AuthorizationState::Required };
	zassert_equal(ALIRO_NO_ERROR, Aliro::Interface::UserDevice::Authorization::GetState(1, stateForOne));
	zassert_equal(ALIRO_NO_ERROR,
		      Aliro::Interface::UserDevice::Authorization::GetState(0xDEADBEEF, stateForOther));

	zassert_equal(static_cast<int>(AuthorizationState::Authorized), static_cast<int>(stateForOne),
		      "Handle 1 must see the shared window");
	zassert_equal(static_cast<int>(AuthorizationState::Authorized), static_cast<int>(stateForOther),
		      "An arbitrary other handle must see the same shared window");
}

/** @brief NotifyAuthenticationRequired() turns the visible indication on exactly once per call. */
ZTEST(aliro_ud_authorization_contract, test_notify_authentication_required_activates_indicator)
{
	zassert_equal(0u, AliroUd::Authorization::Test::GetSetActiveCallCount(), "No indicator call yet");

	Aliro::Interface::UserDevice::Authorization::NotifyAuthenticationRequired(1);

	zassert_equal(1u, AliroUd::Authorization::Test::GetSetActiveCallCount(),
		      "Expected exactly one indicator call");
	zassert_true(AliroUd::Authorization::Test::GetLastActive(), "Expected the indicator to be turned on");
}
```

## src/test_authorization_e2e.cpp
```c
/*
 * Copyright (c) 2026 Nordic Semiconductor ASA
 *
 * SPDX-License-Identifier: LicenseRef-Nordic-5-Clause
 */

#include <zephyr/kernel.h>
#include <zephyr/ztest.h>

#include "fake_authorization_indicator.h"
#include "fake_credential_persistence.h"
#include "fake_key_backend.h"
#include "fake_nfc_interface.h"
#include "platform/authorization/authorization_window.h"
#include "platform/nfc/nfc_worker.h"
#include "storage/credential/credential_store.h"

#include <aliro/user_device/interface.h>

#include <array>
#include <vector>

/*
 * End-to-end test: a real AUTH0 command, with authentication_policy 0x03
 * ("Force user authentication"), sent through the real bounded queue/worker
 * thread and the real Aliro::UserDeviceStack (ncs-aliro WP5.5) against a
 * real credential provisioned through this application's own
 * credential_store, exercising the full application-owned half of
 * ALIRO-UD-SYRS-P1-011/012/020/021: no window -> AUTH0 defers exactly one
 * NotifyAuthenticationRequired() call (turning the LED indication on);
 * pressing the button (Window::Open()) first -> the same AUTH0 command
 * proceeds without ever calling it.
 *
 * The AUTH0 response is the same successful credential_ePubK response in
 * both cases, differing only in that freshly generated key
 * (ALIRO-UD-SYRS-P1-031: "AUTH0 ... externally observable data independent
 * of credential/reader-key/Kpersistent existence"); only the deferred
 * NotifyAuthenticationRequired() delivery differs, which is exactly the
 * application-owned behavior AWP4 implements.
 */

using namespace AliroUd::Nfc;

namespace {

void SettleWorker()
{
	k_msleep(50);
}

void *SetupSuite(void)
{
	StartWorker();
	SettleWorker();
	return nullptr;
}

void ResetBeforeEachTest(void *fixture)
{
	(void)fixture;

	AliroUdTest::FakeNfc::Reset();
	AliroUd::Credential::Test::ResetFakePersistence();
	AliroUd::Credential::Test::ResetFakeKeyBackend();
	AliroUd::Authorization::GlobalWindow().Close();
	AliroUd::Authorization::Test::ResetFakeAuthorizationIndicator();

	zassert_equal(ALIRO_NO_ERROR, AliroUd::Credential::Store::Init(), "Credential store init must succeed");

	if (IsSessionActive()) {
		PostFieldOff();
		SettleWorker();
	}
}

/* An arbitrary valid (nonzero, below the P-256 curve order) private key scalar; reused from the AWP3 CLI test. */
std::array<uint8_t, 32> KeyScalar()
{
	return { 0x23, 0x23, 0x10, 0x22, 0xa3, 0x66, 0x2c, 0xeb, 0x6f, 0x2e, 0x6a, 0x4e, 0x99, 0x88, 0x66, 0xae,
		 0x88, 0xd6, 0xe9, 0xda, 0x1c, 0x72, 0xb0, 0x50, 0xae, 0x5c, 0x20, 0x6a, 0x1d, 0xa4, 0x67, 0x12 };
}

::Aliro::CryptoTypes::PublicKey ArbitraryTrustAnchorKey()
{
	::Aliro::CryptoTypes::PublicKey key{};
	key[0] = 0x04;
	for (size_t i = 1; i < key.size(); ++i) {
		key[i] = 0x11;
	}
	return key;
}

/** @brief Provisions one credential with a single binding and the given policy; returns its handle. */
::Aliro::UserDevice::CredentialHandle SeedCredential(::Aliro::UserDevice::AuthenticationPolicy policy,
						     const ::Aliro::UserDevice::ReaderGroupIdentifier &readerGroupId)
{
	AliroUd::Credential::Provisioning::Payload payload{};
	payload.mHasNewKeyInput = true;
	payload.mNewKeyScalar = KeyScalar();
	payload.mPolicySet = true;
	payload.mPolicy = policy;
	payload.mBindingCount = 1;
	payload.mBindings[0].mReaderGroupIdentifier = readerGroupId;
	payload.mBindings[0].mTrustType = AliroUd::Credential::TrustType::Direct;
	payload.mBindings[0].mKey = ArbitraryTrustAnchorKey();

	::Aliro::UserDevice::CredentialHandle handle{ ::Aliro::UserDevice::kInvalidCredentialHandle };
	const auto error = AliroUd::Credential::Store::Create(payload, handle);
	zassert_equal(ALIRO_NO_ERROR, error, "Seeding the credential must succeed");
	return handle;
}

const std::vector<uint8_t> kExpeditedPhaseAid{ 0xA0, 0x00, 0x00, 0x09, 0x09, 0xAC, 0xCE, 0x55, 0x01 };

std::vector<uint8_t> SelectCommand()
{
	std::vector<uint8_t> cmd{ 0x00, 0xA4, 0x04, 0x00, static_cast<uint8_t>(kExpeditedPhaseAid.size()) };
	cmd.insert(cmd.end(), kExpeditedPhaseAid.begin(), kExpeditedPhaseAid.end());
	return cmd;
}

void AppendTlv(std::vector<uint8_t> &out, uint8_t tag, const std::vector<uint8_t> &value)
{
	out.push_back(tag);
	out.push_back(static_cast<uint8_t>(value.size()));
	out.insert(out.end(), value.begin(), value.end());
}

std::vector<uint8_t> RepeatedBytes(uint8_t value, size_t count)
{
	return std::vector<uint8_t>(count, value);
}

/**
 * @brief Well-formed AUTH0 command data field (Aliro spec Table 8-4) for
 * `authenticationPolicy`, whose 16-byte reader_group_identifier half of tag
 * 0x4D (`reader_identifier`) is filled with `readerGroupFill`.
 */
std::vector<uint8_t> Auth0Data(uint8_t authenticationPolicy, uint8_t readerGroupFill)
{
	std::vector<uint8_t> data{};
	AppendTlv(data, 0x41, { 0x00 });
	AppendTlv(data, 0x42, { authenticationPolicy });
	AppendTlv(data, 0x5C, { 0x01, 0x00 });
	auto publicKey = RepeatedBytes(0xAA, 65);
	publicKey[0] = 0x04;
	AppendTlv(data, 0x87, publicKey);
	AppendTlv(data, 0x4C, RepeatedBytes(0xBB, 16));
	auto readerIdentifier = RepeatedBytes(readerGroupFill, 16);
	const auto subIdentifier = RepeatedBytes(0xCD, 16);
	readerIdentifier.insert(readerIdentifier.end(), subIdentifier.begin(), subIdentifier.end());
	AppendTlv(data, 0x4D, readerIdentifier);
	return data;
}

std::vector<uint8_t> Auth0Command(uint8_t authenticationPolicy, uint8_t readerGroupFill)
{
	const auto data = Auth0Data(authenticationPolicy, readerGroupFill);
	std::vector<uint8_t> cmd{ 0x80, 0x80, 0x00, 0x00, static_cast<uint8_t>(data.size()) };
	cmd.insert(cmd.end(), data.begin(), data.end());
	return cmd;
}

} // namespace

ZTEST_SUITE(aliro_ud_authorization_e2e, nullptr, SetupSuite, ResetBeforeEachTest, nullptr, nullptr);

/**
 * @brief ALIRO-UD-SYRS-P1-012/020/021: AUTH0 with authentication_policy
 * 0x03 against a matched credential, with no authorization window open,
 * defers exactly one NotifyAuthenticationRequired() call, which turns the
 * visible LED indication on.
 */
ZTEST(aliro_ud_authorization_e2e, test_auth0_policy_0x03_with_no_window_indicates_required)
{
	::Aliro::UserDevice::ReaderGroupIdentifier readerGroupId{};
	readerGroupId.fill(0xAB);
	SeedCredential(::Aliro::UserDevice::AuthenticationPolicy::ForceUserAuthentication, readerGroupId);

	PostFieldOn();
	SettleWorker();
	const auto selectCommand = SelectCommand();
	zassert_equal(0, PostCommandApdu(selectCommand.data(), selectCommand.size()));
	SettleWorker();

	const auto auth0Command = Auth0Command(0x03, 0xAB);
	zassert_equal(0, PostCommandApdu(auth0Command.data(), auth0Command.size()));
	SettleWorker();

	zassert_equal(1u, AliroUd::Authorization::Test::GetSetActiveCallCount(),
		      "Expected exactly one indicator activation for the deferred authentication-required event");
	zassert_true(AliroUd::Authorization::Test::GetLastActive(), "Expected the indicator to be turned on");

	PostFieldOff();
	SettleWorker();
}

/**
 * @brief The same AUTH0 command, after the button opened the authorization
 * window first (`Window::Open()`, standing in for a physical press),
 * proceeds without ever calling NotifyAuthenticationRequired() - the
 * application-owned half of "allow a new transaction to succeed after a
 * button press opens the window" (APP_PLAN.md AWP4).
 */
ZTEST(aliro_ud_authorization_e2e, test_auth0_policy_0x03_with_open_window_does_not_indicate)
{
	::Aliro::UserDevice::ReaderGroupIdentifier readerGroupId{};
	readerGroupId.fill(0xAC);
	SeedCredential(::Aliro::UserDevice::AuthenticationPolicy::ForceUserAuthentication, readerGroupId);

	AliroUd::Authorization::GlobalWindow().Open(k_uptime_get(), 30000);

	PostFieldOn();
	SettleWorker();
	const auto selectCommand = SelectCommand();
	zassert_equal(0, PostCommandApdu(selectCommand.data(), selectCommand.size()));
	SettleWorker();

	const auto auth0Command = Auth0Command(0x03, 0xAC);
	zassert_equal(0, PostCommandApdu(auth0Command.data(), auth0Command.size()));
	SettleWorker();

	zassert_equal(0u, AliroUd::Authorization::Test::GetSetActiveCallCount(),
		      "An open window must not defer/trigger an authentication-required indication");

	PostFieldOff();
	SettleWorker();
}

/**
 * @brief ALIRO-UD-SYRS-P1-031: the AUTH0 response is identical whether or
 * not the authorization window is open - only the deferred
 * NotifyAuthenticationRequired() delivery (asserted above) differs.
 *
 * Aliro 1.0 Specification and Test Plan, 26-42802-001, section 8.3.3.2.6,
 * p. 69 requires a new credential_ePubK in every AUTH0 response, so its
 * 64 coordinate bytes differ between the two transactions regardless of
 * window state. Every other byte - the Table 8-5 (p. 67) 0x86 TLV header,
 * the uncompressed-point prefix, and the status word - must be identical.
 */
ZTEST(aliro_ud_authorization_e2e, test_auth0_response_is_independent_of_window_state)
{
	::Aliro::UserDevice::ReaderGroupIdentifier readerGroupId{};
	readerGroupId.fill(0xAD);
	SeedCredential(::Aliro::UserDevice::AuthenticationPolicy::ForceUserAuthentication, readerGroupId);

	PostFieldOn();
	SettleWorker();
	auto selectCommand = SelectCommand();
	zassert_equal(0, PostCommandApdu(selectCommand.data(), selectCommand.size()));
	SettleWorker();

	auto auth0Command = Auth0Command(0x03, 0xAD);
	zassert_equal(0, PostCommandApdu(auth0Command.data(), auth0Command.size()));
	SettleWorker();
	const auto responseWithoutWindow = AliroUdTest::FakeNfc::GetLastResponse();

	PostFieldOff();
	SettleWorker();

	AliroUd::Authorization::GlobalWindow().Open(k_uptime_get(), 30000);

	PostFieldOn();
	SettleWorker();
	selectCommand = SelectCommand();
	zassert_equal(0, PostCommandApdu(selectCommand.data(), selectCommand.size()));
	SettleWorker();

	auth0Command = Auth0Command(0x03, 0xAD);
	zassert_equal(0, PostCommandApdu(auth0Command.data(), auth0Command.size()));
	SettleWorker();
	const auto responseWithWindow = AliroUdTest::FakeNfc::GetLastResponse();

	/* 0x86 0x41 0x04 || x || y || SW1 SW2 */
	constexpr size_t kCoordinatesOffset{ 3 };
	constexpr size_t kCoordinatesLength{ 64 };
	constexpr size_t kResponseLength{ kCoordinatesOffset + kCoordinatesLength + 2 };

	zassert_equal(kResponseLength, responseWithoutWindow.size(), "Unexpected AUTH0 response length");
	zassert_equal(responseWithoutWindow.size(), responseWithWindow.size(),
		      "AUTH0 response length must not depend on window state");
	zassert_mem_equal(responseWithoutWindow.data(), responseWithWindow.data(), kCoordinatesOffset,
			  "AUTH0 response framing must not depend on window state");
	zassert_mem_equal(responseWithoutWindow.data() + kCoordinatesOffset + kCoordinatesLength,
			  responseWithWindow.data() + kCoordinatesOffset + kCoordinatesLength, 2,
			  "AUTH0 status word must not depend on window state");
	zassert_equal(0x90, responseWithWindow[kResponseLength - 2], "AUTH0 must succeed");
	zassert_equal(0x00, responseWithWindow[kResponseLength - 1], "AUTH0 must succeed");

	PostFieldOff();
	SettleWorker();
}
```

## src/test_authorization_window.cpp
```c
/*
 * Copyright (c) 2026 Nordic Semiconductor ASA
 *
 * SPDX-License-Identifier: LicenseRef-Nordic-5-Clause
 */

#include <zephyr/ztest.h>

#include "platform/authorization/authorization_window.h"

/*
 * Pure logic tests for AliroUd::Authorization::Window (APP_PLAN.md AWP4).
 * Every timestamp is an explicit constant passed to the API under test, so
 * this exercises the "fake monotonic clock" Verify requirement without any
 * dependency on wall-clock/k_uptime_get() timing.
 */

using AliroUd::Authorization::Window;
using AuthorizationState = ::Aliro::UserDevice::AuthorizationState;

ZTEST_SUITE(aliro_ud_authorization_window, nullptr, nullptr, nullptr, nullptr, nullptr);

/** @brief ALIRO-UD-SYRS-P1-012: a window that was never opened reports Required, not Authorized or Denied. */
ZTEST(aliro_ud_authorization_window, test_never_opened_reports_required)
{
	Window window{};

	zassert_equal(static_cast<int>(AuthorizationState::Required), static_cast<int>(window.GetState(0)),
		      "Fresh window must fail closed (Required)");
	zassert_false(window.IsValid(0), "Fresh window must not be valid");
	zassert_equal(0, window.GetRemainingMs(0), "Fresh window must report zero remaining time");
}

/** @brief ALIRO-UD-SYRS-P1-011: a button press (Open()) makes a later GetState() query report Authorized. */
ZTEST(aliro_ud_authorization_window, test_preauthorization_before_transaction)
{
	Window window{};

	window.Open(0, 30000);

	zassert_equal(static_cast<int>(AuthorizationState::Authorized), static_cast<int>(window.GetState(5000)),
		      "A transaction well inside the window must see Authorized");
}

/** @brief The window is valid strictly before its deadline and expires exactly at it. */
ZTEST(aliro_ud_authorization_window, test_window_expires_at_deadline)
{
	Window window{};

	window.Open(0, 1000);

	zassert_true(window.IsValid(999), "Window must still be valid 1 ms before the deadline");
	zassert_false(window.IsValid(1000), "Window must be expired exactly at the deadline");
	zassert_equal(static_cast<int>(AuthorizationState::Required), static_cast<int>(window.GetState(1000)),
		      "Expired window must report Required");
}

/** @brief 1-second boundary (Kconfig minimum ALIRO_UD_AUTHORIZATION_WINDOW_SECONDS). */
ZTEST(aliro_ud_authorization_window, test_one_second_boundary)
{
	Window window{};

	window.Open(1000, 1000);

	zassert_true(window.IsValid(1999), "1 s window must still be valid 1 ms before its deadline");
	zassert_false(window.IsValid(2000), "1 s window must be expired exactly at its deadline");
}

/** @brief 300-second boundary (Kconfig maximum ALIRO_UD_AUTHORIZATION_WINDOW_SECONDS). */
ZTEST(aliro_ud_authorization_window, test_three_hundred_second_boundary)
{
	Window window{};

	window.Open(0, 300000);

	zassert_true(window.IsValid(299999), "300 s window must still be valid 1 ms before its deadline");
	zassert_false(window.IsValid(300000), "300 s window must be expired exactly at its deadline");
}

/** @brief A repeated press before expiry restarts (extends) the window rather than being ignored. */
ZTEST(aliro_ud_authorization_window, test_repeated_press_extends_window)
{
	Window window{};

	window.Open(0, 1000);
	zassert_true(window.IsValid(900), "Window must be valid before the repeated press");

	window.Open(900, 1000);

	zassert_true(window.IsValid(1500), "Repeated press must extend validity past the original deadline");
	zassert_false(window.IsValid(1900), "Extended window must still expire at its own new deadline");
}

/** @brief A repeated press after the window already expired (retry) opens a fresh window. */
ZTEST(aliro_ud_authorization_window, test_retry_after_expiry_reopens_window)
{
	Window window{};

	window.Open(0, 1000);
	zassert_false(window.IsValid(2000), "Window must have expired by t=2000");

	window.Open(2000, 1000);

	zassert_true(window.IsValid(2999), "Retried press must open a fresh, valid window");
	zassert_false(window.IsValid(3000), "Retried window must still expire at its own deadline");
}

/** @brief Close() immediately revokes an open window, independent of `nowMs` (explicit denial/reset). */
ZTEST(aliro_ud_authorization_window, test_close_immediately_revokes)
{
	Window window{};

	window.Open(0, 30000);
	zassert_true(window.IsValid(0), "Window must be valid immediately after opening");

	window.Close();

	zassert_false(window.IsValid(0), "Window must be revoked immediately after Close()");
	zassert_equal(static_cast<int>(AuthorizationState::Required), static_cast<int>(window.GetState(0)),
		      "Closed window must report Required");
}

/** @brief GetRemainingMs() reports a decreasing, never-negative countdown and 0 once expired. */
ZTEST(aliro_ud_authorization_window, test_get_remaining_ms)
{
	Window window{};

	window.Open(0, 1000);

	zassert_equal(1000, window.GetRemainingMs(0), "Remaining time must equal the full duration at open");
	zassert_equal(400, window.GetRemainingMs(600), "Remaining time must count down");
	zassert_equal(0, window.GetRemainingMs(1000), "Remaining time must be 0 at the deadline");
	zassert_equal(0, window.GetRemainingMs(5000), "Remaining time must be 0, never negative, after expiry");
}

/** @brief GlobalWindow() always returns the same shared instance. */
ZTEST(aliro_ud_authorization_window, test_global_window_is_a_singleton)
{
	zassert_equal(&AliroUd::Authorization::GlobalWindow(), &AliroUd::Authorization::GlobalWindow(),
		      "GlobalWindow() must return the same instance every time");
}
```

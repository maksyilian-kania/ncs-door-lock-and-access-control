## CMakeLists.txt
```
#
# Copyright (c) 2026 Nordic Semiconductor ASA
#
# SPDX-License-Identifier: LicenseRef-Nordic-5-Clause
#

cmake_minimum_required(VERSION 3.20.0)

find_package(Zephyr REQUIRED HINTS $ENV{ZEPHYR_BASE})

project(aliro_nfc_user_device_mailbox)

set(ALIRO_UD_APP_SRC_DIR ${CMAKE_CURRENT_SOURCE_DIR}/../../../../../applications/aliro-nfc-user-device/src)
set(ALIRO_UD_TEST_COMMON_DIR ${CMAKE_CURRENT_SOURCE_DIR}/../common)

target_include_directories(app PRIVATE ${ALIRO_UD_APP_SRC_DIR} ${ALIRO_UD_TEST_COMMON_DIR})

# Aliro::Interface::UserDevice::Mailbox implementation under test
# (APP_PLAN.md AWP6): the real mailbox.cpp/mailbox_sessions.cpp/
# mailbox_store.cpp engine, plus the real AWP3 credential store (mailbox
# configuration lives there) with host-test fakes standing in for the
# hardware-backed credential/mailbox persistence and key backends, exactly
# as the other functional tests.
target_sources(app PRIVATE
  ${ALIRO_UD_APP_SRC_DIR}/storage/mailbox/mailbox.cpp
  ${ALIRO_UD_APP_SRC_DIR}/storage/mailbox/mailbox_sessions.cpp
  ${ALIRO_UD_APP_SRC_DIR}/storage/mailbox/mailbox_store.cpp
  ${ALIRO_UD_TEST_COMMON_DIR}/fake_mailbox_persistence.cpp
  ${ALIRO_UD_APP_SRC_DIR}/storage/credential/credential_store.cpp
  ${ALIRO_UD_TEST_COMMON_DIR}/fake_credential_persistence.cpp
  ${ALIRO_UD_TEST_COMMON_DIR}/fake_key_backend.cpp
  # credential_store.cpp cascades credential deletion to the Kpersistent
  # record store, whose key backend fake resolves keys through crypto.cpp.
  ${ALIRO_UD_APP_SRC_DIR}/storage/key/persistent_key_store.cpp
  ${ALIRO_UD_TEST_COMMON_DIR}/fake_persistent_key_persistence.cpp
  ${ALIRO_UD_TEST_COMMON_DIR}/fake_persistent_key_backend.cpp
  ${ALIRO_UD_APP_SRC_DIR}/platform/crypto/crypto.cpp
  ${ALIRO_UD_APP_SRC_DIR}/platform/crypto/certificate.cpp
  src/test_mailbox_store.cpp
  src/test_mailbox_sessions.cpp
  src/test_mailbox_fault_injection.cpp
)
```

## Kconfig
```
#
# Copyright (c) 2026 Nordic Semiconductor ASA
#
# SPDX-License-Identifier: LicenseRef-Nordic-5-Clause
#

mainmenu "Aliro NFC User Device - Mailbox Test"

# Pulls in CONFIG_ALIRO_UD_MAILBOX_* for mailbox_store.cpp/mailbox_sessions.cpp
# under test, plus CONFIG_ALIRO_UD_CREDENTIAL_* for the real
# credential_store.cpp engine this test links against (mailbox configuration
# lives in the credential record; see CMakeLists.txt).
rsource "../../../../../applications/aliro-nfc-user-device/src/storage/mailbox/Kconfig"
rsource "../../../../../applications/aliro-nfc-user-device/src/storage/credential/Kconfig"
# The PersistentKey store and crypto.cpp sources this test builds (see
# CMakeLists.txt) reference their own Kconfig options.
rsource "../../../../../applications/aliro-nfc-user-device/src/storage/key/Kconfig"
rsource "../../../../../applications/aliro-nfc-user-device/src/platform/crypto/Kconfig"

source "Kconfig.zephyr"
```

## prj.conf
```kconfig
#
# Copyright (c) 2026 Nordic Semiconductor ASA
#
# SPDX-License-Identifier: LicenseRef-Nordic-5-Clause
#

# Aliro::Interface::UserDevice::Mailbox implementation under test needs the
# "aliro/..." headers and CryptoTypes definitions (APP_PLAN.md AWP6); the
# real Aliro::UserDeviceStack protocol code itself is not linked or
# exercised here (nothing in the checked-out ncs-aliro baseline calls the
# Mailbox contract yet; see docs/evidence.md).
CONFIG_NCS_ALIRO_USER_DEVICE=y

CONFIG_CPP=y
CONFIG_STD_CPP17=y
CONFIG_REQUIRES_FULL_LIBCPP=y

CONFIG_ZTEST=y
CONFIG_ZTEST_STACK_SIZE=16384
CONFIG_MAIN_STACK_SIZE=8192

CONFIG_LOG=y

CONFIG_PSA_CRYPTO=y
```

## src/test_mailbox_fault_injection.cpp
```c
/*
 * Copyright (c) 2026 Nordic Semiconductor ASA
 *
 * SPDX-License-Identifier: LicenseRef-Nordic-5-Clause
 */

#include <zephyr/ztest.h>

#include "fake_credential_persistence.h"
#include "fake_key_backend.h"
#include "fake_mailbox_persistence.h"
#include "storage/credential/credential_store.h"
#include "storage/mailbox/mailbox_sessions.h"
#include "storage/mailbox/mailbox_store.h"

#include <array>

/*
 * Injected-failure coverage for AliroUd::Mailbox::Store/Sessions
 * (APP_PLAN.md AWP6: "Test recovery from reset/power-loss injection at
 * each mailbox commit transition"): a persistence failure at the single
 * atomic write each mutating operation performs must leave the previously
 * committed record completely unchanged, and a subsequent "reboot"
 * (re-running Store::Init()) must recover the last successfully committed
 * state, not a partially-applied one.
 */

using namespace Aliro;
using namespace Aliro::UserDevice;

namespace {

void ResetBeforeEachTest(void *fixture)
{
	(void)fixture;

	AliroUd::Credential::Test::ResetFakePersistence();
	AliroUd::Credential::Test::ResetFakeKeyBackend();
	AliroUd::Mailbox::Test::ResetFakeMailboxPersistence();

	zassert_equal(ALIRO_NO_ERROR, AliroUd::Credential::Store::Init(), "Credential store init must succeed");
	zassert_equal(ALIRO_NO_ERROR, AliroUd::Mailbox::Store::Init(), "Mailbox store init must succeed");
}

CredentialHandle SeedCredentialWithMailbox(uint32_t sizeBytes)
{
	ReaderGroupIdentifier readerGroupId{};
	readerGroupId.fill(0x11);

	CryptoTypes::PublicKey trustAnchor{};
	trustAnchor[0] = 0x04;

	AliroUd::Credential::Provisioning::Payload payload{};
	payload.mHasNewKeyInput = true;
	payload.mNewKeyScalar = { 0x23, 0x23, 0x10, 0x22, 0xa3, 0x66, 0x2c, 0xeb, 0x6f, 0x2e, 0x6a, 0x4e,
				  0x99, 0x88, 0x66, 0xae, 0x88, 0xd6, 0xe9, 0xda, 0x1c, 0x72, 0xb0, 0x50,
				  0xae, 0x5c, 0x20, 0x6a, 0x1d, 0xa4, 0x67, 0x12 };
	payload.mPolicySet = true;
	payload.mBindingCount = 1;
	payload.mBindings[0].mReaderGroupIdentifier = readerGroupId;
	payload.mBindings[0].mTrustType = AliroUd::Credential::TrustType::Direct;
	payload.mBindings[0].mKey = trustAnchor;
	payload.mMailbox.mConfigured = true;
	payload.mMailbox.mSizeBytes = sizeBytes;
	payload.mMailbox.mReadable = true;
	payload.mMailbox.mWritable = true;

	CredentialHandle handle{ kInvalidCredentialHandle };
	const auto error = AliroUd::Credential::Store::Create(payload, handle);
	zassert_equal(ALIRO_NO_ERROR, error, "Seeding the credential with a mailbox must succeed");
	return handle;
}

::Aliro::UserDevice::MailboxHandle MailboxHandleOf(CredentialHandle credentialHandle)
{
	return AliroUd::Mailbox::Store::HandleForCredential(credentialHandle);
}

} // namespace

ZTEST_SUITE(aliro_ud_mailbox_fault_injection, nullptr, nullptr, ResetBeforeEachTest, nullptr, nullptr);

ZTEST(aliro_ud_mailbox_fault_injection, test_initialize_failure_leaves_uninitialized_state)
{
	const auto handle = SeedCredentialWithMailbox(8);

	AliroUd::Mailbox::Test::ArmMailboxFault(AliroUd::Mailbox::Test::FaultPoint::SaveSlot);
	zassert_not_equal(ALIRO_NO_ERROR, AliroUd::Mailbox::Store::Initialize(handle));
	zassert_false(AliroUd::Mailbox::Store::IsInitialized(handle));

	/* Retrying without the fault armed must succeed (no orphaned/half-applied state blocks recovery). */
	zassert_equal(ALIRO_NO_ERROR, AliroUd::Mailbox::Store::Initialize(handle));
	zassert_true(AliroUd::Mailbox::Store::IsInitialized(handle));
}

ZTEST(aliro_ud_mailbox_fault_injection, test_commit_failure_leaves_committed_bytes_unchanged)
{
	const auto handle = SeedCredentialWithMailbox(8);

	AliroUd::Mailbox::Sessions::SessionHandle session{};
	zassert_equal(ALIRO_NO_ERROR, AliroUd::Mailbox::Sessions::OpenSnapshot(MailboxHandleOf(handle), session));

	const std::array<uint8_t, 4> first{ 0x11, 0x22, 0x33, 0x44 };
	zassert_equal(ALIRO_NO_ERROR, AliroUd::Mailbox::Sessions::StageWrite(session, 0, first.data(), first.size()));
	zassert_equal(ALIRO_NO_ERROR, AliroUd::Mailbox::Sessions::Commit(session));

	/* Stage a second write, then fail its Commit(): the first commit's bytes must survive untouched. */
	const std::array<uint8_t, 4> second{ 0xAA, 0xBB, 0xCC, 0xDD };
	zassert_equal(ALIRO_NO_ERROR, AliroUd::Mailbox::Sessions::StageWrite(session, 0, second.data(), second.size()));

	AliroUd::Mailbox::Test::ArmMailboxFault(AliroUd::Mailbox::Test::FaultPoint::SaveSlot);
	zassert_not_equal(ALIRO_NO_ERROR, AliroUd::Mailbox::Sessions::Commit(session));

	std::array<uint8_t, 4> readBack{};
	zassert_equal(ALIRO_NO_ERROR, AliroUd::Mailbox::Sessions::Read(session, 0, readBack.data(), readBack.size()));
	zassert_true(readBack == first, "a failed Commit() must leave the previously committed bytes unchanged");

	/* The failed commit's staged data is preserved (not discarded) so the caller can retry. */
	zassert_equal(ALIRO_NO_ERROR, AliroUd::Mailbox::Sessions::Commit(session));
	zassert_equal(ALIRO_NO_ERROR, AliroUd::Mailbox::Sessions::Read(session, 0, readBack.data(), readBack.size()));
	zassert_true(readBack == second, "retrying Commit() without the fault armed must succeed");

	AliroUd::Mailbox::Sessions::Close(session);
}

ZTEST(aliro_ud_mailbox_fault_injection, test_reboot_after_commit_failure_recovers_last_committed_state)
{
	const auto handle = SeedCredentialWithMailbox(8);

	AliroUd::Mailbox::Sessions::SessionHandle session{};
	zassert_equal(ALIRO_NO_ERROR, AliroUd::Mailbox::Sessions::OpenSnapshot(MailboxHandleOf(handle), session));

	const std::array<uint8_t, 4> committed{ 0x01, 0x02, 0x03, 0x04 };
	zassert_equal(ALIRO_NO_ERROR,
		     AliroUd::Mailbox::Sessions::StageWrite(session, 0, committed.data(), committed.size()));
	zassert_equal(ALIRO_NO_ERROR, AliroUd::Mailbox::Sessions::Commit(session));

	const std::array<uint8_t, 4> lost{ 0xFF, 0xFF, 0xFF, 0xFF };
	zassert_equal(ALIRO_NO_ERROR, AliroUd::Mailbox::Sessions::StageWrite(session, 0, lost.data(), lost.size()));

	AliroUd::Mailbox::Test::ArmMailboxFault(AliroUd::Mailbox::Test::FaultPoint::SaveSlot);
	zassert_not_equal(ALIRO_NO_ERROR, AliroUd::Mailbox::Sessions::Commit(session));
	AliroUd::Mailbox::Sessions::Close(session);

	/* Simulate power loss right after the failed commit, then reboot. */
	zassert_equal(ALIRO_NO_ERROR, AliroUd::Mailbox::Store::Init());

	std::array<uint8_t, 4> readBack{};
	zassert_equal(ALIRO_NO_ERROR, AliroUd::Mailbox::Store::RawRead(handle, 0, readBack.data(), readBack.size()));
	zassert_true(readBack == committed, "a reboot after a failed commit must recover the last committed bytes");
}

ZTEST(aliro_ud_mailbox_fault_injection, test_erase_failure_leaves_slot_initialized)
{
	const auto handle = SeedCredentialWithMailbox(8);
	zassert_equal(ALIRO_NO_ERROR, AliroUd::Mailbox::Store::Initialize(handle));

	AliroUd::Mailbox::Test::ArmMailboxFault(AliroUd::Mailbox::Test::FaultPoint::EraseSlot);
	zassert_not_equal(ALIRO_NO_ERROR, AliroUd::Mailbox::Store::EraseForCredential(handle));
	zassert_true(AliroUd::Mailbox::Store::IsInitialized(handle),
		     "a failed erase must not leave the in-memory state ahead of persisted state");

	/* Retrying without the fault armed must succeed. */
	zassert_equal(ALIRO_NO_ERROR, AliroUd::Mailbox::Store::EraseForCredential(handle));
	zassert_false(AliroUd::Mailbox::Store::IsInitialized(handle));
}
```

## src/test_mailbox_sessions.cpp
```c
/*
 * Copyright (c) 2026 Nordic Semiconductor ASA
 *
 * SPDX-License-Identifier: LicenseRef-Nordic-5-Clause
 */

#include <zephyr/ztest.h>

#include "fake_credential_persistence.h"
#include "fake_key_backend.h"
#include "fake_mailbox_persistence.h"
#include "storage/credential/credential_store.h"
#include "storage/mailbox/mailbox_sessions.h"
#include "storage/mailbox/mailbox_store.h"

#include <aliro/user_device/interface.h>

#include <array>

/*
 * AliroUd::Mailbox::Sessions under test (APP_PLAN.md AWP6): the
 * Reader-facing OpenSnapshot/Read/StageWrite/StageSet/Commit/Rollback/Close
 * contract, exercised both directly (AliroUd::Mailbox::Sessions::*) and
 * through the real Aliro::Interface::UserDevice::Mailbox adapter
 * (mailbox.cpp) to prove the thin-adapter forwarding is exact — same split
 * as test_authorization_contract.cpp over authorization.cpp.
 */

using namespace Aliro;
using namespace Aliro::UserDevice;

namespace {

void ResetBeforeEachTest(void *fixture)
{
	(void)fixture;

	AliroUd::Credential::Test::ResetFakePersistence();
	AliroUd::Credential::Test::ResetFakeKeyBackend();
	AliroUd::Mailbox::Test::ResetFakeMailboxPersistence();

	zassert_equal(ALIRO_NO_ERROR, AliroUd::Credential::Store::Init(), "Credential store init must succeed");
	zassert_equal(ALIRO_NO_ERROR, AliroUd::Mailbox::Store::Init(), "Mailbox store init must succeed");
}

std::array<uint8_t, 32> KeyScalar(uint8_t seed)
{
	std::array<uint8_t, 32> scalar{ 0x23, 0x23, 0x10, 0x22, 0xa3, 0x66, 0x2c, 0xeb, 0x6f, 0x2e,
					 0x6a, 0x4e, 0x99, 0x88, 0x66, 0xae, 0x88, 0xd6, 0xe9, 0xda,
					 0x1c, 0x72, 0xb0, 0x50, 0xae, 0x5c, 0x20, 0x6a, 0x1d, 0xa4,
					 0x67, seed };
	return scalar;
}

/* WP7 stack impact (see docs/wp7_stack_impact.md): the removed-upstream settable-in-AUTH1 parameter was dropped here too. */
CredentialHandle SeedCredentialWithMailbox(uint32_t sizeBytes, bool readable, bool writable, uint8_t keySeed = 0x12)
{
	ReaderGroupIdentifier readerGroupId{};
	readerGroupId.fill(0x11);

	CryptoTypes::PublicKey trustAnchor{};
	trustAnchor[0] = 0x04;

	AliroUd::Credential::Provisioning::Payload payload{};
	payload.mHasNewKeyInput = true;
	payload.mNewKeyScalar = KeyScalar(keySeed);
	payload.mPolicySet = true;
	payload.mPolicy = AuthenticationPolicy::UserDeviceSetting;
	payload.mBindingCount = 1;
	payload.mBindings[0].mReaderGroupIdentifier = readerGroupId;
	payload.mBindings[0].mTrustType = AliroUd::Credential::TrustType::Direct;
	payload.mBindings[0].mKey = trustAnchor;
	payload.mMailbox.mConfigured = true;
	payload.mMailbox.mSizeBytes = sizeBytes;
	payload.mMailbox.mReadable = readable;
	payload.mMailbox.mWritable = writable;

	CredentialHandle handle{ kInvalidCredentialHandle };
	const auto error = AliroUd::Credential::Store::Create(payload, handle);
	zassert_equal(ALIRO_NO_ERROR, error, "Seeding the credential with a mailbox must succeed");
	return handle;
}

::Aliro::UserDevice::MailboxHandle MailboxHandleOf(CredentialHandle credentialHandle)
{
	return AliroUd::Mailbox::Store::HandleForCredential(credentialHandle);
}

} // namespace

ZTEST_SUITE(aliro_ud_mailbox_sessions, nullptr, nullptr, ResetBeforeEachTest, nullptr, nullptr);

ZTEST(aliro_ud_mailbox_sessions, test_open_snapshot_rejects_credential_without_configured_mailbox)
{
	AliroUd::Mailbox::Sessions::SessionHandle session{};
	const auto error = AliroUd::Mailbox::Sessions::OpenSnapshot(MailboxHandleOf(kInvalidCredentialHandle), session);
	zassert_not_equal(ALIRO_NO_ERROR, error);
	zassert_equal(AliroUd::Mailbox::Sessions::kInvalidSessionHandle, session);
}

ZTEST(aliro_ud_mailbox_sessions, test_open_snapshot_lazily_initializes_committed_storage)
{
	const auto handle = SeedCredentialWithMailbox(8, true, true);
	zassert_false(AliroUd::Mailbox::Store::IsInitialized(handle));

	AliroUd::Mailbox::Sessions::SessionHandle session{};
	zassert_equal(ALIRO_NO_ERROR, AliroUd::Mailbox::Sessions::OpenSnapshot(MailboxHandleOf(handle), session));
	zassert_not_equal(AliroUd::Mailbox::Sessions::kInvalidSessionHandle, session);
	zassert_true(AliroUd::Mailbox::Store::IsInitialized(handle));

	AliroUd::Mailbox::Sessions::Close(session);
}

ZTEST(aliro_ud_mailbox_sessions, test_read_isolated_from_staged_writes_until_commit)
{
	const auto handle = SeedCredentialWithMailbox(8, /*readable=*/true, /*writable=*/true);

	AliroUd::Mailbox::Sessions::SessionHandle session{};
	zassert_equal(ALIRO_NO_ERROR, AliroUd::Mailbox::Sessions::OpenSnapshot(MailboxHandleOf(handle), session));

	const std::array<uint8_t, 3> written{ 0x11, 0x22, 0x33 };
	zassert_equal(ALIRO_NO_ERROR, AliroUd::Mailbox::Sessions::StageWrite(session, 0, written.data(), written.size()));

	std::array<uint8_t, 3> readBack{ 0xAA, 0xAA, 0xAA };
	zassert_equal(ALIRO_NO_ERROR, AliroUd::Mailbox::Sessions::Read(session, 0, readBack.data(), readBack.size()));
	for (uint8_t byte : readBack) {
		zassert_equal(0x00, byte, "Read() must observe only committed bytes before Commit()");
	}

	zassert_equal(ALIRO_NO_ERROR, AliroUd::Mailbox::Sessions::Commit(session));
	zassert_equal(ALIRO_NO_ERROR, AliroUd::Mailbox::Sessions::Read(session, 0, readBack.data(), readBack.size()));
	zassert_true(readBack == written, "Read() must observe the committed bytes after Commit()");

	AliroUd::Mailbox::Sessions::Close(session);
}

ZTEST(aliro_ud_mailbox_sessions, test_rollback_and_close_leave_committed_bytes_unchanged)
{
	const auto handle = SeedCredentialWithMailbox(8, true, true);

	AliroUd::Mailbox::Sessions::SessionHandle session{};
	zassert_equal(ALIRO_NO_ERROR, AliroUd::Mailbox::Sessions::OpenSnapshot(MailboxHandleOf(handle), session));

	const std::array<uint8_t, 3> committed{ 0x01, 0x02, 0x03 };
	zassert_equal(ALIRO_NO_ERROR,
		     AliroUd::Mailbox::Sessions::StageWrite(session, 0, committed.data(), committed.size()));
	zassert_equal(ALIRO_NO_ERROR, AliroUd::Mailbox::Sessions::Commit(session));

	const std::array<uint8_t, 3> attempted{ 0xFF, 0xFF, 0xFF };
	zassert_equal(ALIRO_NO_ERROR,
		     AliroUd::Mailbox::Sessions::StageWrite(session, 0, attempted.data(), attempted.size()));
	zassert_equal(ALIRO_NO_ERROR, AliroUd::Mailbox::Sessions::Rollback(session));

	std::array<uint8_t, 3> readBack{};
	zassert_equal(ALIRO_NO_ERROR, AliroUd::Mailbox::Sessions::Read(session, 0, readBack.data(), readBack.size()));
	zassert_true(readBack == committed, "Rollback() must discard staged data without touching committed bytes");

	/* A second, independent session must also observe only the previously committed bytes after Close(). */
	AliroUd::Mailbox::Sessions::Close(session);

	AliroUd::Mailbox::Sessions::SessionHandle session2{};
	zassert_equal(ALIRO_NO_ERROR, AliroUd::Mailbox::Sessions::OpenSnapshot(MailboxHandleOf(handle), session2));
	zassert_equal(ALIRO_NO_ERROR,
		     AliroUd::Mailbox::Sessions::StageWrite(session2, 0, attempted.data(), attempted.size()));
	AliroUd::Mailbox::Sessions::Close(session2); /* Close() without Commit() must also leave committed data unchanged. */

	AliroUd::Mailbox::Sessions::SessionHandle session3{};
	zassert_equal(ALIRO_NO_ERROR, AliroUd::Mailbox::Sessions::OpenSnapshot(MailboxHandleOf(handle), session3));
	zassert_equal(ALIRO_NO_ERROR, AliroUd::Mailbox::Sessions::Read(session3, 0, readBack.data(), readBack.size()));
	zassert_true(readBack == committed, "Close() without Commit() must leave committed bytes unchanged");
	AliroUd::Mailbox::Sessions::Close(session3);
}

ZTEST(aliro_ud_mailbox_sessions, test_read_rejected_when_not_readable)
{
	const auto handle = SeedCredentialWithMailbox(8, /*readable=*/false, /*writable=*/true);

	AliroUd::Mailbox::Sessions::SessionHandle session{};
	zassert_equal(ALIRO_NO_ERROR, AliroUd::Mailbox::Sessions::OpenSnapshot(MailboxHandleOf(handle), session));

	uint8_t byte{};
	zassert_not_equal(ALIRO_NO_ERROR, AliroUd::Mailbox::Sessions::Read(session, 0, &byte, 1));

	AliroUd::Mailbox::Sessions::Close(session);
}

ZTEST(aliro_ud_mailbox_sessions, test_stage_write_rejected_when_not_writable)
{
	const auto handle = SeedCredentialWithMailbox(8, /*readable=*/true, /*writable=*/false);

	AliroUd::Mailbox::Sessions::SessionHandle session{};
	zassert_equal(ALIRO_NO_ERROR, AliroUd::Mailbox::Sessions::OpenSnapshot(MailboxHandleOf(handle), session));

	uint8_t byte{ 0x01 };
	zassert_not_equal(ALIRO_NO_ERROR, AliroUd::Mailbox::Sessions::StageWrite(session, 0, &byte, 1));

	AliroUd::Mailbox::Sessions::Close(session);
}

ZTEST(aliro_ud_mailbox_sessions, test_stage_write_rejects_out_of_bounds_and_overflowing_ranges)
{
	const auto handle = SeedCredentialWithMailbox(8, true, true);

	AliroUd::Mailbox::Sessions::SessionHandle session{};
	zassert_equal(ALIRO_NO_ERROR, AliroUd::Mailbox::Sessions::OpenSnapshot(MailboxHandleOf(handle), session));

	std::array<uint8_t, 4> data{};
	zassert_equal(ALIRO_NO_ERROR, AliroUd::Mailbox::Sessions::StageWrite(session, 4, data.data(), 4));
	zassert_equal(ALIRO_INVALID_ARGUMENT, AliroUd::Mailbox::Sessions::StageWrite(session, 5, data.data(), 4));
	zassert_equal(ALIRO_INVALID_ARGUMENT, AliroUd::Mailbox::Sessions::StageWrite(session, 8, data.data(), 1));
	zassert_equal(ALIRO_INVALID_ARGUMENT,
		     AliroUd::Mailbox::Sessions::StageWrite(session, SIZE_MAX - 2, data.data(), 4));

	AliroUd::Mailbox::Sessions::Close(session);
}

/*
 * WP7 stack impact (see docs/wp7_stack_impact.md), amendment A1 (breaking
 * change): StageSet() now fills [offset, offset + length) with a single
 * repeated byte (Table 8-16 0x95 set request), not a full-mailbox buffer.
 */
ZTEST(aliro_ud_mailbox_sessions, test_stage_set_fills_range_with_repeated_byte)
{
	const auto handle = SeedCredentialWithMailbox(4, true, true);

	AliroUd::Mailbox::Sessions::SessionHandle session{};
	zassert_equal(ALIRO_NO_ERROR, AliroUd::Mailbox::Sessions::OpenSnapshot(MailboxHandleOf(handle), session));

	/* Out-of-bounds and overflowing ranges are rejected, mirroring StageWrite()'s bounds checks. */
	zassert_equal(ALIRO_INVALID_ARGUMENT, AliroUd::Mailbox::Sessions::StageSet(session, 3, 2, 0x7));
	zassert_equal(ALIRO_INVALID_ARGUMENT, AliroUd::Mailbox::Sessions::StageSet(session, 4, 1, 0x7));
	zassert_equal(ALIRO_INVALID_ARGUMENT, AliroUd::Mailbox::Sessions::StageSet(session, SIZE_MAX - 1, 4, 0x7));

	/* A partial-range fill leaves the rest of the mailbox untouched. */
	zassert_equal(ALIRO_NO_ERROR, AliroUd::Mailbox::Sessions::StageSet(session, 1, 2, 0x7));
	zassert_equal(ALIRO_NO_ERROR, AliroUd::Mailbox::Sessions::Commit(session));

	std::array<uint8_t, 4> readBack{};
	zassert_equal(ALIRO_NO_ERROR, AliroUd::Mailbox::Sessions::Read(session, 0, readBack.data(), readBack.size()));
	const std::array<uint8_t, 4> expected{ 0x00, 0x7, 0x7, 0x00 };
	zassert_true(readBack == expected);

	AliroUd::Mailbox::Sessions::Close(session);
}

/*
 * WP7 stack impact (see docs/wp7_stack_impact.md), amendment A6 (breaking
 * behavior change): a conforming backend supports at most one open
 * snapshot per mailbox. This replaces the pre-WP7 "multiple sessions stage
 * independently" test, which relied on opening two concurrent sessions
 * against the *same* mailbox handle - now explicitly rejected.
 */
ZTEST(aliro_ud_mailbox_sessions, test_second_open_snapshot_on_same_mailbox_is_rejected)
{
	const auto handle = SeedCredentialWithMailbox(4, true, true);

	AliroUd::Mailbox::Sessions::SessionHandle sessionA{};
	zassert_equal(ALIRO_NO_ERROR, AliroUd::Mailbox::Sessions::OpenSnapshot(MailboxHandleOf(handle), sessionA));

	AliroUd::Mailbox::Sessions::SessionHandle sessionB{};
	zassert_equal(ALIRO_INVALID_STATE, AliroUd::Mailbox::Sessions::OpenSnapshot(MailboxHandleOf(handle), sessionB),
		     "a second concurrent snapshot on the same mailbox must be rejected (amendment A6)");
	zassert_equal(AliroUd::Mailbox::Sessions::kInvalidSessionHandle, sessionB);

	/* Closing the first session frees the mailbox for a new snapshot. */
	AliroUd::Mailbox::Sessions::Close(sessionA);
	zassert_equal(ALIRO_NO_ERROR, AliroUd::Mailbox::Sessions::OpenSnapshot(MailboxHandleOf(handle), sessionB));
	AliroUd::Mailbox::Sessions::Close(sessionB);
}

/* Two different mailboxes may each have their own concurrently open session. */
ZTEST(aliro_ud_mailbox_sessions, test_sessions_on_different_mailboxes_stage_independently)
{
	const auto handleA = SeedCredentialWithMailbox(4, true, true, /*keySeed=*/0x01);
	const auto handleB = SeedCredentialWithMailbox(4, true, true, /*keySeed=*/0x02);

	AliroUd::Mailbox::Sessions::SessionHandle sessionA{};
	AliroUd::Mailbox::Sessions::SessionHandle sessionB{};
	zassert_equal(ALIRO_NO_ERROR, AliroUd::Mailbox::Sessions::OpenSnapshot(MailboxHandleOf(handleA), sessionA));
	zassert_equal(ALIRO_NO_ERROR, AliroUd::Mailbox::Sessions::OpenSnapshot(MailboxHandleOf(handleB), sessionB));
	zassert_not_equal(sessionA, sessionB);

	uint8_t byteA{ 0xAA };
	uint8_t byteB{ 0xBB };
	zassert_equal(ALIRO_NO_ERROR, AliroUd::Mailbox::Sessions::StageWrite(sessionA, 0, &byteA, 1));
	zassert_equal(ALIRO_NO_ERROR, AliroUd::Mailbox::Sessions::StageWrite(sessionB, 0, &byteB, 1));
	zassert_equal(ALIRO_NO_ERROR, AliroUd::Mailbox::Sessions::Commit(sessionA));
	zassert_equal(ALIRO_NO_ERROR, AliroUd::Mailbox::Sessions::Commit(sessionB));

	uint8_t readBack{};
	zassert_equal(ALIRO_NO_ERROR, AliroUd::Mailbox::Sessions::Read(sessionA, 0, &readBack, 1));
	zassert_equal(0xAA, readBack);
	zassert_equal(ALIRO_NO_ERROR, AliroUd::Mailbox::Sessions::Read(sessionB, 0, &readBack, 1));
	zassert_equal(0xBB, readBack, "each mailbox's own session must stage/commit independently of the other's");

	AliroUd::Mailbox::Sessions::Close(sessionA);
	AliroUd::Mailbox::Sessions::Close(sessionB);
}

ZTEST(aliro_ud_mailbox_sessions, test_operations_on_unknown_session_fail_safely)
{
	uint8_t byte{};
	zassert_not_equal(ALIRO_NO_ERROR, AliroUd::Mailbox::Sessions::Read(0xDEAD, 0, &byte, 1));
	zassert_not_equal(ALIRO_NO_ERROR, AliroUd::Mailbox::Sessions::StageWrite(0xDEAD, 0, &byte, 1));
	zassert_not_equal(ALIRO_NO_ERROR, AliroUd::Mailbox::Sessions::Commit(0xDEAD));
	zassert_not_equal(ALIRO_NO_ERROR, AliroUd::Mailbox::Sessions::Rollback(0xDEAD));
	/* Close() on an unknown/already-closed session is a documented no-op, not an error. */
	AliroUd::Mailbox::Sessions::Close(0xDEAD);
}

ZTEST(aliro_ud_mailbox_sessions, test_shrinking_mailbox_mid_session_is_reflected_immediately)
{
	const auto handle = SeedCredentialWithMailbox(8, true, true);

	AliroUd::Mailbox::Sessions::SessionHandle session{};
	zassert_equal(ALIRO_NO_ERROR, AliroUd::Mailbox::Sessions::OpenSnapshot(MailboxHandleOf(handle), session));

	/* Shrink the provisioned mailbox size via a credential update, mid-session. */
	AliroUd::Credential::PersistedCredential record{};
	zassert_equal(ALIRO_NO_ERROR, AliroUd::Credential::Store::GetFullRecord(handle, record));

	AliroUd::Credential::Provisioning::Payload update{};
	update.mPolicySet = true;
	update.mPolicy = record.mPolicy;
	update.mBindingCount = record.mBindingCount;
	update.mBindings = record.mBindings;
	update.mMailbox = record.mMailbox;
	update.mMailbox.mSizeBytes = 2;
	zassert_equal(ALIRO_NO_ERROR, AliroUd::Credential::Store::Update(handle, update));

	uint8_t data{ 0x01 };
	zassert_equal(ALIRO_INVALID_ARGUMENT, AliroUd::Mailbox::Sessions::StageWrite(session, 4, &data, 1),
		     "an offset valid before the shrink must now be rejected");

	AliroUd::Mailbox::Sessions::Close(session);
}

/*
 * The same behavior once more through the real
 * Aliro::Interface::UserDevice::Mailbox adapter (mailbox.cpp), proving the
 * adapter forwards every parameter/return value unchanged.
 */
ZTEST(aliro_ud_mailbox_sessions, test_interface_adapter_forwards_to_sessions_engine)
{
	const auto handle = SeedCredentialWithMailbox(4, true, true);

	Interface::UserDevice::Mailbox::SessionHandle session{ Interface::UserDevice::Mailbox::kInvalidSessionHandle };
	zassert_equal(ALIRO_NO_ERROR, Interface::UserDevice::Mailbox::OpenSnapshot(MailboxHandleOf(handle), session));
	zassert_not_equal(Interface::UserDevice::Mailbox::kInvalidSessionHandle, session);

	/* WP7 stack impact (see docs/wp7_stack_impact.md), amendment A1: StageSet(session, offset, length, value). */
	zassert_equal(ALIRO_NO_ERROR, Interface::UserDevice::Mailbox::StageSet(session, 0, 4, 0x9));
	zassert_equal(ALIRO_NO_ERROR, Interface::UserDevice::Mailbox::Commit(session));

	std::array<uint8_t, 4> readBack{};
	zassert_equal(ALIRO_NO_ERROR,
		     Interface::UserDevice::Mailbox::Read(session, 0, readBack.data(), readBack.size()));
	const std::array<uint8_t, 4> full{ 0x9, 0x9, 0x9, 0x9 };
	zassert_true(readBack == full);

	Interface::UserDevice::Mailbox::Close(session);
}

/*
 * WP7 stack impact (see docs/wp7_stack_impact.md): the five new
 * Aliro::Interface::UserDevice::Mailbox contract functions added upstream
 * in WP7-S2/WP7-S8, exercised through the real mailbox.cpp adapter.
 */
ZTEST(aliro_ud_mailbox_sessions, test_interface_adapter_resolve_and_metadata_functions)
{
	const auto handle = SeedCredentialWithMailbox(4, /*readable=*/true, /*writable=*/false);
	const auto mailboxHandle = MailboxHandleOf(handle);

	::Aliro::UserDevice::MailboxHandle resolved{ ::Aliro::UserDevice::kInvalidMailboxHandle };
	zassert_equal(ALIRO_NO_ERROR, Interface::UserDevice::Mailbox::ResolveForCredential(handle, resolved));
	zassert_equal(mailboxHandle, resolved);

	::Aliro::UserDevice::MailboxHandle notResolved{ ::Aliro::UserDevice::kInvalidMailboxHandle };
	zassert_not_equal(ALIRO_NO_ERROR,
			 Interface::UserDevice::Mailbox::ResolveForCredential(kInvalidCredentialHandle, notResolved));
	zassert_equal(::Aliro::UserDevice::kInvalidMailboxHandle, notResolved);

	::Aliro::UserDevice::MailboxMetadata metadata{};
	zassert_equal(ALIRO_NO_ERROR, Interface::UserDevice::Mailbox::GetMetadata(mailboxHandle, metadata));
	zassert_equal(mailboxHandle, metadata.mHandle);
	zassert_equal(4U, metadata.mSizeBytes);
	zassert_true(metadata.mPermissions.mReadable);
	zassert_false(metadata.mPermissions.mWritable);

	bool hasNonZeroData{ true };
	zassert_equal(ALIRO_NO_ERROR, Interface::UserDevice::Mailbox::HasNonZeroData(mailboxHandle, hasNonZeroData));
	zassert_false(hasNonZeroData, "a freshly seeded mailbox has no committed data yet");

	/* No mailbox_data_subset was staged by SeedCredentialWithMailbox(): must read as unconfigured. */
	bool configured{ true };
	size_t count{ 123 };
	zassert_equal(ALIRO_NO_ERROR,
		     Interface::UserDevice::Mailbox::GetMailboxDataSubsetPairCount(mailboxHandle, configured, count));
	zassert_false(configured);
	zassert_equal(0U, count);
}
```

## src/test_mailbox_store.cpp
```c
/*
 * Copyright (c) 2026 Nordic Semiconductor ASA
 *
 * SPDX-License-Identifier: LicenseRef-Nordic-5-Clause
 */

#include <zephyr/ztest.h>

#include "fake_credential_persistence.h"
#include "fake_key_backend.h"
#include "fake_mailbox_persistence.h"
#include "storage/credential/credential_store.h"
#include "storage/mailbox/mailbox_store.h"

#include <array>

/*
 * AliroUd::Mailbox::Store under test (APP_PLAN.md AWP6): Credential-Issuer-
 * level committed byte storage, live-config lookup from the AWP3 credential
 * store, overflow-safe bounds, idempotent Initialize()/destructive Reset(),
 * and erase-on-credential-delete/-reset integration.
 */

using namespace Aliro;
using namespace Aliro::UserDevice;

namespace {

void ResetBeforeEachTest(void *fixture)
{
	(void)fixture;

	AliroUd::Credential::Test::ResetFakePersistence();
	AliroUd::Credential::Test::ResetFakeKeyBackend();
	AliroUd::Mailbox::Test::ResetFakeMailboxPersistence();

	zassert_equal(ALIRO_NO_ERROR, AliroUd::Credential::Store::Init(), "Credential store init must succeed");
	zassert_equal(ALIRO_NO_ERROR, AliroUd::Mailbox::Store::Init(), "Mailbox store init must succeed");
}

std::array<uint8_t, 32> KeyScalar(uint8_t seed)
{
	std::array<uint8_t, 32> scalar{ 0x23, 0x23, 0x10, 0x22, 0xa3, 0x66, 0x2c, 0xeb, 0x6f, 0x2e,
					 0x6a, 0x4e, 0x99, 0x88, 0x66, 0xae, 0x88, 0xd6, 0xe9, 0xda,
					 0x1c, 0x72, 0xb0, 0x50, 0xae, 0x5c, 0x20, 0x6a, 0x1d, 0xa4,
					 0x67, seed };
	return scalar;
}

/* WP7 stack impact (see docs/wp7_stack_impact.md): the removed-upstream settable-in-AUTH1 parameter was dropped here too. */
CredentialHandle SeedCredentialWithMailbox(uint32_t sizeBytes, bool readable, bool writable, uint8_t keySeed = 0x12)
{
	ReaderGroupIdentifier readerGroupId{};
	readerGroupId.fill(0x11);

	CryptoTypes::PublicKey trustAnchor{};
	trustAnchor[0] = 0x04;

	AliroUd::Credential::Provisioning::Payload payload{};
	payload.mHasNewKeyInput = true;
	payload.mNewKeyScalar = KeyScalar(keySeed);
	payload.mPolicySet = true;
	payload.mPolicy = AuthenticationPolicy::UserDeviceSetting;
	payload.mBindingCount = 1;
	payload.mBindings[0].mReaderGroupIdentifier = readerGroupId;
	payload.mBindings[0].mTrustType = AliroUd::Credential::TrustType::Direct;
	payload.mBindings[0].mKey = trustAnchor;
	payload.mMailbox.mConfigured = true;
	payload.mMailbox.mSizeBytes = sizeBytes;
	payload.mMailbox.mReadable = readable;
	payload.mMailbox.mWritable = writable;

	CredentialHandle handle{ kInvalidCredentialHandle };
	const auto error = AliroUd::Credential::Store::Create(payload, handle);
	zassert_equal(ALIRO_NO_ERROR, error, "Seeding the credential with a mailbox must succeed");
	return handle;
}

CredentialHandle SeedCredentialWithoutMailbox()
{
	ReaderGroupIdentifier readerGroupId{};
	readerGroupId.fill(0x22);

	CryptoTypes::PublicKey trustAnchor{};
	trustAnchor[0] = 0x04;

	AliroUd::Credential::Provisioning::Payload payload{};
	payload.mHasNewKeyInput = true;
	payload.mNewKeyScalar = KeyScalar(0x34);
	payload.mPolicySet = true;
	payload.mBindingCount = 1;
	payload.mBindings[0].mReaderGroupIdentifier = readerGroupId;
	payload.mBindings[0].mTrustType = AliroUd::Credential::TrustType::Direct;
	payload.mBindings[0].mKey = trustAnchor;

	CredentialHandle handle{ kInvalidCredentialHandle };
	const auto error = AliroUd::Credential::Store::Create(payload, handle);
	zassert_equal(ALIRO_NO_ERROR, error, "Seeding the credential without a mailbox must succeed");
	return handle;
}

} // namespace

ZTEST_SUITE(aliro_ud_mailbox_store, nullptr, nullptr, ResetBeforeEachTest, nullptr, nullptr);

ZTEST(aliro_ud_mailbox_store, test_get_config_reflects_live_credential_provisioning)
{
	const auto handle = SeedCredentialWithMailbox(64, /*readable=*/true, /*writable=*/false);

	AliroUd::Mailbox::Store::Config config{};
	zassert_equal(ALIRO_NO_ERROR, AliroUd::Mailbox::Store::GetConfig(handle, config));
	zassert_true(config.mConfigured);
	zassert_equal(64U, config.mSizeBytes);
	zassert_true(config.mPermissions.mReadable);
	zassert_false(config.mPermissions.mWritable);
	/* WP7 stack impact (see docs/wp7_stack_impact.md): mSettableInAuth1 no longer exists; no
	 * mailbox_data_subset was staged by SeedCredentialWithMailbox(), so it must read as unconfigured. */
	zassert_false(config.mDataSubsetConfigured);
	zassert_equal(0U, config.mDataSubsetPairCount);
}

ZTEST(aliro_ud_mailbox_store, test_get_config_rejects_credential_without_mailbox)
{
	const auto handle = SeedCredentialWithoutMailbox();

	AliroUd::Mailbox::Store::Config config{};
	zassert_equal(ALIRO_INVALID_ARGUMENT, AliroUd::Mailbox::Store::GetConfig(handle, config));
	zassert_false(config.mConfigured);
}

ZTEST(aliro_ud_mailbox_store, test_get_config_rejects_unknown_handle)
{
	AliroUd::Mailbox::Store::Config config{};
	zassert_not_equal(ALIRO_NO_ERROR, AliroUd::Mailbox::Store::GetConfig(kInvalidCredentialHandle, config));
}

ZTEST(aliro_ud_mailbox_store, test_initialize_is_idempotent_and_zero_fills)
{
	const auto handle = SeedCredentialWithMailbox(16, true, true);

	zassert_false(AliroUd::Mailbox::Store::IsInitialized(handle));
	zassert_equal(ALIRO_NO_ERROR, AliroUd::Mailbox::Store::Initialize(handle));
	zassert_true(AliroUd::Mailbox::Store::IsInitialized(handle));
	zassert_false(AliroUd::Mailbox::Store::HasNonZeroData(handle));

	std::array<uint8_t, 16> data{};
	zassert_equal(ALIRO_NO_ERROR, AliroUd::Mailbox::Store::RawRead(handle, 0, data.data(), data.size()));
	for (uint8_t byte : data) {
		zassert_equal(0, byte);
	}

	/* Write some data, then re-Initialize(): must not wipe it (idempotent). */
	std::array<bool, AliroUd::Mailbox::kMaxSizeBytes> dirty{};
	std::array<uint8_t, AliroUd::Mailbox::kMaxSizeBytes> shadow{};
	shadow[0] = 0xAB;
	dirty[0] = true;
	zassert_equal(ALIRO_NO_ERROR, AliroUd::Mailbox::Store::ApplyDirtyBytes(handle, shadow, dirty));

	zassert_equal(ALIRO_NO_ERROR, AliroUd::Mailbox::Store::Initialize(handle));
	zassert_true(AliroUd::Mailbox::Store::HasNonZeroData(handle), "Initialize() must not wipe existing data");
}

ZTEST(aliro_ud_mailbox_store, test_reset_re_zeroes_even_if_already_initialized)
{
	const auto handle = SeedCredentialWithMailbox(16, true, true);
	zassert_equal(ALIRO_NO_ERROR, AliroUd::Mailbox::Store::Initialize(handle));

	std::array<bool, AliroUd::Mailbox::kMaxSizeBytes> dirty{};
	std::array<uint8_t, AliroUd::Mailbox::kMaxSizeBytes> shadow{};
	shadow[0] = 0xAB;
	dirty[0] = true;
	zassert_equal(ALIRO_NO_ERROR, AliroUd::Mailbox::Store::ApplyDirtyBytes(handle, shadow, dirty));
	zassert_true(AliroUd::Mailbox::Store::HasNonZeroData(handle));

	zassert_equal(ALIRO_NO_ERROR, AliroUd::Mailbox::Store::Reset(handle));
	zassert_false(AliroUd::Mailbox::Store::HasNonZeroData(handle), "Reset() must re-zero committed data");
	zassert_true(AliroUd::Mailbox::Store::IsInitialized(handle));
}

ZTEST(aliro_ud_mailbox_store, test_raw_read_rejects_out_of_bounds_and_overflowing_ranges)
{
	const auto handle = SeedCredentialWithMailbox(16, true, true);
	zassert_equal(ALIRO_NO_ERROR, AliroUd::Mailbox::Store::Initialize(handle));

	std::array<uint8_t, 16> data{};
	zassert_equal(ALIRO_NO_ERROR, AliroUd::Mailbox::Store::RawRead(handle, 0, data.data(), 16));
	zassert_equal(ALIRO_INVALID_ARGUMENT, AliroUd::Mailbox::Store::RawRead(handle, 0, data.data(), 17));
	zassert_equal(ALIRO_INVALID_ARGUMENT, AliroUd::Mailbox::Store::RawRead(handle, 16, data.data(), 1));
	zassert_equal(ALIRO_INVALID_ARGUMENT, AliroUd::Mailbox::Store::RawRead(handle, 10, data.data(), 10));
	/* Overflow-safe: an offset near SIZE_MAX with any positive length must not wrap around and pass bounds. */
	zassert_equal(ALIRO_INVALID_ARGUMENT, AliroUd::Mailbox::Store::RawRead(handle, SIZE_MAX - 4, data.data(), 8));
}

ZTEST(aliro_ud_mailbox_store, test_apply_dirty_bytes_only_touches_dirty_offsets)
{
	const auto handle = SeedCredentialWithMailbox(8, true, true);
	zassert_equal(ALIRO_NO_ERROR, AliroUd::Mailbox::Store::Initialize(handle));

	std::array<bool, AliroUd::Mailbox::kMaxSizeBytes> dirty{};
	std::array<uint8_t, AliroUd::Mailbox::kMaxSizeBytes> shadow{};
	shadow[2] = 0x42;
	dirty[2] = true;
	zassert_equal(ALIRO_NO_ERROR, AliroUd::Mailbox::Store::ApplyDirtyBytes(handle, shadow, dirty));

	std::array<uint8_t, 8> data{};
	zassert_equal(ALIRO_NO_ERROR, AliroUd::Mailbox::Store::RawRead(handle, 0, data.data(), data.size()));
	for (size_t i = 0; i < data.size(); ++i) {
		zassert_equal(i == 2 ? 0x42 : 0x00, data[i], "byte %zu unexpected", i);
	}
}

ZTEST(aliro_ud_mailbox_store, test_erase_for_credential_clears_committed_data)
{
	const auto handle = SeedCredentialWithMailbox(8, true, true);
	zassert_equal(ALIRO_NO_ERROR, AliroUd::Mailbox::Store::Initialize(handle));

	std::array<bool, AliroUd::Mailbox::kMaxSizeBytes> dirty{};
	std::array<uint8_t, AliroUd::Mailbox::kMaxSizeBytes> shadow{};
	shadow[0] = 0xFF;
	dirty[0] = true;
	zassert_equal(ALIRO_NO_ERROR, AliroUd::Mailbox::Store::ApplyDirtyBytes(handle, shadow, dirty));
	zassert_true(AliroUd::Mailbox::Store::HasNonZeroData(handle));

	zassert_equal(ALIRO_NO_ERROR, AliroUd::Mailbox::Store::EraseForCredential(handle));
	zassert_false(AliroUd::Mailbox::Store::IsInitialized(handle));

	/*
	 * Simulates the handle being reused by a fresh Create() at the same
	 * slot (storage/credential/Kconfig: "handles are never reused for a
	 * different slot", but a *deleted* slot's handle is reused by the
	 * next Create()): the previous credential's mailbox bytes must not
	 * leak into the new one.
	 */
	zassert_equal(ALIRO_NO_ERROR, AliroUd::Credential::Store::Delete(handle));
	const auto newHandle = SeedCredentialWithMailbox(8, true, true, /*keySeed=*/0x99);
	zassert_equal(handle, newHandle, "the fake credential backend is expected to reuse the freed slot");
	zassert_equal(ALIRO_NO_ERROR, AliroUd::Mailbox::Store::Initialize(newHandle));
	zassert_false(AliroUd::Mailbox::Store::HasNonZeroData(newHandle),
		      "a new credential at a reused handle must not observe the deleted credential's mailbox data");
}

ZTEST(aliro_ud_mailbox_store, test_erase_all_clears_every_slot)
{
	const auto handleA = SeedCredentialWithMailbox(8, true, true, 0x01);
	const auto handleB = SeedCredentialWithMailbox(8, true, true, 0x02);
	zassert_equal(ALIRO_NO_ERROR, AliroUd::Mailbox::Store::Initialize(handleA));
	zassert_equal(ALIRO_NO_ERROR, AliroUd::Mailbox::Store::Initialize(handleB));

	zassert_equal(ALIRO_NO_ERROR, AliroUd::Mailbox::Store::EraseAll());

	zassert_false(AliroUd::Mailbox::Store::IsInitialized(handleA));
	zassert_false(AliroUd::Mailbox::Store::IsInitialized(handleB));
}

ZTEST(aliro_ud_mailbox_store, test_persists_across_reboot_simulation)
{
	const auto handle = SeedCredentialWithMailbox(8, true, true);
	zassert_equal(ALIRO_NO_ERROR, AliroUd::Mailbox::Store::Initialize(handle));

	std::array<bool, AliroUd::Mailbox::kMaxSizeBytes> dirty{};
	std::array<uint8_t, AliroUd::Mailbox::kMaxSizeBytes> shadow{};
	shadow[3] = 0x55;
	dirty[3] = true;
	zassert_equal(ALIRO_NO_ERROR, AliroUd::Mailbox::Store::ApplyDirtyBytes(handle, shadow, dirty));

	/* Simulate reboot: re-run Init() without clearing the fake's backing storage. */
	zassert_equal(ALIRO_NO_ERROR, AliroUd::Mailbox::Store::Init());

	std::array<uint8_t, 8> data{};
	zassert_equal(ALIRO_NO_ERROR, AliroUd::Mailbox::Store::RawRead(handle, 0, data.data(), data.size()));
	zassert_equal(0x55, data[3], "committed mailbox data must survive a reboot");
}
```

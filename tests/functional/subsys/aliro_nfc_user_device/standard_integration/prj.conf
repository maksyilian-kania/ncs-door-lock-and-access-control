## CMakeLists.txt
```
#
# Copyright (c) 2026 Nordic Semiconductor ASA
#
# SPDX-License-Identifier: LicenseRef-Nordic-5-Clause
#

cmake_minimum_required(VERSION 3.20.0)

find_package(Zephyr REQUIRED HINTS $ENV{ZEPHYR_BASE})

project(aliro_nfc_user_device_standard_integration)

set(ALIRO_UD_APP_SRC_DIR ${CMAKE_CURRENT_SOURCE_DIR}/../../../../../applications/aliro-nfc-user-device/src)
set(ALIRO_UD_WORKER_LIFECYCLE_TEST_SRC_DIR ${CMAKE_CURRENT_SOURCE_DIR}/../worker_lifecycle/src)
set(ALIRO_UD_TEST_COMMON_DIR ${CMAKE_CURRENT_SOURCE_DIR}/../common)

target_include_directories(app PRIVATE ${ALIRO_UD_APP_SRC_DIR} ${ALIRO_UD_TEST_COMMON_DIR}
					${ALIRO_UD_WORKER_LIFECYCLE_TEST_SRC_DIR})

# Certificate and no-certificate Expedited Standard transactions driven
# through the real worker thread and the real Aliro::UserDeviceStack against
# every real application adapter the stack reaches through AUTH1. Only
# storage persistence, key-storage backends, the NFC-A transport, and the
# DK-hardware authorization indicator are fakes.
target_sources(app PRIVATE
  ${ALIRO_UD_APP_SRC_DIR}/platform/authorization/authorization_window.cpp
  ${ALIRO_UD_APP_SRC_DIR}/platform/authorization/authorization.cpp
  ${ALIRO_UD_TEST_COMMON_DIR}/fake_authorization_indicator.cpp
  ${ALIRO_UD_APP_SRC_DIR}/platform/nfc/nfc_worker.cpp
  ${ALIRO_UD_APP_SRC_DIR}/platform/os/os_mutex.cpp
  ${ALIRO_UD_APP_SRC_DIR}/platform/os/os_timer.cpp
  ${ALIRO_UD_APP_SRC_DIR}/platform/os/os_queue.cpp
  ${ALIRO_UD_APP_SRC_DIR}/platform/os/os_trusted_time.cpp
  ${ALIRO_UD_APP_SRC_DIR}/platform/os/os_logging.cpp
  ${ALIRO_UD_APP_SRC_DIR}/platform/os/transaction.cpp
  ${ALIRO_UD_APP_SRC_DIR}/platform/crypto/crypto.cpp
  ${ALIRO_UD_APP_SRC_DIR}/platform/crypto/certificate.cpp
  ${ALIRO_UD_APP_SRC_DIR}/platform/crypto/credential_signing.cpp
  ${ALIRO_UD_APP_SRC_DIR}/storage/credential/credential.cpp
  ${ALIRO_UD_APP_SRC_DIR}/storage/credential/credential_store.cpp
  ${ALIRO_UD_TEST_COMMON_DIR}/fake_credential_persistence.cpp
  ${ALIRO_UD_TEST_COMMON_DIR}/fake_key_backend.cpp
  ${ALIRO_UD_APP_SRC_DIR}/storage/document/document.cpp
  ${ALIRO_UD_APP_SRC_DIR}/storage/document/document_snapshots.cpp
  ${ALIRO_UD_APP_SRC_DIR}/storage/key/persistent_key.cpp
  ${ALIRO_UD_APP_SRC_DIR}/storage/key/persistent_key_store.cpp
  ${ALIRO_UD_TEST_COMMON_DIR}/fake_persistent_key_persistence.cpp
  ${ALIRO_UD_TEST_COMMON_DIR}/fake_persistent_key_backend.cpp
  ${ALIRO_UD_APP_SRC_DIR}/storage/mailbox/mailbox.cpp
  ${ALIRO_UD_APP_SRC_DIR}/storage/mailbox/mailbox_sessions.cpp
  ${ALIRO_UD_APP_SRC_DIR}/storage/mailbox/mailbox_store.cpp
  ${ALIRO_UD_TEST_COMMON_DIR}/fake_mailbox_persistence.cpp
  ${ALIRO_UD_WORKER_LIFECYCLE_TEST_SRC_DIR}/fake_nfc_interface.cpp
  ${ALIRO_UD_TEST_COMMON_DIR}/test_reader.cpp
  src/log_capture.c
  src/test_standard_integration.cpp
)

# nfc_worker.cpp calls into BeginCommandTiming()/EndCommandTiming()
# (APP_PLAN.md AWP7); mirrors the application's own CMakeLists.txt.
target_sources_ifdef(CONFIG_ALIRO_UD_TIMING_INSTRUMENTATION app PRIVATE
  ${ALIRO_UD_APP_SRC_DIR}/platform/nfc/command_timing.cpp
)
```

## Kconfig
```
#
# Copyright (c) 2026 Nordic Semiconductor ASA
#
# SPDX-License-Identifier: LicenseRef-Nordic-5-Clause
#

mainmenu "Aliro NFC User Device - Standard Authentication Integration Test"

# This test builds the real application sources listed in CMakeLists.txt
# directly, so it needs the Kconfig options they reference, normally sourced
# via the application's own Kconfig.
rsource "../../../../../applications/aliro-nfc-user-device/src/platform/nfc/Kconfig"
rsource "../../../../../applications/aliro-nfc-user-device/src/platform/os/Kconfig"
rsource "../../../../../applications/aliro-nfc-user-device/src/platform/authorization/Kconfig"
rsource "../../../../../applications/aliro-nfc-user-device/src/platform/crypto/Kconfig"
rsource "../../../../../applications/aliro-nfc-user-device/src/storage/credential/Kconfig"
rsource "../../../../../applications/aliro-nfc-user-device/src/storage/mailbox/Kconfig"
rsource "../../../../../applications/aliro-nfc-user-device/src/storage/key/Kconfig"
rsource "../../../../../applications/aliro-nfc-user-device/src/storage/document/Kconfig"

source "Kconfig.zephyr"
```

## prj.conf
```kconfig
#
# Copyright (c) 2026 Nordic Semiconductor ASA
#
# SPDX-License-Identifier: LicenseRef-Nordic-5-Clause
#

CONFIG_NCS_ALIRO_USER_DEVICE=y

CONFIG_CPP=y
CONFIG_STD_CPP17=y
CONFIG_REQUIRES_FULL_LIBCPP=y

CONFIG_ZTEST=y
# The test thread provisions PersistedCredential-sized payloads and runs the
# test Reader's PSA ECDH/ECDSA/HKDF/AES-GCM operations.
CONFIG_ZTEST_STACK_SIZE=16384
CONFIG_MAIN_STACK_SIZE=8192

# Immediate mode, as in the application's prj.conf: log_capture.c records
# the Transaction::NotifyResult() adapter's output synchronously.
CONFIG_LOG=y
CONFIG_LOG_MODE_IMMEDIATE=y

# k_poll() multiplexes the worker thread's wait between the coalesced
# field-lifecycle semaphore and the bounded command/stack-event queue.
CONFIG_POLL=y

# PSA Crypto (volatile only). The application adapters select their own
# algorithms (platform/crypto/Kconfig); the fake key backends and the test
# Reader additionally import ECC key pairs.
CONFIG_PSA_CRYPTO=y
CONFIG_PSA_WANT_KEY_TYPE_ECC_KEY_PAIR_IMPORT=y
CONFIG_PSA_WANT_KEY_TYPE_ECC_KEY_PAIR_EXPORT=y
CONFIG_PSA_WANT_KEY_TYPE_ECC_PUBLIC_KEY=y
CONFIG_PSA_WANT_ECC_SECP_R1_256=y
CONFIG_PSA_WANT_ALG_ECDSA=y
CONFIG_PSA_WANT_ALG_SHA_256=y
CONFIG_PSA_WANT_GENERATE_RANDOM=y
```

## src/log_capture.c
```c
/*
 * Copyright (c) 2026 Nordic Semiconductor ASA
 *
 * SPDX-License-Identifier: LicenseRef-Nordic-5-Clause
 */

#include "log_capture.h"

#include <zephyr/logging/log_backend.h>
#include <zephyr/logging/log_output.h>
#include <zephyr/spinlock.h>

#include <string.h>

#define LINE_CAPACITY 256
#define RECORD_CAPACITY 32

static const char kFilter[] = "Transaction result:";

static struct k_spinlock sLock;
static char sLine[LINE_CAPACITY];
static size_t sLineLength;
static char sRecords[RECORD_CAPACITY][LINE_CAPACITY];
static size_t sRecordCount;

static int CaptureOutput(uint8_t *data, size_t length, void *context)
{
	ARG_UNUSED(context);

	for (size_t i = 0; i < length && sLineLength < LINE_CAPACITY - 1; ++i) {
		sLine[sLineLength++] = (char)data[i];
	}
	return (int)length;
}

static uint8_t sOutputBuffer[64];
LOG_OUTPUT_DEFINE(sCaptureOutput, CaptureOutput, sOutputBuffer, sizeof(sOutputBuffer));

static void Process(const struct log_backend *const backend, union log_msg_generic *msg)
{
	ARG_UNUSED(backend);

	k_spinlock_key_t key = k_spin_lock(&sLock);

	sLineLength = 0;
	log_output_msg_process(&sCaptureOutput, &msg->log, 0);
	log_output_flush(&sCaptureOutput);
	sLine[sLineLength] = '\0';

	if (strstr(sLine, kFilter) != NULL && sRecordCount < RECORD_CAPACITY) {
		memcpy(sRecords[sRecordCount], sLine, sLineLength + 1);
		sRecordCount++;
	}

	k_spin_unlock(&sLock, key);
}

static void Panic(const struct log_backend *const backend)
{
	ARG_UNUSED(backend);
}

static const struct log_backend_api sCaptureApi = {
	.process = Process,
	.panic = Panic,
};

LOG_BACKEND_DEFINE(aliro_ud_test_log_capture, sCaptureApi, true);

void log_capture_reset(void)
{
	k_spinlock_key_t key = k_spin_lock(&sLock);
	sRecordCount = 0;
	k_spin_unlock(&sLock, key);
}

size_t log_capture_count(const char *needle)
{
	size_t count = 0;
	k_spinlock_key_t key = k_spin_lock(&sLock);
	for (size_t i = 0; i < sRecordCount; ++i) {
		if (strstr(sRecords[i], needle) != NULL) {
			count++;
		}
	}
	k_spin_unlock(&sLock, key);
	return count;
}

size_t log_capture_total(void)
{
	k_spinlock_key_t key = k_spin_lock(&sLock);
	const size_t count = sRecordCount;
	k_spin_unlock(&sLock, key);
	return count;
}
```

## src/log_capture.h
```c
/*
 * Copyright (c) 2026 Nordic Semiconductor ASA
 *
 * SPDX-License-Identifier: LicenseRef-Nordic-5-Clause
 */

#pragma once

#include <stddef.h>

#ifdef __cplusplus
extern "C" {
#endif

/**
 * @brief Test log backend that records each formatted log line containing
 * "Transaction result:", the only observable behavior of the application's
 * `Aliro::Interface::UserDevice::Transaction::NotifyResult()` adapter.
 * Requires CONFIG_LOG_MODE_IMMEDIATE.
 */
void log_capture_reset(void);

/** @brief Number of recorded lines containing `needle`. */
size_t log_capture_count(const char *needle);

/** @brief Total number of recorded lines. */
size_t log_capture_total(void);

#ifdef __cplusplus
}
#endif
```

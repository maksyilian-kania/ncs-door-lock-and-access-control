## CMakeLists.txt
```
#
# Copyright (c) 2026 Nordic Semiconductor ASA
#
# SPDX-License-Identifier: LicenseRef-Nordic-5-Clause
#

cmake_minimum_required(VERSION 3.20.0)

find_package(Zephyr REQUIRED HINTS $ENV{ZEPHYR_BASE})

project(aliro_nfc_user_device_persistent_key)

set(ALIRO_UD_APP_SRC_DIR ${CMAKE_CURRENT_SOURCE_DIR}/../../../../../applications/aliro-nfc-user-device/src)
set(ALIRO_UD_TEST_COMMON_DIR ${CMAKE_CURRENT_SOURCE_DIR}/../common)

target_include_directories(app PRIVATE ${ALIRO_UD_APP_SRC_DIR} ${ALIRO_UD_TEST_COMMON_DIR} src)

# Aliro::Interface::UserDevice::PersistentKey adapter and record engine under
# test, independent of protocol flow. The persistence and PSA key backends are
# suite-local in-memory fakes with fault injection, a shared power-loss model,
# and object accounting; crypto.cpp is not linked. The real credential store,
# over the shared credential fakes, verifies the credential delete/reset
# cascade into the record engine.
target_sources(app PRIVATE
  ${ALIRO_UD_APP_SRC_DIR}/storage/key/persistent_key.cpp
  ${ALIRO_UD_APP_SRC_DIR}/storage/key/persistent_key_store.cpp
  ${ALIRO_UD_APP_SRC_DIR}/storage/credential/credential_store.cpp
  ${ALIRO_UD_TEST_COMMON_DIR}/fake_credential_persistence.cpp
  ${ALIRO_UD_TEST_COMMON_DIR}/fake_key_backend.cpp
  src/fake_power_loss.cpp
  src/fake_psa_key_backend.cpp
  src/fake_record_persistence.cpp
  src/recovery_support.cpp
  src/test_persistent_key_semantics.cpp
  src/test_persistent_key_recovery.cpp
  src/test_persistent_key_fault_injection.cpp
  src/test_persistent_key_credential_cascade.cpp
)
```

## Kconfig
```
#
# Copyright (c) 2026 Nordic Semiconductor ASA
#
# SPDX-License-Identifier: LicenseRef-Nordic-5-Clause
#

mainmenu "Aliro NFC User Device - Persistent Key Test"

# CONFIG_ALIRO_UD_MAX_PERSISTENT_KEYS_PER_CREDENTIAL/_PERSISTENT_KEY_ID_BASE
# for the record engine under test, plus the credential store options,
# including CONFIG_ALIRO_UD_MAX_CREDENTIALS, which sizes its global record
# table.
rsource "../../../../../applications/aliro-nfc-user-device/src/storage/key/Kconfig"
rsource "../../../../../applications/aliro-nfc-user-device/src/storage/credential/Kconfig"

source "Kconfig.zephyr"
```

## prj.conf
```kconfig
#
# Copyright (c) 2026 Nordic Semiconductor ASA
#
# SPDX-License-Identifier: LicenseRef-Nordic-5-Clause
#

# Only the "aliro/..." headers are needed; no Aliro::UserDeviceStack
# protocol code is exercised.
CONFIG_NCS_ALIRO_USER_DEVICE=y

CONFIG_CPP=y
CONFIG_STD_CPP17=y
CONFIG_REQUIRES_FULL_LIBCPP=y

CONFIG_ZTEST=y
CONFIG_ZTEST_STACK_SIZE=16384
CONFIG_MAIN_STACK_SIZE=8192

CONFIG_LOG=y

# Satisfies the PSA_WANT_* selections of the application Kconfig files. The
# Kpersistent key backend is a fake; only the shared credential key-backend
# fake calls PSA, to provision credentials for the cascade tests.
CONFIG_PSA_CRYPTO=y
```

## src/fake_power_loss.cpp
```c
/*
 * Copyright (c) 2026 Nordic Semiconductor ASA
 *
 * SPDX-License-Identifier: LicenseRef-Nordic-5-Clause
 */

#include "fake_power_loss.h"

#include <array>

namespace AliroUd::PersistentKey::FakePower {
namespace {

enum class Armed : uint8_t {
	None,
	Cut,
	FailOnce,
};

Armed sArmed{ Armed::None };
size_t sRemaining{ 0 };
bool sWithEffect{ false };
bool sTripped{ false };

std::array<Transition, 64> sTrace{};
size_t sTraceLength{ 0 };

} // namespace

void Reset()
{
	sArmed = Armed::None;
	sRemaining = 0;
	sWithEffect = false;
	sTripped = false;
	ClearTrace();
}

void CutAfter(size_t durableWrites)
{
	sArmed = Armed::Cut;
	sRemaining = durableWrites;
	sTripped = false;
}

void FailOnceAfter(size_t durableWrites, bool withEffect)
{
	sArmed = Armed::FailOnce;
	sRemaining = durableWrites;
	sWithEffect = withEffect;
	sTripped = false;
}

bool Tripped()
{
	return sTripped;
}

Outcome NextDurableWrite(Mutation kind, uint32_t target)
{
	if (sTraceLength < sTrace.size()) {
		sTrace[sTraceLength] = Transition{ kind, target };
	}
	++sTraceLength;

	if (sArmed == Armed::None) {
		return Outcome::Land;
	}
	if (sRemaining > 0) {
		--sRemaining;
		return Outcome::Land;
	}

	sTripped = true;
	if (sArmed == Armed::Cut) {
		return Outcome::Refuse;
	}
	sArmed = Armed::None;
	return sWithEffect ? Outcome::LandThenFail : Outcome::Refuse;
}

void ClearTrace()
{
	sTraceLength = 0;
}

size_t TraceLength()
{
	return sTraceLength;
}

Transition TraceAt(size_t index)
{
	return index < sTrace.size() ? sTrace[index] : Transition{};
}

size_t TraceCapacity()
{
	return sTrace.size();
}

} // namespace AliroUd::PersistentKey::FakePower
```

## src/fake_power_loss.h
```c
/*
 * Copyright (c) 2026 Nordic Semiconductor ASA
 *
 * SPDX-License-Identifier: LicenseRef-Nordic-5-Clause
 */

#pragma once

#include <cstddef>
#include <cstdint>

/**
 * @brief Durable-mutation fault model shared by the suite's persistence and
 * PSA fakes.
 *
 * Every durable mutation (record save or erase, durable key creation or
 * destruction) asks `NextDurableWrite()` for its outcome, which is also
 * appended to a trace. After `CutAfter(n)`, the first `n` mutations land and
 * every later one fails without effect, as if power were lost at that
 * point. After `FailOnceAfter(n, withEffect)`, the first `n` mutations land
 * and the next one reports failure, without its effect or after it, while
 * later mutations land again. Reads are unaffected. A test then simulates
 * the reboot with `Reset()` and `FakePsa::Reboot()`.
 */
namespace AliroUd::PersistentKey::FakePower {

enum class Mutation : uint8_t {
	OwnKey,
	DestroyKey,
	SaveRecord,
	EraseRecord,
};

/** @brief One attempted durable mutation: a key ID for keys, a slot index for records. */
struct Transition {
	Mutation mKind{ Mutation::OwnKey };
	uint32_t mTarget{ 0 };

	bool operator==(const Transition &other) const { return mKind == other.mKind && mTarget == other.mTarget; }
};

enum class Outcome : uint8_t {
	Land,
	Refuse,
	LandThenFail,
};

/** @brief Restores power, disarms any fault, and clears the trip flag and the trace. */
void Reset();

/** @brief Lets exactly `durableWrites` more mutations land, then refuses every later one. */
void CutAfter(size_t durableWrites);

/**
 * @brief Lets exactly `durableWrites` more mutations land, then fails the
 * next one once: without its effect, or with it when `withEffect` is true.
 */
void FailOnceAfter(size_t durableWrites, bool withEffect);

/** @brief Returns true once a mutation was refused or failed since the last `Reset()`. */
bool Tripped();

/** @brief Decides the outcome of the next durable mutation and records it in the trace. */
Outcome NextDurableWrite(Mutation kind, uint32_t target);

/** @brief Clears the trace only. */
void ClearTrace();

/** @brief Number of mutations attempted since the trace was last cleared. */
size_t TraceLength();

/** @brief The `index`-th attempted mutation; valid for `index < TraceLength()` within the trace capacity. */
Transition TraceAt(size_t index);

/** @brief Maximum number of mutations the trace retains. */
size_t TraceCapacity();

} // namespace AliroUd::PersistentKey::FakePower
```

## src/fake_psa_key_backend.cpp
```c
/*
 * Copyright (c) 2026 Nordic Semiconductor ASA
 *
 * SPDX-License-Identifier: LicenseRef-Nordic-5-Clause
 */

#include "fake_psa_key_backend.h"
#include "fake_power_loss.h"

#include <storage/key/persistent_key_backend.h>
#include <storage/key/persistent_key_types.h>

#include <algorithm>

using namespace Aliro;

namespace AliroUd::PersistentKey::FakePsa {
namespace {

/* Caller-owned IDs never overlap CONFIG_ALIRO_UD_PERSISTENT_KEY_ID_BASE's range and are never reused. */
constexpr CryptoTypes::KeyId kInputKeyIdBase{ 0x40000000 };
constexpr CryptoTypes::KeyId kTemporaryKeyIdBase{ 0x50000000 };

struct Object {
	bool mLive{ false };
	Kind mKind{ Kind::Input };
	CryptoTypes::KeyId mId{ 0 };
	Material mMaterial{};
};

/* Every durable slot ID plus generous room for caller-owned objects. */
std::array<Object, 2 * kMaxRecords + 64> sObjects{};
CryptoTypes::KeyId sNextInputKeyId{ kInputKeyIdBase + 1 };
CryptoTypes::KeyId sNextTemporaryKeyId{ kTemporaryKeyIdBase + 1 };
Fault sArmedFault{ Fault::None };
size_t sArmedSkip{ 0 };
size_t sDurableDestroyCount{ 0 };
size_t sDurableCreateCount{ 0 };
size_t sInvalidDestroyCount{ 0 };

Object *Find(CryptoTypes::KeyId keyId)
{
	for (auto &object : sObjects) {
		if (object.mLive && object.mId == keyId) {
			return &object;
		}
	}
	return nullptr;
}

Object *Create(Kind kind, CryptoTypes::KeyId keyId, const Material &material)
{
	for (auto &object : sObjects) {
		if (!object.mLive) {
			object = Object{ true, kind, keyId, material };
			return &object;
		}
	}
	return nullptr;
}

bool ConsumeFault(Fault fault)
{
	if (sArmedFault != fault) {
		return false;
	}
	if (sArmedSkip > 0) {
		--sArmedSkip;
		return false;
	}
	sArmedFault = Fault::None;
	return true;
}

void Release(Object &object)
{
	object.mMaterial.fill(0);
	object = Object{};
}

} // namespace

void Reset()
{
	for (auto &object : sObjects) {
		Release(object);
	}
	sNextInputKeyId = kInputKeyIdBase + 1;
	sNextTemporaryKeyId = kTemporaryKeyIdBase + 1;
	sArmedFault = Fault::None;
	sArmedSkip = 0;
	sDurableDestroyCount = 0;
	sDurableCreateCount = 0;
	sInvalidDestroyCount = 0;
}

void Reboot()
{
	for (auto &object : sObjects) {
		if (object.mLive && object.mKind != Kind::Durable) {
			Release(object);
		}
	}
	sArmedFault = Fault::None;
	sArmedSkip = 0;
}

void FailNext(Fault fault, size_t skip)
{
	sArmedFault = fault;
	sArmedSkip = skip;
}

bool FaultArmed()
{
	return sArmedFault != Fault::None;
}

CryptoTypes::KeyId CreateInputKey(const Material &material)
{
	const Object *object = Create(Kind::Input, sNextInputKeyId, material);
	if (object == nullptr) {
		return 0;
	}
	++sNextInputKeyId;
	return object->mId;
}

bool PreloadDurable(CryptoTypes::KeyId persistedKeyId, const Material &material)
{
	if (persistedKeyId == 0 || Find(persistedKeyId) != nullptr) {
		return false;
	}
	return Create(Kind::Durable, persistedKeyId, material) != nullptr;
}

bool DestroyCallerKey(CryptoTypes::KeyId keyId)
{
	Object *object = Find(keyId);
	if (object == nullptr || object->mKind == Kind::Durable) {
		++sInvalidDestroyCount;
		return false;
	}
	Release(*object);
	return true;
}

bool IsLive(CryptoTypes::KeyId keyId, Kind kind)
{
	const Object *object = Find(keyId);
	return object != nullptr && object->mKind == kind;
}

bool MaterialEquals(CryptoTypes::KeyId keyId, const Material &material)
{
	const Object *object = Find(keyId);
	return object != nullptr && object->mMaterial == material;
}

size_t LiveCount()
{
	return static_cast<size_t>(
		std::count_if(sObjects.begin(), sObjects.end(), [](const Object &object) { return object.mLive; }));
}

size_t LiveCount(Kind kind)
{
	return static_cast<size_t>(std::count_if(sObjects.begin(), sObjects.end(), [kind](const Object &object) {
		return object.mLive && object.mKind == kind;
	}));
}

size_t DurableDestroyCount()
{
	return sDurableDestroyCount;
}

size_t DurableCreateCount()
{
	return sDurableCreateCount;
}

size_t InvalidDestroyCount()
{
	return sInvalidDestroyCount;
}

} // namespace AliroUd::PersistentKey::FakePsa

namespace AliroUd::PersistentKey::Backend {

using namespace FakePsa;

AliroError DurablyOwn(CryptoTypes::KeyId sourceKeyId, CryptoTypes::KeyId desiredPersistentKeyId,
		      CryptoTypes::KeyId &outActualPersistentKeyId)
{
	outActualPersistentKeyId = 0;

	const Object *source = Find(sourceKeyId);
	if (source == nullptr || source->mKind == Kind::Durable) {
		return ALIRO_INVALID_ARGUMENT;
	}

	if (Find(desiredPersistentKeyId) != nullptr) {
		return ALIRO_KEY_ALREADY_EXISTS;
	}

	if (ConsumeFault(Fault::DurablyOwn)) {
		return ALIRO_ERROR_INTERNAL;
	}
	const FakePower::Outcome outcome =
		FakePower::NextDurableWrite(FakePower::Mutation::OwnKey, desiredPersistentKeyId);
	if (outcome == FakePower::Outcome::Refuse) {
		return ALIRO_ERROR_INTERNAL;
	}

	if (Create(Kind::Durable, desiredPersistentKeyId, source->mMaterial) == nullptr) {
		return ALIRO_NO_MEMORY;
	}
	++sDurableCreateCount;

	/* Beyond the backend contract: the key exists although the call failed. */
	if (outcome == FakePower::Outcome::LandThenFail) {
		return ALIRO_ERROR_INTERNAL;
	}

	outActualPersistentKeyId = desiredPersistentKeyId;
	return ALIRO_NO_ERROR;
}

AliroError MintVolatileHandle(CryptoTypes::KeyId persistedKeyId, CryptoTypes::KeyId &outVolatileKeyId)
{
	outVolatileKeyId = 0;

	const Object *durable = Find(persistedKeyId);
	if (durable == nullptr || durable->mKind != Kind::Durable) {
		return ALIRO_ERROR_INTERNAL;
	}

	if (ConsumeFault(Fault::MintVolatileHandle)) {
		return ALIRO_ERROR_INTERNAL;
	}

	const Object *temporary = Create(Kind::Temporary, sNextTemporaryKeyId, durable->mMaterial);
	if (temporary == nullptr) {
		return ALIRO_NO_MEMORY;
	}
	++sNextTemporaryKeyId;

	outVolatileKeyId = temporary->mId;
	return ALIRO_NO_ERROR;
}

AliroError Exists(CryptoTypes::KeyId persistedKeyId, bool &outExists)
{
	outExists = false;
	if (ConsumeFault(Fault::Exists)) {
		return ALIRO_ERROR_INTERNAL;
	}

	const Object *object = Find(persistedKeyId);
	outExists = object != nullptr && object->mKind == Kind::Durable;
	return ALIRO_NO_ERROR;
}

AliroError Destroy(CryptoTypes::KeyId persistedKeyId)
{
	Object *durable = Find(persistedKeyId);
	if (durable == nullptr || durable->mKind != Kind::Durable) {
		/* Idempotent per the backend contract, but the store under test must never rely on it. */
		++sInvalidDestroyCount;
		return ALIRO_NO_ERROR;
	}

	if (ConsumeFault(Fault::Destroy)) {
		return ALIRO_ERROR_INTERNAL;
	}
	const FakePower::Outcome outcome = FakePower::NextDurableWrite(FakePower::Mutation::DestroyKey, persistedKeyId);
	if (outcome == FakePower::Outcome::Refuse) {
		return ALIRO_ERROR_INTERNAL;
	}

	Release(*durable);
	++sDurableDestroyCount;
	return outcome == FakePower::Outcome::LandThenFail ? ALIRO_ERROR_INTERNAL : ALIRO_NO_ERROR;
}

} // namespace AliroUd::PersistentKey::Backend
```

## src/fake_psa_key_backend.h
```c
/*
 * Copyright (c) 2026 Nordic Semiconductor ASA
 *
 * SPDX-License-Identifier: LicenseRef-Nordic-5-Clause
 */

#pragma once

#include <aliro/types.h>

#include <array>
#include <cstddef>
#include <cstdint>

/**
 * @brief In-memory PSA key-object model implementing
 * `storage/key/persistent_key_backend.h`, with leak and double-destroy
 * accounting.
 *
 * Every key object is one of:
 * - an input key the test creates to stand in for the stack's transient
 *   `Kpersistent` handle passed to `Replace()`;
 * - a durable copy created by `Backend::DurablyOwn()` at the store-chosen
 *   persistent key ID; or
 * - a temporary copy minted by `Backend::MintVolatileHandle()` for `Lookup()`.
 *
 * Input and temporary objects are caller-owned and released with
 * `DestroyCallerKey()`, standing in for `Crypto::DestroyKey()`. Durable
 * objects are released only by `Backend::Destroy()`. Durable objects survive
 * `AliroUd::PersistentKey::Store::Init()`, simulating a reboot. Durable
 * creation and destruction honor `fake_power_loss.h`.
 *
 * Key material is only ever compared, never returned or formatted.
 */
namespace AliroUd::PersistentKey::FakePsa {

using Material = std::array<uint8_t, 32>;

enum class Kind : uint8_t {
	Input,
	Durable,
	Temporary,
};

enum class Fault : uint8_t {
	None,
	DurablyOwn,
	MintVolatileHandle,
	Exists,
	Destroy,
};

/** @brief Destroys every object and clears every counter and armed fault (first boot). */
void Reset();

/** @brief Simulates a reboot: input and temporary objects vanish, durable objects and counters survive. */
void Reboot();

/** @brief Arms one failure of the given backend operation, after `skip` calls to it succeed. */
void FailNext(Fault fault, size_t skip = 0);

/** @brief Returns true while an armed fault has not fired. */
bool FaultArmed();

/** @brief Creates a caller-owned input key holding `material`; returns 0 when the object table is full. */
::Aliro::CryptoTypes::KeyId CreateInputKey(const Material &material);

/** @brief Seeds a durable object at `persistedKeyId`, as if left by an earlier boot. */
bool PreloadDurable(::Aliro::CryptoTypes::KeyId persistedKeyId, const Material &material);

/**
 * @brief Releases a live input or temporary object. Returns false, and
 * counts an invalid destroy, if `keyId` is not a live caller-owned object.
 */
bool DestroyCallerKey(::Aliro::CryptoTypes::KeyId keyId);

/** @brief Returns true if `keyId` names a live object of `kind`. */
bool IsLive(::Aliro::CryptoTypes::KeyId keyId, Kind kind);

/** @brief Returns true if `keyId` names a live object whose material equals `material`. */
bool MaterialEquals(::Aliro::CryptoTypes::KeyId keyId, const Material &material);

/** @brief Number of live objects of every kind. */
size_t LiveCount();

/** @brief Number of live objects of `kind`. */
size_t LiveCount(Kind kind);

/** @brief Number of `Backend::Destroy()` calls that released a live durable object. */
size_t DurableDestroyCount();

/** @brief Number of durable objects `Backend::DurablyOwn()` created. */
size_t DurableCreateCount();

/** @brief Number of destroy attempts on an object that was not live (double destroy or unknown ID). */
size_t InvalidDestroyCount();

} // namespace AliroUd::PersistentKey::FakePsa
```

## src/fake_record_persistence.cpp
```c
/*
 * Copyright (c) 2026 Nordic Semiconductor ASA
 *
 * SPDX-License-Identifier: LicenseRef-Nordic-5-Clause
 */

#include "fake_record_persistence.h"
#include "fake_power_loss.h"

#include <storage/key/persistent_key_persistence.h>

#include <algorithm>
#include <cstdint>
#include <cstring>

namespace AliroUd::PersistentKey::FakeStorage {
namespace {

struct Slot {
	bool mPresent{ false };
	std::array<uint8_t, sizeof(Record)> mBytes{};
};

constexpr size_t kNoSlot{ SIZE_MAX };

std::array<Slot, kMaxRecords> sSlots{};
bool sFailNextSave{ false };
bool sFailNextErase{ false };
bool sFailNextInit{ false };
size_t sFailNextLoadSlot{ kNoSlot };
size_t sWriteCount{ 0 };

} // namespace

void Reset()
{
	sSlots = {};
	sFailNextSave = false;
	sFailNextErase = false;
	sFailNextInit = false;
	sFailNextLoadSlot = kNoSlot;
	sWriteCount = 0;
}

void FailNextInit()
{
	sFailNextInit = true;
}

void FailNextLoad(size_t slotIndex)
{
	sFailNextLoadSlot = slotIndex;
}

bool ReadFaultArmed()
{
	return sFailNextInit || sFailNextLoadSlot != kNoSlot;
}

void FailNextSave()
{
	sFailNextSave = true;
}

void FailNextErase()
{
	sFailNextErase = true;
}

void Preload(size_t slotIndex, const Record &record)
{
	std::memcpy(sSlots[slotIndex].mBytes.data(), &record, sizeof(Record));
	sSlots[slotIndex].mPresent = true;
}

Image Capture()
{
	Image image{};
	size_t offset = 0;
	for (const auto &slot : sSlots) {
		image[offset++] = slot.mPresent ? 1 : 0;
		std::copy(slot.mBytes.begin(), slot.mBytes.end(), image.begin() + offset);
		offset += slot.mBytes.size();
	}
	return image;
}

size_t PresentCount()
{
	return static_cast<size_t>(
		std::count_if(sSlots.begin(), sSlots.end(), [](const Slot &slot) { return slot.mPresent; }));
}

size_t WriteCount()
{
	return sWriteCount;
}

bool ImageContains(const uint8_t *bytes, size_t length)
{
	const Image image = Capture();
	return std::search(image.begin(), image.end(), bytes, bytes + length) != image.end();
}

} // namespace AliroUd::PersistentKey::FakeStorage

namespace AliroUd::PersistentKey::Persistence {

using namespace FakeStorage;

AliroError Init()
{
	if (sFailNextInit) {
		sFailNextInit = false;
		return ALIRO_ERROR_INTERNAL;
	}
	return ALIRO_NO_ERROR;
}

AliroError LoadRecord(size_t slotIndex, Record &out, bool &outPresent)
{
	if (sFailNextLoadSlot == slotIndex) {
		sFailNextLoadSlot = kNoSlot;
		outPresent = false;
		return ALIRO_ERROR_INTERNAL;
	}

	outPresent = sSlots[slotIndex].mPresent;
	if (outPresent) {
		std::memcpy(&out, sSlots[slotIndex].mBytes.data(), sizeof(Record));
	}
	return ALIRO_NO_ERROR;
}

AliroError SaveRecord(size_t slotIndex, const Record &value)
{
	if (sFailNextSave) {
		sFailNextSave = false;
		return ALIRO_ERROR_INTERNAL;
	}
	const FakePower::Outcome outcome = FakePower::NextDurableWrite(FakePower::Mutation::SaveRecord, slotIndex);
	if (outcome == FakePower::Outcome::Refuse) {
		return ALIRO_ERROR_INTERNAL;
	}

	std::memcpy(sSlots[slotIndex].mBytes.data(), &value, sizeof(Record));
	sSlots[slotIndex].mPresent = true;
	++sWriteCount;
	return outcome == FakePower::Outcome::LandThenFail ? ALIRO_ERROR_INTERNAL : ALIRO_NO_ERROR;
}

AliroError EraseRecord(size_t slotIndex)
{
	if (sFailNextErase) {
		sFailNextErase = false;
		return ALIRO_ERROR_INTERNAL;
	}
	const FakePower::Outcome outcome = FakePower::NextDurableWrite(FakePower::Mutation::EraseRecord, slotIndex);
	if (outcome == FakePower::Outcome::Refuse) {
		return ALIRO_ERROR_INTERNAL;
	}

	sSlots[slotIndex] = Slot{};
	++sWriteCount;
	return outcome == FakePower::Outcome::LandThenFail ? ALIRO_ERROR_INTERNAL : ALIRO_NO_ERROR;
}

} // namespace AliroUd::PersistentKey::Persistence
```

## src/fake_record_persistence.h
```c
/*
 * Copyright (c) 2026 Nordic Semiconductor ASA
 *
 * SPDX-License-Identifier: LicenseRef-Nordic-5-Clause
 */

#pragma once

#include <storage/key/persistent_key_types.h>

#include <array>
#include <cstddef>
#include <cstdint>

/**
 * @brief In-memory `storage/key/persistent_key_persistence.h` that stores
 * each record verbatim as `sizeof(Record)` bytes, as the settings backend
 * does, so tests can compare and scan the exact persisted image. Survives
 * `AliroUd::PersistentKey::Store::Init()`, simulating a reboot. Saves and
 * erases honor `fake_power_loss.h`.
 */
namespace AliroUd::PersistentKey::FakeStorage {

/** @brief Presence flag plus raw bytes of every slot. */
using Image = std::array<uint8_t, kMaxRecords * (1 + sizeof(Record))>;

/** @brief Clears every slot, counter, and armed fault (first boot). */
void Reset();

/** @brief Arms one failure of the next `Persistence::SaveRecord()`. */
void FailNextSave();

/** @brief Arms one failure of the next `Persistence::EraseRecord()`. */
void FailNextErase();

/** @brief Arms one failure of the next `Persistence::Init()`. */
void FailNextInit();

/** @brief Arms one failure of the next `Persistence::LoadRecord()` of `slotIndex`. */
void FailNextLoad(size_t slotIndex);

/** @brief Returns true while an armed `Init()` or `LoadRecord()` failure has not fired. */
bool ReadFaultArmed();

/** @brief Writes `record` into `slotIndex` directly, as if left by an earlier boot. */
void Preload(size_t slotIndex, const Record &record);

/** @brief Returns the current persisted image. */
Image Capture();

/** @brief Number of present slots. */
size_t PresentCount();

/** @brief Number of successful `SaveRecord()`/`EraseRecord()` calls. */
size_t WriteCount();

/** @brief Returns true if `length` consecutive bytes equal to `bytes` appear anywhere in the image. */
bool ImageContains(const uint8_t *bytes, size_t length);

} // namespace AliroUd::PersistentKey::FakeStorage
```

## src/recovery_support.cpp
```c
/*
 * Copyright (c) 2026 Nordic Semiconductor ASA
 *
 * SPDX-License-Identifier: LicenseRef-Nordic-5-Clause
 */

#include "recovery_support.h"

#include "fake_power_loss.h"
#include "fake_record_persistence.h"

#include <storage/key/persistent_key_persistence.h>
#include <storage/key/persistent_key_store.h>

#include <zephyr/ztest.h>

using namespace Aliro;
using namespace Aliro::UserDevice;

namespace AliroUd::PersistentKey::RecoverySupport {
namespace {

constexpr CryptoTypes::KeyId kKeyIdBase{ CONFIG_ALIRO_UD_PERSISTENT_KEY_ID_BASE };
constexpr PK::RecordHandle kPoisonRecord{ 0x5A5A5A5A };
constexpr CryptoTypes::KeyId kPoisonKeyId{ 0xA5A5A5A5 };

} // namespace

FakePsa::Material MakeMaterial(uint8_t seed)
{
	FakePsa::Material material{};
	for (size_t i = 0; i < material.size(); ++i) {
		material[i] = static_cast<uint8_t>(seed ^ (0x11 + 0x3B * i));
	}
	return material;
}

ReaderGroupSubIdentifier MakeSub(uint8_t seed)
{
	ReaderGroupSubIdentifier sub{};
	sub.fill(seed);
	return sub;
}

CryptoTypes::KeyId CommittedKeyId(size_t slotIndex)
{
	return kKeyIdBase + static_cast<CryptoTypes::KeyId>(2 * slotIndex);
}

CryptoTypes::KeyId StagedKeyId(size_t slotIndex)
{
	return CommittedKeyId(slotIndex) + 1;
}

Record MakeRecord(PK::RecordHandle handle, CredentialHandle credential, const ReaderGroupSubIdentifier &sub,
		  CryptoTypes::KeyId keyId)
{
	Record record{};
	record.mValid = true;
	record.mHandle = handle;
	record.mCredentialHandle = credential;
	record.mReaderGroupSubIdentifier = sub;
	record.mPersistedKeyId = keyId;
	return record;
}

void ClearAll()
{
	FakePower::Reset();
	FakePsa::Reset();
	FakeStorage::Reset();
}

AliroError Reboot()
{
	FakePower::Reset();
	FakePsa::Reboot();
	return Store::Init();
}

Stored Insert(CredentialHandle credential, const ReaderGroupSubIdentifier &sub, uint8_t seed)
{
	Stored stored{};
	stored.mMaterial = MakeMaterial(seed);

	const CryptoTypes::KeyId input = FakePsa::CreateInputKey(stored.mMaterial);
	zassert_not_equal(0u, input, "fake PSA table must have room for an input key");

	zassert_equal(ALIRO_NO_ERROR, PK::Replace(credential, sub, input, stored.mRecord), "Replace must succeed");
	zassert_not_equal(PK::kInvalidRecordHandle, stored.mRecord, "a committed record needs a valid handle");
	zassert_true(FakePsa::DestroyCallerKey(input), "the caller must be able to release its input key");

	return stored;
}

void ExpectResolves(CredentialHandle credential, const ReaderGroupSubIdentifier &sub, const Stored &stored)
{
	zassert_true(ResolvesOrMisses(credential, sub, stored), "Lookup must hit");
}

void ExpectMiss(CredentialHandle credential, const ReaderGroupSubIdentifier &sub)
{
	PK::RecordHandle record{ kPoisonRecord };
	CryptoTypes::KeyId temporary{ kPoisonKeyId };

	zassert_equal(ALIRO_ERROR_UNKNOWN, PK::Lookup(credential, sub, record, temporary), "Lookup must miss");
	zassert_equal(PK::kInvalidRecordHandle, record);
	zassert_equal(0u, temporary);
}

bool ResolvesOrMisses(CredentialHandle credential, const ReaderGroupSubIdentifier &sub, const Stored &stored)
{
	PK::RecordHandle record{ kPoisonRecord };
	CryptoTypes::KeyId temporary{ kPoisonKeyId };

	const AliroError error = PK::Lookup(credential, sub, record, temporary);
	if (error == ALIRO_ERROR_UNKNOWN) {
		zassert_equal(PK::kInvalidRecordHandle, record);
		zassert_equal(0u, temporary);
		return false;
	}

	zassert_equal(ALIRO_NO_ERROR, error, "Lookup must either hit or miss");
	zassert_equal(stored.mRecord, record, "Lookup must return the committed record handle");
	zassert_true(FakePsa::MaterialEquals(temporary, stored.mMaterial),
		     "the temporary handle must wrap the committed Kpersistent material");
	zassert_true(FakePsa::DestroyCallerKey(temporary));
	return true;
}

void ExpectConsistent()
{
	size_t present{ 0 };

	for (size_t i = 0; i < kMaxRecords; ++i) {
		Record record{};
		bool isPresent{ false };
		zassert_equal(ALIRO_NO_ERROR, Persistence::LoadRecord(i, record, isPresent));
		if (!isPresent) {
			continue;
		}
		++present;

		zassert_true(record.mValid, "slot %zu: a persisted record must be valid", i);
		zassert_true(record.mPersistedKeyId == CommittedKeyId(i) || record.mPersistedKeyId == StagedKeyId(i),
			     "slot %zu: the record must reference one of its slot's key IDs", i);
		zassert_true(FakePsa::IsLive(record.mPersistedKeyId, FakePsa::Kind::Durable),
			     "slot %zu: the record's durable key must exist", i);

		PK::RecordHandle handle{};
		CryptoTypes::KeyId temporary{};
		zassert_equal(ALIRO_NO_ERROR,
			      PK::Lookup(record.mCredentialHandle, record.mReaderGroupSubIdentifier, handle, temporary),
			      "slot %zu: a persisted record must resolve", i);
		zassert_equal(record.mHandle, handle);
		zassert_true(FakePsa::DestroyCallerKey(temporary));
	}

	zassert_equal(present, FakePsa::LiveCount(FakePsa::Kind::Durable), "no durable key may be unowned");
	zassert_equal(0u, FakePsa::InvalidDestroyCount(), "no key object may be destroyed twice or while absent");
}

void ExpectStableReboot()
{
	const FakeStorage::Image image = FakeStorage::Capture();
	const size_t writes = FakeStorage::WriteCount();
	const size_t creates = FakePsa::DurableCreateCount();
	const size_t destroys = FakePsa::DurableDestroyCount();
	const size_t durable = FakePsa::LiveCount(FakePsa::Kind::Durable);

	zassert_equal(ALIRO_NO_ERROR, Reboot(), "a repeated boot must succeed");
	zassert_true(FakeStorage::Capture() == image, "a repeated boot must not change persisted records");
	zassert_equal(writes, FakeStorage::WriteCount(), "a repeated boot must not write");
	zassert_equal(creates, FakePsa::DurableCreateCount(), "a repeated boot must not create a key");
	zassert_equal(destroys, FakePsa::DurableDestroyCount(), "a repeated boot must not destroy a key");
	zassert_equal(durable, FakePsa::LiveCount(FakePsa::Kind::Durable));
	ExpectConsistent();
}

void ExpectCleanTeardown()
{
	zassert_equal(ALIRO_NO_ERROR, PK::Reset(), "factory reset must succeed");
	zassert_equal(0u, FakeStorage::PresentCount(), "no persisted record may survive factory reset");
	zassert_equal(0u, FakePsa::LiveCount(), "every fake PSA object must be released");
	zassert_equal(0u, FakePsa::InvalidDestroyCount(), "no key object may be destroyed twice or while absent");
}

} // namespace AliroUd::PersistentKey::RecoverySupport
```

## src/recovery_support.h
```c
/*
 * Copyright (c) 2026 Nordic Semiconductor ASA
 *
 * SPDX-License-Identifier: LicenseRef-Nordic-5-Clause
 */

#pragma once

#include "fake_psa_key_backend.h"

#include <storage/key/persistent_key_types.h>

#include <aliro/user_device/interface.h>

/**
 * @brief Shared helpers for the recovery and credential-cascade suites.
 *
 * "Boot" means `Store::Init()` over the durable state the fakes retain;
 * "reboot" additionally restores power and drops every volatile fake PSA
 * object first. Assertion messages never format key material.
 */
namespace AliroUd::PersistentKey::RecoverySupport {

namespace PK = ::Aliro::Interface::UserDevice::PersistentKey;

struct Stored {
	PK::RecordHandle mRecord{ PK::kInvalidRecordHandle };
	FakePsa::Material mMaterial{};
};

FakePsa::Material MakeMaterial(uint8_t seed);
::Aliro::UserDevice::ReaderGroupSubIdentifier MakeSub(uint8_t seed);

::Aliro::CryptoTypes::KeyId CommittedKeyId(size_t slotIndex);
::Aliro::CryptoTypes::KeyId StagedKeyId(size_t slotIndex);

/** @brief A well-formed record for direct preloading. */
Record MakeRecord(PK::RecordHandle handle, ::Aliro::UserDevice::CredentialHandle credential,
		  const ::Aliro::UserDevice::ReaderGroupSubIdentifier &sub, ::Aliro::CryptoTypes::KeyId keyId);

/** @brief Clears every fake (first boot) without initializing the store. */
void ClearAll();

/** @brief Restores power, drops volatile PSA objects, and boots; returns `Store::Init()`'s result. */
::AliroError Reboot();

/** @brief Commits one record, then releases the input key as the stack does after `Replace()`. */
Stored Insert(::Aliro::UserDevice::CredentialHandle credential,
	      const ::Aliro::UserDevice::ReaderGroupSubIdentifier &sub, uint8_t seed);

void ExpectResolves(::Aliro::UserDevice::CredentialHandle credential,
		    const ::Aliro::UserDevice::ReaderGroupSubIdentifier &sub, const Stored &stored);
void ExpectMiss(::Aliro::UserDevice::CredentialHandle credential,
		const ::Aliro::UserDevice::ReaderGroupSubIdentifier &sub);

/** @brief Returns true if the pair resolves to `stored`; fails unless it resolves so or misses. */
bool ResolvesOrMisses(::Aliro::UserDevice::CredentialHandle credential,
		      const ::Aliro::UserDevice::ReaderGroupSubIdentifier &sub, const Stored &stored);

/**
 * @brief Checks the recovered invariant: every persisted record is valid,
 * resolves with its own handle, and owns a live durable key at one of its
 * slot's IDs, and no other durable key exists.
 */
void ExpectConsistent();

/** @brief Reboots again and checks that recovery makes no durable change. */
void ExpectStableReboot();

/** @brief Factory-resets the store and checks that nothing survives. */
void ExpectCleanTeardown();

} // namespace AliroUd::PersistentKey::RecoverySupport
```

## src/test_persistent_key_credential_cascade.cpp
```c
/*
 * Copyright (c) 2026 Nordic Semiconductor ASA
 *
 * SPDX-License-Identifier: LicenseRef-Nordic-5-Clause
 */

#include <zephyr/ztest.h>

#include "fake_credential_persistence.h"
#include "fake_key_backend.h"
#include "fake_psa_key_backend.h"
#include "fake_record_persistence.h"
#include "recovery_support.h"
#include "storage/credential/credential_store.h"
#include "storage/key/persistent_key_store.h"

#include <algorithm>
#include <array>

/*
 * Credential deletion and factory reset remove the credential's Kpersistent
 * records and report a failure to do so. Kpersistent is bound to its
 * Access Credential (Aliro 1.0 Specification, section 8.3.1.13, page 59),
 * and lifecycle management is implementation-specific (section 6.2,
 * page 28). A missing Kpersistent is a supported protocol state (section
 * 8.3.3.2.6, pages 69-70), so records are removed before the credential.
 */

using namespace Aliro;
using namespace Aliro::UserDevice;
using namespace AliroUd::PersistentKey::RecoverySupport;

namespace CredentialStore = ::AliroUd::Credential::Store;
namespace FakePsa = ::AliroUd::PersistentKey::FakePsa;
namespace FakeStorage = ::AliroUd::PersistentKey::FakeStorage;

using FakePsa::Kind;

namespace {

constexpr size_t kPerCredential{ AliroUd::PersistentKey::kMaxRecordsPerCredential };
constexpr size_t kGlobal{ AliroUd::PersistentKey::kMaxRecords };
constexpr size_t kCredentials{ CONFIG_ALIRO_UD_MAX_CREDENTIALS };

std::array<uint8_t, 32> KeyScalar(uint8_t seed)
{
	std::array<uint8_t, 32> scalar{ 0x23, 0x23, 0x10, 0x22, 0xa3, 0x66, 0x2c, 0xeb, 0x6f, 0x2e, 0x6a,
					0x4e, 0x99, 0x88, 0x66, 0xae, 0x88, 0xd6, 0xe9, 0xda, 0x1c, 0x72,
					0xb0, 0x50, 0xae, 0x5c, 0x20, 0x6a, 0x1d, 0xa4, 0x67, seed };
	return scalar;
}

CredentialHandle CreateCredential(uint8_t seed)
{
	ReaderGroupIdentifier readerGroupId{};
	readerGroupId.fill(seed);
	CryptoTypes::PublicKey trustAnchor{};
	trustAnchor[0] = 0x04;

	AliroUd::Credential::Provisioning::Payload payload{};
	payload.mHasNewKeyInput = true;
	payload.mNewKeyScalar = KeyScalar(seed);
	payload.mPolicySet = true;
	payload.mPolicy = AuthenticationPolicy::UserDeviceSetting;
	payload.mBindingCount = 1;
	payload.mBindings[0].mReaderGroupIdentifier = readerGroupId;
	payload.mBindings[0].mTrustType = AliroUd::Credential::TrustType::Direct;
	payload.mBindings[0].mKey = trustAnchor;

	CredentialHandle handle{ kInvalidCredentialHandle };
	zassert_equal(ALIRO_NO_ERROR, CredentialStore::Create(payload, handle), "credential creation must succeed");
	return handle;
}

bool CredentialExists(CredentialHandle handle)
{
	CredentialMetadata metadata{};
	return CredentialStore::GetMetadata(handle, metadata) == ALIRO_NO_ERROR;
}

void ResetBeforeEachTest(void *fixture)
{
	(void)fixture;

	ClearAll();
	AliroUd::Credential::Test::ResetFakePersistence();
	AliroUd::Credential::Test::ResetFakeKeyBackend();

	/* Boot order from main.cpp. */
	zassert_equal(ALIRO_NO_ERROR, CredentialStore::Init());
	zassert_equal(ALIRO_NO_ERROR, AliroUd::PersistentKey::Store::Init());
}

} // namespace

ZTEST_SUITE(aliro_ud_persistent_key_credential_cascade, nullptr, nullptr, ResetBeforeEachTest, nullptr, nullptr);

/* Deleting a credential removes exactly its records, and a reused handle starts without any. */
ZTEST(aliro_ud_persistent_key_credential_cascade, test_credential_delete_removes_its_records)
{
	const CredentialHandle credential = CreateCredential(0x31);
	const size_t ownCount = std::min<size_t>(kPerCredential, 2);
	for (size_t i = 0; i < ownCount; ++i) {
		(void)Insert(credential, MakeSub(static_cast<uint8_t>(0x10 + i)), static_cast<uint8_t>(0x20 + i));
	}

	const bool hasOther = kCredentials >= 2;
	CredentialHandle otherCredential{ kInvalidCredentialHandle };
	Stored other{};
	if (hasOther) {
		otherCredential = CreateCredential(0x32);
		other = Insert(otherCredential, MakeSub(0x18), 0x28);
	}

	zassert_equal(ALIRO_NO_ERROR, CredentialStore::Delete(credential));
	zassert_false(CredentialExists(credential));
	for (size_t i = 0; i < ownCount; ++i) {
		ExpectMiss(credential, MakeSub(static_cast<uint8_t>(0x10 + i)));
	}
	zassert_equal(hasOther ? 1u : 0u, FakePsa::LiveCount(Kind::Durable), "the credential's keys are destroyed");
	if (hasOther) {
		ExpectResolves(otherCredential, MakeSub(0x18), other);
	}

	const CredentialHandle reused = CreateCredential(0x33);
	zassert_equal(credential, reused, "the freed handle is reused");
	ExpectMiss(reused, MakeSub(0x10));
	ExpectConsistent();

	ExpectCleanTeardown();
}

/* A record-cleanup failure is returned and leaves the credential committed; a retry completes. */
ZTEST(aliro_ud_persistent_key_credential_cascade, test_credential_delete_propagates_record_cleanup_failure)
{
	const CredentialHandle credential = CreateCredential(0x41);
	const ReaderGroupSubIdentifier sub = MakeSub(0x42);
	const Stored stored = Insert(credential, sub, 0x43);

	FakeStorage::FailNextErase();
	zassert_not_equal(ALIRO_NO_ERROR, CredentialStore::Delete(credential), "the erase failure must be returned");
	zassert_true(CredentialExists(credential), "the credential must stay committed");
	ExpectResolves(credential, sub, stored);

	FakePsa::FailNext(FakePsa::Fault::Destroy);
	zassert_not_equal(ALIRO_NO_ERROR, CredentialStore::Delete(credential), "the destroy failure must be returned");
	zassert_true(CredentialExists(credential), "the credential must stay committed");
	ExpectMiss(credential, sub);
	zassert_equal(1u, FakePsa::LiveCount(Kind::Durable), "the key is retained for recovery");

	zassert_equal(ALIRO_NO_ERROR, CredentialStore::Delete(credential), "a retry must succeed");
	zassert_false(CredentialExists(credential));

	/* The retained key is swept at boot. */
	zassert_equal(ALIRO_NO_ERROR, Reboot());
	ExpectConsistent();
	zassert_equal(0u, FakePsa::LiveCount(Kind::Durable));

	ExpectCleanTeardown();
}

/* Factory reset removes every record, including one whose credential no longer exists. */
ZTEST(aliro_ud_persistent_key_credential_cascade, test_credential_reset_removes_all_records)
{
	const CredentialHandle credential = CreateCredential(0x51);
	(void)Insert(credential, MakeSub(0x52), 0x53);
	if (kGlobal >= 2) {
		/* Left by earlier firmware, which ignored cleanup failures. */
		(void)Insert(static_cast<CredentialHandle>(kCredentials + 1), MakeSub(0x54), 0x55);
	}

	zassert_equal(ALIRO_NO_ERROR, CredentialStore::Reset());
	zassert_false(CredentialExists(credential));
	zassert_equal(0u, FakeStorage::PresentCount());
	zassert_equal(0u, FakePsa::LiveCount(Kind::Durable));

	ExpectCleanTeardown();
}

/* A record-cleanup failure during factory reset is returned, and a repeated reset completes. */
ZTEST(aliro_ud_persistent_key_credential_cascade, test_credential_reset_propagates_record_cleanup_failure)
{
	const CredentialHandle credential = CreateCredential(0x61);
	(void)Insert(credential, MakeSub(0x62), 0x63);

	FakePsa::FailNext(FakePsa::Fault::Destroy);
	zassert_not_equal(ALIRO_NO_ERROR, CredentialStore::Reset(), "the destroy failure must be returned");
	zassert_equal(0u, FakeStorage::PresentCount());
	zassert_equal(1u, FakePsa::LiveCount(Kind::Durable), "the key is retained for recovery");

	zassert_equal(ALIRO_NO_ERROR, CredentialStore::Reset(), "a repeated reset must succeed");
	zassert_false(CredentialExists(credential));
	zassert_equal(0u, FakePsa::LiveCount(Kind::Durable));

	ExpectCleanTeardown();
}
```

## CMakeLists.txt
```
#
# Copyright (c) 2026 Nordic Semiconductor ASA
#
# SPDX-License-Identifier: LicenseRef-Nordic-5-Clause
#

cmake_minimum_required(VERSION 3.20.0)

find_package(Zephyr REQUIRED HINTS $ENV{ZEPHYR_BASE})

project(aliro_nfc_user_device_worker_lifecycle)

set(ALIRO_UD_APP_SRC_DIR ${CMAKE_CURRENT_SOURCE_DIR}/../../../../../applications/aliro-nfc-user-device/src)
set(ALIRO_UD_TEST_COMMON_DIR ${CMAKE_CURRENT_SOURCE_DIR}/../common)

target_include_directories(app PRIVATE ${ALIRO_UD_APP_SRC_DIR} ${ALIRO_UD_TEST_COMMON_DIR})

# Real platform/nfc worker (bounded queue + dedicated thread) and platform/os
# (mutex, timer, deferred-event queue, logging) code under test, built
# exactly as shipped. nfc_transport.cpp (the nfc_t4t_lib hardware glue) is
# intentionally excluded: this test substitutes fake_nfc_interface.cpp for
# Aliro::Interface::UserDevice::Nfc so it can run on native_sim/native/64
# without real NFC hardware, while still exercising the real worker
# thread/queue and the real Aliro::UserDeviceStack (AWP1).
target_sources(app PRIVATE
  ${ALIRO_UD_APP_SRC_DIR}/platform/nfc/nfc_worker.cpp
  ${ALIRO_UD_APP_SRC_DIR}/platform/os/os_mutex.cpp
  ${ALIRO_UD_APP_SRC_DIR}/platform/os/os_timer.cpp
  ${ALIRO_UD_APP_SRC_DIR}/platform/os/os_queue.cpp
  ${ALIRO_UD_APP_SRC_DIR}/platform/os/os_trusted_time.cpp
  ${ALIRO_UD_APP_SRC_DIR}/platform/os/os_logging.cpp
  ${ALIRO_UD_APP_SRC_DIR}/platform/os/transaction.cpp
  # Aliro::Interface::UserDevice::Credential/Trust adapter (AWP3) and its
  # real credential_store.cpp engine; the real Aliro::UserDeviceStack pulled
  # in below calls into these unconditionally (ncs-aliro WP5's
  # CredentialManager::EvaluateAuth0()). credential_persistence_settings.cpp
  # and key_backend_psa.cpp are swapped for in-memory fakes (native_sim has
  # no hardware-backed flash/trusted storage); see
  # tests/functional/subsys/aliro_nfc_user_device/common/.
  ${ALIRO_UD_APP_SRC_DIR}/storage/credential/credential.cpp
  ${ALIRO_UD_APP_SRC_DIR}/storage/credential/credential_store.cpp
  ${ALIRO_UD_TEST_COMMON_DIR}/fake_credential_persistence.cpp
  ${ALIRO_UD_TEST_COMMON_DIR}/fake_key_backend.cpp
  # The real Aliro::UserDeviceStack references the Crypto,
  # CredentialSigning, Document, and PersistentKey contracts; the
  # PersistentKey persistence/key backends are swapped for in-memory fakes.
  ${ALIRO_UD_APP_SRC_DIR}/platform/crypto/crypto.cpp
  ${ALIRO_UD_APP_SRC_DIR}/platform/crypto/certificate.cpp
  ${ALIRO_UD_APP_SRC_DIR}/platform/crypto/credential_signing.cpp
  ${ALIRO_UD_APP_SRC_DIR}/storage/document/document.cpp
  ${ALIRO_UD_APP_SRC_DIR}/storage/document/document_snapshots.cpp
  ${ALIRO_UD_APP_SRC_DIR}/storage/key/persistent_key.cpp
  ${ALIRO_UD_APP_SRC_DIR}/storage/key/persistent_key_store.cpp
  ${ALIRO_UD_TEST_COMMON_DIR}/fake_persistent_key_persistence.cpp
  ${ALIRO_UD_TEST_COMMON_DIR}/fake_persistent_key_backend.cpp
  # WP7 stack impact (see docs/wp7_stack_impact.md): the real
  # Aliro::UserDeviceStack now unconditionally calls
  # Aliro::Interface::UserDevice::Mailbox::* from
  # UserDeviceStateMachine::HandleAuth1()/HandleExchange() (WP7-S7), even
  # for SELECT-only traffic's session teardown path.
  ${ALIRO_UD_APP_SRC_DIR}/storage/mailbox/mailbox.cpp
  ${ALIRO_UD_APP_SRC_DIR}/storage/mailbox/mailbox_sessions.cpp
  ${ALIRO_UD_APP_SRC_DIR}/storage/mailbox/mailbox_store.cpp
  ${ALIRO_UD_TEST_COMMON_DIR}/fake_mailbox_persistence.cpp
  # Aliro::Interface::UserDevice::Authorization adapter (AWP4) and its real
  # authorization_window.cpp state machine; authorization_button.cpp/
  # authorization_led.cpp (DK-hardware-only GPIO) are excluded, substituted
  # by fake_authorization_indicator.cpp.
  ${ALIRO_UD_APP_SRC_DIR}/platform/authorization/authorization.cpp
  ${ALIRO_UD_APP_SRC_DIR}/platform/authorization/authorization_window.cpp
  ${ALIRO_UD_TEST_COMMON_DIR}/fake_authorization_indicator.cpp
  src/fake_nfc_interface.cpp
  src/test_worker_lifecycle.cpp
)

# nfc_worker.cpp calls into BeginCommandTiming()/EndCommandTiming()
# (APP_PLAN.md AWP7); mirrors the application's own CMakeLists.txt so this
# test links exactly like the real application when
# CONFIG_ALIRO_UD_TIMING_INSTRUMENTATION (rsourced via platform/nfc/Kconfig,
# default y) is enabled.
target_sources_ifdef(CONFIG_ALIRO_UD_TIMING_INSTRUMENTATION app PRIVATE
  ${ALIRO_UD_APP_SRC_DIR}/platform/nfc/command_timing.cpp
)
```

## Kconfig
```
#
# Copyright (c) 2026 Nordic Semiconductor ASA
#
# SPDX-License-Identifier: LicenseRef-Nordic-5-Clause
#

mainmenu "Aliro NFC User Device - Worker Lifecycle Test"

# Pulls in CONFIG_ALIRO_UD_NFC_* and CONFIG_ALIRO_UD_OS_*: this test builds
# the real platform/nfc/nfc_worker.cpp and platform/os/*.cpp sources
# directly (see CMakeLists.txt), so it needs the same Kconfig options they
# reference, normally sourced via the application's own Kconfig.
rsource "../../../../../applications/aliro-nfc-user-device/src/platform/nfc/Kconfig"
rsource "../../../../../applications/aliro-nfc-user-device/src/platform/os/Kconfig"
rsource "../../../../../applications/aliro-nfc-user-device/src/platform/authorization/Kconfig"
rsource "../../../../../applications/aliro-nfc-user-device/src/storage/credential/Kconfig"
# WP7 stack impact (see docs/wp7_stack_impact.md): the real
# Aliro::UserDeviceStack now unconditionally calls
# Aliro::Interface::UserDevice::Mailbox::*, so this test now also builds
# storage/mailbox/*.cpp (see CMakeLists.txt) and needs its Kconfig options.
rsource "../../../../../applications/aliro-nfc-user-device/src/storage/mailbox/Kconfig"
# The Crypto, Document, and PersistentKey sources this test builds (see
# CMakeLists.txt) reference their own Kconfig options.
rsource "../../../../../applications/aliro-nfc-user-device/src/platform/crypto/Kconfig"
rsource "../../../../../applications/aliro-nfc-user-device/src/storage/key/Kconfig"
rsource "../../../../../applications/aliro-nfc-user-device/src/storage/document/Kconfig"

source "Kconfig.zephyr"
```

## prj.conf
```kconfig
#
# Copyright (c) 2026 Nordic Semiconductor ASA
#
# SPDX-License-Identifier: LicenseRef-Nordic-5-Clause
#

CONFIG_NCS_ALIRO_USER_DEVICE=y

CONFIG_CPP=y
CONFIG_STD_CPP17=y
CONFIG_REQUIRES_FULL_LIBCPP=y

CONFIG_ZTEST=y
CONFIG_ZTEST_STACK_SIZE=4096
CONFIG_MAIN_STACK_SIZE=4096

CONFIG_LOG=y

#
# PSA Crypto (volatile only): backs the AWP3 credential-store fake key
# backend's real scalar validation/public-key derivation. See
# tests/functional/subsys/aliro_nfc_user_device/common/fake_key_backend.cpp.
#
CONFIG_PSA_CRYPTO=y
CONFIG_PSA_WANT_KEY_TYPE_ECC_KEY_PAIR_IMPORT=y
CONFIG_PSA_WANT_KEY_TYPE_ECC_PUBLIC_KEY=y
CONFIG_PSA_WANT_ECC_SECP_R1_256=y
CONFIG_PSA_WANT_ALG_ECDSA=y
CONFIG_PSA_WANT_ALG_SHA_256=y
CONFIG_PSA_WANT_GENERATE_RANDOM=y

# k_poll() multiplexes the worker thread's wait between the coalesced
# field-lifecycle semaphore and the bounded command/stack-event queue.
CONFIG_POLL=y

# Small, deterministic queue depth so the overflow test case only needs a
# handful of un-drained posts.
CONFIG_ALIRO_UD_NFC_EVENT_QUEUE_DEPTH=4

# Short watchdog timeout so the timeout-termination test doesn't need to
# wait the 2000 ms production default. Kept comfortably above the largest
# intentional idle gap between events in any other test case (~100 ms, two
# SettleWorker() calls with no watchdog feed in between) so the shortened
# timeout does not spuriously fire in unrelated tests.
CONFIG_NCS_ALIRO_USER_DEVICE_SESSION_TIMEOUT_NFC=500
```

## src/fake_nfc_interface.cpp
```c
/*
 * Copyright (c) 2026 Nordic Semiconductor ASA
 *
 * SPDX-License-Identifier: LicenseRef-Nordic-5-Clause
 */

#include "fake_nfc_interface.h"

#include <aliro/user_device/interface.h>

namespace {

size_t gSentResponseCount{ 0 };
std::vector<uint8_t> gLastResponse{};
size_t gTerminationCount{ 0 };

} // namespace

namespace AliroUdTest::FakeNfc {

void Reset()
{
	gSentResponseCount = 0;
	gLastResponse.clear();
	gTerminationCount = 0;
}

size_t GetSentResponseCount()
{
	return gSentResponseCount;
}

std::vector<uint8_t> GetLastResponse()
{
	return gLastResponse;
}

size_t GetTerminationCount()
{
	return gTerminationCount;
}

} // namespace AliroUdTest::FakeNfc

namespace Aliro::Interface::UserDevice::Nfc {

AliroError SendResponseApdu(ConnectionHandle handle, ConstData apdu)
{
	(void)handle;

	gSentResponseCount++;
	gLastResponse.assign(apdu.mData, apdu.mData + apdu.mLength);

	return ALIRO_NO_ERROR;
}

void HandleTermination(ConnectionHandle handle)
{
	(void)handle;

	gTerminationCount++;
}

TimingConstraints GetTimingConstraints(ConnectionHandle handle)
{
	(void)handle;

	return TimingConstraints{};
}

} // namespace Aliro::Interface::UserDevice::Nfc
```

## src/fake_nfc_interface.h
```c
/*
 * Copyright (c) 2026 Nordic Semiconductor ASA
 *
 * SPDX-License-Identifier: LicenseRef-Nordic-5-Clause
 */

#pragma once

#include <cstddef>
#include <cstdint>
#include <vector>

/**
 * @brief Test double for `Aliro::Interface::UserDevice::Nfc`.
 *
 * Substitutes for the real, hardware-dependent `nfc_transport.cpp` so that
 * `nfc_worker.cpp`, the `platform/os` bindings, and the real
 * `Aliro::UserDeviceStack` can be exercised end to end on
 * native_sim/native/64 (AWP1).
 */
namespace AliroUdTest::FakeNfc {

/** @brief Resets every counter/capture below. Call between test cases. */
void Reset();

/** @brief Number of `SendResponseApdu()` calls since the last `Reset()`. */
size_t GetSentResponseCount();

/** @brief The response APDU bytes passed to the most recent `SendResponseApdu()` call. */
std::vector<uint8_t> GetLastResponse();

/** @brief Number of `HandleTermination()` calls since the last `Reset()`. */
size_t GetTerminationCount();

} // namespace AliroUdTest::FakeNfc
```

## src/test_worker_lifecycle.cpp
```c
/*
 * Copyright (c) 2026 Nordic Semiconductor ASA
 *
 * SPDX-License-Identifier: LicenseRef-Nordic-5-Clause
 */

#include <zephyr/kernel.h>
#include <zephyr/ztest.h>

#include "fake_nfc_interface.h"
#include "platform/nfc/nfc_worker.h"

#include <vector>

using namespace AliroUd::Nfc;

namespace {

/*
 * Generous relative to the worker thread's non-blocking dispatch: lets the
 * dedicated NFC/stack worker thread (started once for the whole suite)
 * drain every already-queued event/pending field transition before
 * assertions run.
 */
void SettleWorker()
{
	k_msleep(50);
}

void *SetupWorker(void)
{
	StartWorker();
	SettleWorker();
	return nullptr;
}

void ResetBeforeEachTest(void *fixture)
{
	(void)fixture;
	AliroUdTest::FakeNfc::Reset();

	/*
	 * Tests that end without an explicit PostFieldOff() (e.g. the timeout
	 * test) must not leak an active session into the next test case.
	 */
	if (IsSessionActive()) {
		PostFieldOff();
		SettleWorker();
	}
}

/** @brief The Expedited Phase AID (Aliro 1.0 Specification and Test Plan, 26-42802-001, Table 10-3, page 96). */
const std::vector<uint8_t> kExpeditedPhaseAid{ 0xA0, 0x00, 0x00, 0x09, 0x09, 0xAC, 0xCE, 0x55, 0x01 };

std::vector<uint8_t> SelectCommand(const std::vector<uint8_t> &aid, uint8_t p1 = 0x04, uint8_t p2 = 0x00)
{
	std::vector<uint8_t> cmd{ 0x00, 0xA4, p1, p2, static_cast<uint8_t>(aid.size()) };
	cmd.insert(cmd.end(), aid.begin(), aid.end());
	return cmd;
}

/**
 * @brief Fixed FCI response for the Expedited Phase SELECT (Aliro 1.0
 * Specification and Test Plan, 26-42802-001, section 10.2.1.2, Appendix
 * 14.4, page 177).
 */
const std::vector<uint8_t> kExpectedFciResponse{
	0x6F, 0x15, 0x84, 0x09, 0xA0, 0x00, 0x00, 0x09, 0x09, 0xAC, 0xCE, 0x55, 0x01,
	0xA5, 0x08, 0x80, 0x02, 0x00, 0x00, 0x5C, 0x02, 0x01, 0x00, 0x90, 0x00,
};

} // namespace

ZTEST_SUITE(aliro_ud_worker_lifecycle, nullptr, SetupWorker, ResetBeforeEachTest, nullptr, nullptr);

/**
 * @brief A field-on event, followed by a command APDU, is dispatched
 * through the real worker thread and real UserDeviceStack: activation and
 * command handling produce exactly one response (NFC-to-stack call
 * ordering, response-buffer round trip).
 */
ZTEST(aliro_ud_worker_lifecycle, test_field_on_then_command_produces_one_response)
{
	PostFieldOn();
	SettleWorker();
	zassert_true(IsSessionActive(), "Session should be active after FIELD_ON");

	const auto command = SelectCommand(kExpeditedPhaseAid);
	zassert_equal(0, PostCommandApdu(command.data(), command.size()), "PostCommandApdu() should succeed");
	SettleWorker();

	zassert_equal(1u, AliroUdTest::FakeNfc::GetSentResponseCount(), "Expected exactly one response");

	PostFieldOff();
	SettleWorker();
	zassert_false(IsSessionActive(), "Session should be inactive after FIELD_OFF");
}

/**
 * @brief A well-formed SELECT for the Expedited Phase AID, sent through the
 * real worker thread and stack, returns the exact FCI response bytes from
 * the spec's worked example, terminated with SW `9000`.
 */
ZTEST(aliro_ud_worker_lifecycle, test_select_expedited_aid_returns_spec_fci)
{
	PostFieldOn();
	SettleWorker();

	const auto command = SelectCommand(kExpeditedPhaseAid);
	zassert_equal(0, PostCommandApdu(command.data(), command.size()));
	SettleWorker();

	const auto response = AliroUdTest::FakeNfc::GetLastResponse();
	zassert_equal(kExpectedFciResponse.size(), response.size(), "Unexpected FCI response length");
	zassert_mem_equal(kExpectedFciResponse.data(), response.data(), response.size(),
			   "FCI response does not match the Aliro spec worked example");

	PostFieldOff();
	SettleWorker();
}

/**
 * @brief Field loss notifies `Nfc::HandleTermination()` (via
 * `UserDeviceSessionManager::Destroy()`), exercising the worker's
 * field-off -> DeactivateSession -> HandleTermination path end to end, and
 * the resulting local "session active" flag is cleared.
 */
ZTEST(aliro_ud_worker_lifecycle, test_field_off_notifies_termination)
{
	PostFieldOn();
	SettleWorker();

	PostFieldOff();
	SettleWorker();

	zassert_equal(1u, AliroUdTest::FakeNfc::GetTerminationCount(), "Expected exactly one termination notification");
	zassert_false(IsSessionActive(), "Session should be inactive after termination");
}

/**
 * @brief A duplicate field-on (two field-on events with no intervening
 * field-off) results in exactly one activation attempt: the worker's local
 * "session active" flag makes the second FIELD_ON a no-op rather than a
 * second `ActivateSession()` call.
 */
ZTEST(aliro_ud_worker_lifecycle, test_duplicate_field_on_is_safe)
{
	const auto attemptsBefore = GetActivationAttemptCount();

	PostFieldOn();
	SettleWorker();
	PostFieldOn();
	SettleWorker();

	zassert_equal(attemptsBefore + 1, GetActivationAttemptCount(),
		      "Duplicate FIELD_ON must not trigger a second activation attempt");

	const auto command = SelectCommand(kExpeditedPhaseAid);
	zassert_equal(0, PostCommandApdu(command.data(), command.size()));
	SettleWorker();

	zassert_equal(1u, AliroUdTest::FakeNfc::GetSentResponseCount(),
		      "Duplicate activation should not break normal command dispatch");

	PostFieldOff();
	SettleWorker();
}

/**
 * @brief A stale/duplicate field-off with no active session (already torn
 * down, or a field-off that never had a matching field-on) is a safe no-op:
 * no crash, no spurious termination notification, and no
 * `DeactivateSession()` call.
 */
ZTEST(aliro_ud_worker_lifecycle, test_field_off_without_session_is_safe)
{
	PostFieldOff();
	SettleWorker();

	zassert_equal(0u, AliroUdTest::FakeNfc::GetTerminationCount(),
		      "No session existed, so no termination should have been notified");
	zassert_false(IsSessionActive());
}

/**
 * @brief ON -> APDUs -> ON -> APDUs -> OFF: normal traffic interleaved with
 * a duplicate, ignored FIELD_ON produces exactly one activation attempt and
 * every command APDU is still answered.
 */
ZTEST(aliro_ud_worker_lifecycle, test_on_apdus_on_apdus_off)
{
	const auto attemptsBefore = GetActivationAttemptCount();
	const auto command = SelectCommand(kExpeditedPhaseAid);

	PostFieldOn();
	SettleWorker();

	zassert_equal(0, PostCommandApdu(command.data(), command.size()));
	SettleWorker();
	zassert_equal(1u, AliroUdTest::FakeNfc::GetSentResponseCount());

	/* Duplicate FIELD_ON: ignored, no second activation attempt. */
	PostFieldOn();
	SettleWorker();
	zassert_equal(attemptsBefore + 1, GetActivationAttemptCount());

	zassert_equal(0, PostCommandApdu(command.data(), command.size()));
	SettleWorker();
	zassert_equal(2u, AliroUdTest::FakeNfc::GetSentResponseCount());

	PostFieldOff();
	SettleWorker();
	zassert_false(IsSessionActive());
}

/**
 * @brief ON -> OFF -> ON: strict, non-racing field cycle. Deactivation
 * completes fully before the second activation, which must succeed
 * normally (fresh session, one more activation attempt).
 */
ZTEST(aliro_ud_worker_lifecycle, test_on_off_on)
{
	const auto attemptsBefore = GetActivationAttemptCount();

	PostFieldOn();
	SettleWorker();
	zassert_true(IsSessionActive());

	PostFieldOff();
	SettleWorker();
	zassert_false(IsSessionActive());

	PostFieldOn();
	SettleWorker();
	zassert_true(IsSessionActive());
	zassert_equal(attemptsBefore + 2, GetActivationAttemptCount());

	const auto command = SelectCommand(kExpeditedPhaseAid);
	zassert_equal(0, PostCommandApdu(command.data(), command.size()));
	SettleWorker();
	zassert_equal(1u, AliroUdTest::FakeNfc::GetSentResponseCount(), "Reactivated session should handle commands");

	PostFieldOff();
	SettleWorker();
}

/**
 * @brief A field-loss/re-activation race (field-off immediately followed by
 * field-on, as the worker would see if a reader briefly drops and regains
 * the field) tears down the old session and cleanly activates a new one.
 * FIELD_ON/FIELD_OFF are coalesced onto one pending-intent slot, so only
 * the latest (FIELD_ON) survives here - which is the correct outcome.
 */
ZTEST(aliro_ud_worker_lifecycle, test_field_loss_then_reactivate)
{
	PostFieldOn();
	SettleWorker();

	/* Field-loss race: off immediately followed by on, before settling. */
	PostFieldOff();
	PostFieldOn();
	SettleWorker();

	zassert_true(IsSessionActive(), "Latest coalesced intent (FIELD_ON) should win the race");

	const auto command = SelectCommand(kExpeditedPhaseAid);
	zassert_equal(0, PostCommandApdu(command.data(), command.size()));
	SettleWorker();

	zassert_equal(1u, AliroUdTest::FakeNfc::GetSentResponseCount(), "Reactivated session should handle commands");

	PostFieldOff();
	SettleWorker();
}

/**
 * @brief ON -> timeout termination -> ON: the stack's own session watchdog
 * (`CONFIG_NCS_ALIRO_USER_DEVICE_SESSION_TIMEOUT_NFC`, shortened for this
 * suite) terminates the session independently of any FIELD_OFF. The
 * worker's local "session active" flag must follow that termination
 * (via `NotifySessionTerminated()`), and a subsequent FIELD_ON must
 * activate a fresh session rather than being ignored as "already active".
 */
ZTEST(aliro_ud_worker_lifecycle, test_on_timeout_termination_on)
{
	const auto attemptsBefore = GetActivationAttemptCount();
	const auto terminationsBefore = AliroUdTest::FakeNfc::GetTerminationCount();

	PostFieldOn();
	SettleWorker();
	zassert_true(IsSessionActive());

	/* CONFIG_NCS_ALIRO_USER_DEVICE_SESSION_TIMEOUT_NFC=500 (prj.conf). */
	k_msleep(800);
	SettleWorker();

	zassert_equal(terminationsBefore + 1, AliroUdTest::FakeNfc::GetTerminationCount(),
		      "Watchdog timeout should have terminated the session");
	zassert_false(IsSessionActive(), "Local session-active belief must follow stack-driven termination");

	PostFieldOn();
	SettleWorker();
	zassert_true(IsSessionActive(), "FIELD_ON after a stack-driven termination must reactivate");
	zassert_equal(attemptsBefore + 2, GetActivationAttemptCount());

	PostFieldOff();
	SettleWorker();
}

/**
 * @brief Posting more command APDUs than the bounded queue depth
 * (`CONFIG_ALIRO_UD_NFC_EVENT_QUEUE_DEPTH`) without letting the worker
 * drain forces deterministic session recovery; dispatch resumes cleanly
 * afterward once a fresh FIELD_ON reactivates.
 */
ZTEST(aliro_ud_worker_lifecycle, test_queue_overflow_is_deterministic_and_recoverable)
{
	PostFieldOn();
	SettleWorker();
	zassert_true(IsSessionActive());

	size_t rejected{ 0 };
	const auto command = SelectCommand(kExpeditedPhaseAid);

	/*
	 * CONFIG_ALIRO_UD_NFC_EVENT_QUEUE_DEPTH=4 (prj.conf); posting more
	 * than that back-to-back, without yielding, guarantees overflow: this
	 * test thread runs at a higher priority than the worker thread
	 * (K_PRIO_PREEMPT(CONFIG_ALIRO_UD_NFC_THREAD_PRIORITY), default 5), so
	 * the worker cannot drain anything until this loop yields/sleeps.
	 */
	for (int i = 0; i < 8; i++) {
		if (PostCommandApdu(command.data(), command.size()) != 0) {
			rejected++;
		}
	}

	zassert_true(rejected > 0, "Expected at least one event to be rejected by the bounded queue");

	/* The overflow must force deterministic recovery: session torn down. */
	SettleWorker();
	zassert_false(IsSessionActive(), "Overflow must force session recovery rather than leaving stale state");

	/* Recovery: a fresh field cycle resumes normal dispatch cleanly. */
	PostFieldOn();
	SettleWorker();
	zassert_equal(0, PostCommandApdu(command.data(), command.size()));
	SettleWorker();

	zassert_equal(1u, AliroUdTest::FakeNfc::GetSentResponseCount(), "Worker did not recover after queue overflow");

	PostFieldOff();
	SettleWorker();
}

/**
 * @brief ON -> queue overflow involving OFF: flooding the bounded queue
 * with command APDUs must not cause a subsequent FIELD_OFF to be dropped.
 * FIELD_OFF is delivered through the separate coalesced field channel, so
 * it is never subject to the bounded queue's capacity.
 */
ZTEST(aliro_ud_worker_lifecycle, test_queue_overflow_does_not_drop_field_off)
{
	const auto terminationsBefore = AliroUdTest::FakeNfc::GetTerminationCount();

	PostFieldOn();
	SettleWorker();
	zassert_true(IsSessionActive());

	const auto command = SelectCommand(kExpeditedPhaseAid);
	for (int i = 0; i < 8; i++) {
		PostCommandApdu(command.data(), command.size());
	}

	/* Posted while the command queue is still full/being drained. */
	PostFieldOff();
	SettleWorker();

	zassert_false(IsSessionActive(), "FIELD_OFF must still take effect despite queue overflow");
	zassert_true(AliroUdTest::FakeNfc::GetTerminationCount() >= terminationsBefore + 1,
		     "FIELD_OFF (or the overflow's forced recovery) must have terminated the session");
}

/**
 * @brief A command APDU received with no active session - either before
 * any FIELD_ON, or after a session has already terminated - is rejected
 * deterministically: no `HandleCommandApdu()` call reaches the stack (no
 * response is sent) and the drop is counted.
 */
ZTEST(aliro_ud_worker_lifecycle, test_apdu_rejected_without_active_session)
{
	const auto rejectedBefore = GetRejectedApduCount();
	const auto command = SelectCommand(kExpeditedPhaseAid);

	/* Before any FIELD_ON. */
	zassert_equal(0, PostCommandApdu(command.data(), command.size()));
	SettleWorker();
	zassert_equal(0u, AliroUdTest::FakeNfc::GetSentResponseCount(), "No session: no response should be sent");
	zassert_equal(rejectedBefore + 1, GetRejectedApduCount());

	/* After a session existed and was terminated. */
	PostFieldOn();
	SettleWorker();
	PostFieldOff();
	SettleWorker();
	zassert_false(IsSessionActive());

	zassert_equal(0, PostCommandApdu(command.data(), command.size()));
	SettleWorker();
	zassert_equal(0u, AliroUdTest::FakeNfc::GetSentResponseCount(),
		      "Post-termination APDU must still be rejected, not answered");
	zassert_equal(rejectedBefore + 2, GetRejectedApduCount());
}
```

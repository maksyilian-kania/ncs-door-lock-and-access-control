## CMakeLists.txt
```
#
# Copyright (c) 2026 Nordic Semiconductor ASA
#
# SPDX-License-Identifier: LicenseRef-Nordic-5-Clause
#

cmake_minimum_required(VERSION 3.20.0)

find_package(Zephyr REQUIRED HINTS $ENV{ZEPHYR_BASE})

project(aliro_nfc_user_device_host_smoke)

target_sources(app PRIVATE
  src/test_host_smoke.cpp
)
```

## prj.conf
```kconfig
#
# Copyright (c) 2026 Nordic Semiconductor ASA
#
# SPDX-License-Identifier: LicenseRef-Nordic-5-Clause
#

CONFIG_NCS_ALIRO_USER_DEVICE=y

CONFIG_CPP=y
CONFIG_STD_CPP17=y
CONFIG_REQUIRES_FULL_LIBCPP=y

CONFIG_ZTEST=y
CONFIG_ZTEST_STACK_SIZE=4096

CONFIG_LOG=y
```

## src/test_host_smoke.cpp
```c
/*
 * Copyright (c) 2026 Nordic Semiconductor ASA
 *
 * SPDX-License-Identifier: LicenseRef-Nordic-5-Clause
 */

#include <zephyr/ztest.h>

#include <aliro/user_device/user_device.h>

/*
 * AWP0 build/link evidence for ALIRO-UD-SYRS-P1-001: a host build that links
 * the checked-out Aliro::UserDeviceStack facade and calls its current public
 * Init() API. This is not protocol verification; session/APDU behavior is
 * exercised starting with AWP1.
 */
ZTEST_SUITE(aliro_nfc_user_device_host_smoke, nullptr, nullptr, nullptr, nullptr, nullptr);

ZTEST(aliro_nfc_user_device_host_smoke, test_stack_facade_links_and_initializes)
{
	const AliroError err = Aliro::UserDeviceStack::Instance().Init();

	zassert_equal(ALIRO_NO_ERROR, err.ToInt(), "UserDeviceStack::Init() unexpectedly failed");
}
```
